/******************************************************************************
* ASAP2 file: Toaster_ES1274A.a2l
* Code generation for model "Toaster_ES1274A".
* Model version : 1.1666
* Simulink Coder version : 8.14 (R2018a) 06-Feb-2018
* C source code generated on : Fri Sep 25 13:40:15 2020
* Target selection: MPC5644A.tlc
* Embedded hardware selection: Freescale->MPC55xx
* Code generation objectives: Unspecified
* Validation result: Not run
* (add additional file header information here)
******************************************************************************/ ASAP2_VERSION 1 31
/* Version 1.31 */
/begin PROJECT ProjectName "Project Comment Goes Here"
/begin HEADER "Header Comments go here" /end HEADER
/begin MODULE ModuleName "Module Comment Goes Here"
/* EcoCoder V2.8.10 R16 Target:ES1274A verCalTool:0.0*/
/* XCP-En:0 XCPCalTool:CANape CANape XCP-CAN:CAN_CTRL_C XCP-CAN-Baud:500kbps*/
/* CCP-En:1 CCP-TYPE:Configurable CCPCalTool:CANape CCP-CAN:CAN_CTRL_A CCP-CAN-Baud:500kbps*/
/*PGCANAEn:NoUse PGCANAStation:NoUse PGCANABaud:500kbps PGCANACRO:NoUse PGCANADTO:NoUse*/
/*PGCANBEn:NoUse PGCANBStation:NoUse PGCANBBaud:500kbps PGCANBCRO:NoUse PGCANBDTO:NoUse*/
/*PGCANCEn:NoUse PGCANCStation:NoUse PGCANCBaud:500kbps PGCANCCRO:NoUse PGCANCDTO:NoUse*/
/*PGCANDEn:NoUse PGCANDStation:NoUse PGCANDBaud:NoUsekbps PGCANDCRO:NoUse PGCANDDTO:NoUse*/
/*ECO_XCP_Note_Start
/begin IF_DATA XCP
/begin PROTOCOL_LAYER
0x0100
0x07D0
0x2710
0x3E8
0x2710
0x3E8
0x19
0x19
0x08
0x08
BYTE_ORDER_MSB_FIRST
ADDRESS_GRANULARITY_BYTE
OPTIONAL_CMD ALLOC_ODT_ENTRY
OPTIONAL_CMD ALLOC_ODT
OPTIONAL_CMD ALLOC_DAQ
OPTIONAL_CMD FREE_DAQ
OPTIONAL_CMD GET_DAQ_EVENT_INFO
OPTIONAL_CMD GET_DAQ_RESOLUTION_INFO
OPTIONAL_CMD GET_DAQ_PROCESSOR_INFO
OPTIONAL_CMD START_STOP_SYNCH
OPTIONAL_CMD START_STOP_DAQ_LIST
OPTIONAL_CMD GET_DAQ_LIST_MODE
OPTIONAL_CMD SET_DAQ_LIST_MODE
OPTIONAL_CMD WRITE_DAQ
OPTIONAL_CMD SET_DAQ_PTR
OPTIONAL_CMD CLEAR_DAQ_LIST
OPTIONAL_CMD DOWNLOAD
OPTIONAL_CMD SHORT_UPLOAD
OPTIONAL_CMD UPLOAD
OPTIONAL_CMD SET_MTA
OPTIONAL_CMD UNLOCK
OPTIONAL_CMD GET_SEED
OPTIONAL_CMD GET_ID
OPTIONAL_CMD GET_COMM_MODE_INFO
OPTIONAL_CMD BUILD_CHECKSUM
SEED_AND_KEY_EXTERNAL_FUNCTION ""
/end PROTOCOL_LAYER
/begin DAQ
DYNAMIC
0x00
0x05
0x00
OPTIMISATION_TYPE_DEFAULT
ADDRESS_EXTENSION_FREE
IDENTIFICATION_FIELD_TYPE_ABSOLUTE
GRANULARITY_ODT_ENTRY_SIZE_DAQ_BYTE
0x07
OVERLOAD_INDICATION_PID
/begin STIM
GRANULARITY_ODT_ENTRY_SIZE_STIM_BYTE
0x07
/end STIM
/begin EVENT
"5ms"
"5ms"
0x00
DAQ
0x01
0x05
0x06
0x00
/end EVENT
/begin EVENT
"20ms"
"20ms"
0x01
DAQ
0x01
0x02
0x07
0x00
/end EVENT
/begin EVENT
"50ms"
"50ms"
0x02
DAQ
0x01
0x05
0x07
0x00
/end EVENT
/begin EVENT
"100ms"
"100ms"
0x03
DAQ
0x01
0x01
0x08
0x00
/end EVENT
/begin EVENT
"200ms"
"200m"
0x04
DAQ
0x01
0x02
0x08
0x00
/end EVENT
/end DAQ
/begin PAG
0x00
/end PAG
/begin PGM
PGM_MODE_ABSOLUTE
0x00
0x00
/end PGM
/begin XCP_ON_CAN
0x0100
CAN_ID_MASTER 0x100
CAN_ID_SLAVE 0x101
BAUDRATE 500000
SAMPLE_POINT 0x4B
SAMPLE_RATE SINGLE
BTL_CYCLES 0x08
SJW 0x02
SYNC_EDGE SINGLE
/end XCP_ON_CAN
/end IF_DATA
/begin IF_DATA CANAPE_ADDRESS_UPDATE
/end IF_DATA
/begin MOD_PAR "_default_ModParComment"
/begin MEMORY_SEGMENT _ROMCAL
"calibration_rom"
DATA
FLASH
INTERN
0x00FD0000
0x00008000
-1 -1 -1 -1 -1
/begin IF_DATA XCP
/begin SEGMENT
0x00
0x01
0x00
0x00
0x00
/begin CHECKSUM
XCP_CRC_16_CITT
MAX_BLOCK_SIZE 0xFFFF
EXTERNAL_FUNCTION "String.Empty"
/end CHECKSUM
/begin PAGE
0x00
ECU_ACCESS_DONT_CARE
XCP_READ_ACCESS_DONT_CARE
XCP_WRITE_ACCESS_DONT_CARE
INIT_SEGMENT 0x00
/end PAGE
/begin ADDRESS_MAPPING
0x00FD0000
0x40000000
0x00008000
/end ADDRESS_MAPPING
/end SEGMENT
/end IF_DATA
/end MEMORY_SEGMENT
/begin MEMORY_SEGMENT _CODE
"ecu_code"
CODE
FLASH
INTERN
0x01000200
0x1FFA00
-1 -1 -1 -1 -1
/end MEMORY_SEGMENT
/end MOD_PAR
ECO_XCP_Note_End*/
/*ECO_CCP_Note_Start*/
/begin MOD_PAR "_default_ModParComment" ADDR_EPK 0x01000100 EPK "2020-09-25 13:40:19" /*EcoCoderINCAStart
/begin MEMORY_SEGMENT _RAMCAL
"calibration_ram"
DATA
RAM
INTERN
0x40000000
0x00008000
-1 -1 -1 -1 -1
/end MEMORY_SEGMENT
EcoCoderINCAEnd*/
 /begin MEMORY_SEGMENT _ROMCAL "calibration_rom" DATA FLASH INTERN 0x00FD0000 0x00008000 -1 -1 -1 -1 -1
  /begin IF_DATA ASAP1B_CCP /*EcoCoderINCAStart
ADDRESS_MAPPING 0x00FD0000 0x40000000 0x00008000
EcoCoderINCAEnd*/ ADDR_MAPPING 0x00FD0000 0x40000000 0x00008000 /end IF_DATA
 /end MEMORY_SEGMENT
 /begin MEMORY_SEGMENT _epk_data "epk_data" DATA FLASH INTERN 0x01000100 0xFF -1 -1 -1 -1 -1
  /begin IF_DATA ASAP1B_CCP /*EcoCoderINCAStart
ADDRESS_MAPPING 0x01000100 0x01000100 0xFF
EcoCoderINCAEnd*/ ADDR_MAPPING 0x01000100 0x01000100 0xFF /end IF_DATA
 /end MEMORY_SEGMENT
 /begin MEMORY_SEGMENT _CODE "ecu_code" CODE FLASH INTERN 0x01000200 0x1FFA00 -1 -1 -1 -1 -1 /end MEMORY_SEGMENT
/end MOD_PAR
/begin IF_DATA ASAP1B_CCP
 /begin SOURCE "20ms" 3 20 DISPLAY_IDENTIFIER DAQ2
  /begin QP_BLOB 1 LENGTH 0x20 CAN_ID_FIXED 0x101 RASTER 1 REDUCTION_ALLOWED FIRST_PID 0x3C /end QP_BLOB
 /end SOURCE
 /begin SOURCE "100ms" 3 100 DISPLAY_IDENTIFIER DAQ3
  /begin QP_BLOB 2 LENGTH 0x30 CAN_ID_FIXED 0x101 RASTER 2 REDUCTION_ALLOWED FIRST_PID 0x78 /end QP_BLOB
 /end SOURCE
 /begin RASTER "20ms" "20ms" 1 3 20 /end RASTER
 /begin RASTER "100ms" "100ms" 2 3 100 /end RASTER
 /begin SEED_KEY "" "" "" /end SEED_KEY
 /begin CHECKSUM "CRC16.dll" /end CHECKSUM
 /begin TP_BLOB 0x0201 0x0204 0x100 0x101 0x112 1 BAUDRATE 500000 SAMPLE_POINT 70 SAMPLE_RATE 1 BTL_CYCLES 10 SJW 1 SYNC_EDGE SINGLE DAQ_MODE 0 CONSISTENCY 1 ADDRESS_EXTENSION 0 RESUME_SUPPORTED STORE_SUPPORTED
  /begin CHECKSUM_PARAM /*EcoCoderINCAStart
0x9001
EcoCoderINCAEnd*/ 0x0C 0xffffffff CHECKSUM_CALCULATION ACTIVE_PAGE /end CHECKSUM_PARAM
  /begin DEFINED_PAGES 0x00 "RAM_PAGE" 0x00 0x40000000 0x00008000 RAM RAM_INIT_BY_ECU /end DEFINED_PAGES
  OPTIONAL_CMD 0X5 OPTIONAL_CMD 0X8 OPTIONAL_CMD 0X9 OPTIONAL_CMD 0XC OPTIONAL_CMD 0XD OPTIONAL_CMD 0XE OPTIONAL_CMD 0XF OPTIONAL_CMD 0X10 OPTIONAL_CMD 0X11 OPTIONAL_CMD 0X12 OPTIONAL_CMD 0X13 OPTIONAL_CMD 0X18 OPTIONAL_CMD 0X19 OPTIONAL_CMD 0X20 OPTIONAL_CMD 0X21 OPTIONAL_CMD 0X22 OPTIONAL_CMD 0X23 /end TP_BLOB
/end IF_DATA
/*ECO_CCP_Note_End*/
/begin MOD_COMMON "" /* Comment */ ALIGNMENT_BYTE 1 ALIGNMENT_WORD 1 ALIGNMENT_LONG 1 ALIGNMENT_FLOAT32_IEEE 1 ALIGNMENT_FLOAT64_IEEE 1 BYTE_ORDER MSB_FIRST DEPOSIT ABSOLUTE /end MOD_COMMON
/begin RECORD_LAYOUT Scalar_BOOLEAN FNC_VALUES 1 UBYTE COLUMN_DIR DIRECT /end RECORD_LAYOUT
/begin RECORD_LAYOUT Scalar_UBYTE FNC_VALUES 1 UBYTE COLUMN_DIR DIRECT /end RECORD_LAYOUT
/begin RECORD_LAYOUT Scalar_BYTE FNC_VALUES 1 SBYTE COLUMN_DIR DIRECT /end RECORD_LAYOUT
/begin RECORD_LAYOUT Scalar_UWORD FNC_VALUES 1 UWORD COLUMN_DIR DIRECT /end RECORD_LAYOUT
/begin RECORD_LAYOUT Scalar_SWORD FNC_VALUES 1 SWORD COLUMN_DIR DIRECT /end RECORD_LAYOUT
/begin RECORD_LAYOUT Scalar_ULONG FNC_VALUES 1 ULONG COLUMN_DIR DIRECT /end RECORD_LAYOUT
/begin RECORD_LAYOUT Scalar_LONG FNC_VALUES 1 SLONG COLUMN_DIR DIRECT /end RECORD_LAYOUT
/begin RECORD_LAYOUT Scalar_FLOAT32_IEEE FNC_VALUES 1 FLOAT32_IEEE COLUMN_DIR DIRECT /end RECORD_LAYOUT
/begin RECORD_LAYOUT Scalar_FLOAT64_IEEE FNC_VALUES 1 FLOAT64_IEEE COLUMN_DIR DIRECT /end RECORD_LAYOUT
/begin RECORD_LAYOUT Lookup1D_BOOLEAN FNC_VALUES 1 UBYTE COLUMN_DIR DIRECT /end RECORD_LAYOUT
/begin RECORD_LAYOUT Lookup1D_X_BOOLEAN AXIS_PTS_X 1 UBYTE INDEX_INCR DIRECT /end RECORD_LAYOUT
/begin RECORD_LAYOUT Lookup1D_BYTE FNC_VALUES 1 SBYTE COLUMN_DIR DIRECT /end RECORD_LAYOUT
/begin RECORD_LAYOUT Lookup1D_X_BYTE AXIS_PTS_X 1 SBYTE INDEX_INCR DIRECT /end RECORD_LAYOUT
/begin RECORD_LAYOUT Lookup1D_UBYTE FNC_VALUES 1 UBYTE COLUMN_DIR DIRECT /end RECORD_LAYOUT
/begin RECORD_LAYOUT Lookup1D_X_UBYTE AXIS_PTS_X 1 UBYTE INDEX_INCR DIRECT /end RECORD_LAYOUT
/begin RECORD_LAYOUT Lookup1D_UWORD FNC_VALUES 1 UWORD COLUMN_DIR DIRECT /end RECORD_LAYOUT
/begin RECORD_LAYOUT Lookup1D_X_UWORD AXIS_PTS_X 1 UWORD INDEX_INCR DIRECT /end RECORD_LAYOUT
/begin RECORD_LAYOUT Lookup1D_WORD FNC_VALUES 1 SWORD COLUMN_DIR DIRECT /end RECORD_LAYOUT
/begin RECORD_LAYOUT Lookup1D_X_WORD AXIS_PTS_X 1 SWORD INDEX_INCR DIRECT /end RECORD_LAYOUT
/begin RECORD_LAYOUT Lookup1D_ULONG FNC_VALUES 1 ULONG COLUMN_DIR DIRECT /end RECORD_LAYOUT
/begin RECORD_LAYOUT Lookup1D_X_ULONG AXIS_PTS_X 1 ULONG INDEX_INCR DIRECT /end RECORD_LAYOUT
/begin RECORD_LAYOUT Lookup1D_SLONG FNC_VALUES 1 SLONG COLUMN_DIR DIRECT /end RECORD_LAYOUT
/begin RECORD_LAYOUT Lookup1D_X_LONG AXIS_PTS_X 1 SLONG INDEX_INCR DIRECT /end RECORD_LAYOUT
/begin RECORD_LAYOUT Lookup1D_FLOAT32_IEEE FNC_VALUES 1 FLOAT32_IEEE COLUMN_DIR DIRECT /end RECORD_LAYOUT
/begin RECORD_LAYOUT Lookup1D_X_FLOAT32_IEEE AXIS_PTS_X 1 FLOAT32_IEEE INDEX_INCR DIRECT /end RECORD_LAYOUT
/begin RECORD_LAYOUT Lookup1D_FLOAT64_IEEE FNC_VALUES 1 FLOAT64_IEEE COLUMN_DIR DIRECT /end RECORD_LAYOUT
/begin RECORD_LAYOUT Lookup1D_X_FLOAT64_IEEE AXIS_PTS_X 1 FLOAT64_IEEE INDEX_INCR DIRECT /end RECORD_LAYOUT
/begin RECORD_LAYOUT Lookup2D_BOOLEAN FNC_VALUES 1 UBYTE COLUMN_DIR DIRECT /end RECORD_LAYOUT
/begin RECORD_LAYOUT Lookup2D_X_BOOLEAN AXIS_PTS_X 1 UBYTE INDEX_INCR DIRECT /end RECORD_LAYOUT
/begin RECORD_LAYOUT Lookup2D_UBYTE FNC_VALUES 1 UBYTE COLUMN_DIR DIRECT /end RECORD_LAYOUT
/begin RECORD_LAYOUT Lookup2D_X_UBYTE AXIS_PTS_X 1 UBYTE INDEX_INCR DIRECT /end RECORD_LAYOUT
/begin RECORD_LAYOUT Lookup2D_BYTE FNC_VALUES 1 SBYTE COLUMN_DIR DIRECT /end RECORD_LAYOUT
/begin RECORD_LAYOUT Lookup2D_X_BYTE AXIS_PTS_X 1 SBYTE INDEX_INCR DIRECT /end RECORD_LAYOUT
/begin RECORD_LAYOUT Lookup2D_UWORD FNC_VALUES 1 UWORD COLUMN_DIR DIRECT /end RECORD_LAYOUT
/begin RECORD_LAYOUT Lookup2D_X_UWORD AXIS_PTS_X 1 UWORD INDEX_INCR DIRECT /end RECORD_LAYOUT
/begin RECORD_LAYOUT Lookup2D_WORD FNC_VALUES 1 SWORD COLUMN_DIR DIRECT /end RECORD_LAYOUT
/begin RECORD_LAYOUT Lookup2D_X_WORD AXIS_PTS_X 1 SWORD INDEX_INCR DIRECT /end RECORD_LAYOUT
/begin RECORD_LAYOUT Lookup2D_ULONG FNC_VALUES 1 ULONG COLUMN_DIR DIRECT /end RECORD_LAYOUT
/begin RECORD_LAYOUT Lookup2D_X_ULONG AXIS_PTS_X 1 ULONG INDEX_INCR DIRECT /end RECORD_LAYOUT
/begin RECORD_LAYOUT Lookup2D_LONG FNC_VALUES 1 SLONG COLUMN_DIR DIRECT /end RECORD_LAYOUT
/begin RECORD_LAYOUT Lookup2D_X_LONG AXIS_PTS_X 1 SLONG INDEX_INCR DIRECT /end RECORD_LAYOUT
/begin RECORD_LAYOUT Lookup2D_FLOAT32_IEEE FNC_VALUES 1 FLOAT32_IEEE COLUMN_DIR DIRECT /end RECORD_LAYOUT
/begin RECORD_LAYOUT Lookup2D_X_FLOAT32_IEEE AXIS_PTS_X 1 FLOAT32_IEEE INDEX_INCR DIRECT /end RECORD_LAYOUT
/begin RECORD_LAYOUT Lookup2D_FLOAT64_IEEE FNC_VALUES 1 FLOAT64_IEEE COLUMN_DIR DIRECT /end RECORD_LAYOUT
/begin RECORD_LAYOUT Lookup2D_X_FLOAT64_IEEE AXIS_PTS_X 1 FLOAT64_IEEE INDEX_INCR DIRECT /end RECORD_LAYOUT
/begin CHARACTERISTIC DriveCmd_AccCmdOvrCal_val "" VALUE 0xfd0028 /* @ECU_Address@DriveCmd_AccCmdOvrCal_val@ */ Scalar_FLOAT32_IEEE 0 Toaster_ES1274A_CM_single -3.4E+38 3.4E+38 /end CHARACTERISTIC
/begin CHARACTERISTIC DriveCmd_BrakeDecelCmdOvrCal_val "" VALUE 0xfd0030 /* @ECU_Address@DriveCmd_BrakeDecelCmdOvrCal_val@ */ Scalar_FLOAT32_IEEE 0 Toaster_ES1274A_CM_single -3.4E+38 3.4E+38 /end CHARACTERISTIC
/begin CHARACTERISTIC Pwr_tOffDelay_val "" VALUE 0xfd005c /* @ECU_Address@Pwr_tOffDelay_val@ */ Scalar_FLOAT32_IEEE 0 Toaster_ES1274A_CM_single_s -3.4E+38 3.4E+38 /end CHARACTERISTIC
/begin CHARACTERISTIC Remote_max_decl "" VALUE 0xfd0064 /* @ECU_Address@Remote_max_decl@ */ Scalar_FLOAT32_IEEE 0 Toaster_ES1274A_CM_single 0.0 100.0 /end CHARACTERISTIC
/begin CHARACTERISTIC SteeringCmd_AngelCmdOvrCal_val "" VALUE 0xfd008c /* @ECU_Address@SteeringCmd_AngelCmdOvrCal_val@ */ Scalar_FLOAT32_IEEE 0 Toaster_ES1274A_CM_single -3.4E+38 3.4E+38 /end CHARACTERISTIC
/begin CHARACTERISTIC SteeringCmd_AngelRateCmdOvrCal_val "" VALUE 0xfd0094 /* @ECU_Address@SteeringCmd_AngelRateCmdOvrCal_val@ */ Scalar_FLOAT32_IEEE 0 Toaster_ES1274A_CM_single -3.4E+38 3.4E+38 /end CHARACTERISTIC
/begin CHARACTERISTIC Toaster1_wheel_tire_radius "" VALUE 0xfd009c /* @ECU_Address@Toaster1_wheel_tire_radius@ */ Scalar_FLOAT32_IEEE 0 Toaster_ES1274A_CM_single_mm -3.4E+38 3.4E+38 /end CHARACTERISTIC
/begin CHARACTERISTIC Veh_7BCLF_Wheel_spdOvrCal_val "" VALUE 0xfd00a4 /* @ECU_Address@Veh_7BCLF_Wheel_spdOvrCal_val@ */ Scalar_FLOAT32_IEEE 0 Toaster_ES1274A_CM_single -3.4E+38 3.4E+38 /end CHARACTERISTIC
/begin CHARACTERISTIC Veh_7BCLR_Wheel_spdOvrCal_val "" VALUE 0xfd00ac /* @ECU_Address@Veh_7BCLR_Wheel_spdOvrCal_val@ */ Scalar_FLOAT32_IEEE 0 Toaster_ES1274A_CM_single -3.4E+38 3.4E+38 /end CHARACTERISTIC
/begin CHARACTERISTIC Veh_7BCRF_Wheel_spdOvrCal_val "" VALUE 0xfd00b4 /* @ECU_Address@Veh_7BCRF_Wheel_spdOvrCal_val@ */ Scalar_FLOAT32_IEEE 0 Toaster_ES1274A_CM_single -3.4E+38 3.4E+38 /end CHARACTERISTIC
/begin CHARACTERISTIC Veh_7BCRR_Wheel_spdOvrCal_val "" VALUE 0xfd00bc /* @ECU_Address@Veh_7BCRR_Wheel_spdOvrCal_val@ */ Scalar_FLOAT32_IEEE 0 Toaster_ES1274A_CM_single -3.4E+38 3.4E+38 /end CHARACTERISTIC
/begin CHARACTERISTIC acceleratorPositionOvrCal_val "" VALUE 0xfd00dc /* @ECU_Address@acceleratorPositionOvrCal_val@ */ Scalar_FLOAT32_IEEE 0 Toaster_ES1274A_CM_single -3.4E+38 3.4E+38 /end CHARACTERISTIC
/begin CHARACTERISTIC acceleratorPositionRateOvrCal_val "" VALUE 0xfd00e4 /* @ECU_Address@acceleratorPositionRateOvrCal_val@ */ Scalar_FLOAT32_IEEE 0 Toaster_ES1274A_CM_single -3.4E+38 3.4E+38 /end CHARACTERISTIC
/begin CHARACTERISTIC brakePedalDriverActivityThreshold_percent "" VALUE 0xfd010c /* @ECU_Address@brakePedalDriverActivityThreshold_percent@ */ Scalar_FLOAT32_IEEE 0 Toaster_ES1274A_CM_single -3.4E+38 3.4E+38 /end CHARACTERISTIC
/begin CHARACTERISTIC brakePedalDriverActivityThreshold_ticks "" VALUE 0xfd0110 /* @ECU_Address@brakePedalDriverActivityThreshold_ticks@ */ Scalar_FLOAT32_IEEE 0 Toaster_ES1274A_CM_single -3.4E+38 3.4E+38 /end CHARACTERISTIC
/begin CHARACTERISTIC brakePedalDriverOverrideThreshold_percent "" VALUE 0xfd0114 /* @ECU_Address@brakePedalDriverOverrideThreshold_percent@ */ Scalar_FLOAT32_IEEE 0 Toaster_ES1274A_CM_single -3.4E+38 3.4E+38 /end CHARACTERISTIC
/begin CHARACTERISTIC brakePedalDriverOverrideThreshold_ticks "" VALUE 0xfd0118 /* @ECU_Address@brakePedalDriverOverrideThreshold_ticks@ */ Scalar_FLOAT32_IEEE 0 Toaster_ES1274A_CM_single -3.4E+38 3.4E+38 /end CHARACTERISTIC
/begin CHARACTERISTIC brakePedalPositionOvrCal_val "" VALUE 0xfd011c /* @ECU_Address@brakePedalPositionOvrCal_val@ */ Scalar_FLOAT32_IEEE 0 Toaster_ES1274A_CM_single -3.4E+38 3.4E+38 /end CHARACTERISTIC
/begin CHARACTERISTIC brakePedalPositionRateLimit_percentps "" VALUE 0xfd0124 /* @ECU_Address@brakePedalPositionRateLimit_percentps@ */ Scalar_FLOAT32_IEEE 0 Toaster_ES1274A_CM_single -3.4E+38 3.4E+38 /end CHARACTERISTIC
/begin CHARACTERISTIC cmd_brakePedalPositionOvrCal_val "" VALUE 0xfd0134 /* @ECU_Address@cmd_brakePedalPositionOvrCal_val@ */ Scalar_FLOAT32_IEEE 0 Toaster_ES1274A_CM_single -3.4E+38 3.4E+38 /end CHARACTERISTIC
/begin CHARACTERISTIC cmd_brakePedalPositionRateOvrCal_val "" VALUE 0xfd013c /* @ECU_Address@cmd_brakePedalPositionRateOvrCal_val@ */ Scalar_FLOAT32_IEEE 0 Toaster_ES1274A_CM_single -3.4E+38 3.4E+38 /end CHARACTERISTIC
/begin CHARACTERISTIC steeringWheelAngleCommand_DegOvrCal_val "" VALUE 0xfd0190 /* @ECU_Address@steeringWheelAngleCommand_DegOvrCal_val@ */ Scalar_FLOAT32_IEEE 0 Toaster_ES1274A_CM_single -3.4E+38 3.4E+38 /end CHARACTERISTIC
/begin CHARACTERISTIC steeringWheelAngleRateCommandOvrCal_val "" VALUE 0xfd0198 /* @ECU_Address@steeringWheelAngleRateCommandOvrCal_val@ */ Scalar_FLOAT32_IEEE 0 Toaster_ES1274A_CM_single -3.4E+38 3.4E+38 /end CHARACTERISTIC
/begin CHARACTERISTIC steeringWheelAngleRateSetpointOvrCal_val "" VALUE 0xfd01a0 /* @ECU_Address@steeringWheelAngleRateSetpointOvrCal_val@ */ Scalar_FLOAT32_IEEE 0 Toaster_ES1274A_CM_single -3.4E+38 3.4E+38 /end CHARACTERISTIC
/begin CHARACTERISTIC steeringWheelAngleSetpoint_DegOvrCal_val "" VALUE 0xfd01a8 /* @ECU_Address@steeringWheelAngleSetpoint_DegOvrCal_val@ */ Scalar_FLOAT32_IEEE 0 Toaster_ES1274A_CM_single -3.4E+38 3.4E+38 /end CHARACTERISTIC
/begin CHARACTERISTIC steering_feedback_eps_statusOvrCal_val "" VALUE 0xfd01b8 /* @ECU_Address@steering_feedback_eps_statusOvrCal_val@ */ Scalar_FLOAT32_IEEE 0 Toaster_ES1274A_CM_single -3.4E+38 3.4E+38 /end CHARACTERISTIC
/begin CHARACTERISTIC systemAgeValidOvrCal_val "" VALUE 0xfd01c8 /* @ECU_Address@systemAgeValidOvrCal_val@ */ Scalar_FLOAT32_IEEE 0 Toaster_ES1274A_CM_single -3.4E+38 3.4E+38 /end CHARACTERISTIC
/begin CHARACTERISTIC throttlePedalDriverActivityThreshold_percent "" VALUE 0xfd01f0 /* @ECU_Address@throttlePedalDriverActivityThreshold_percent@ */ Scalar_FLOAT32_IEEE 0 Toaster_ES1274A_CM_single -3.4E+38 3.4E+38 /end CHARACTERISTIC
/begin CHARACTERISTIC throttlePedalDriverActivityThreshold_ticks "" VALUE 0xfd01f4 /* @ECU_Address@throttlePedalDriverActivityThreshold_ticks@ */ Scalar_FLOAT32_IEEE 0 Toaster_ES1274A_CM_single -3.4E+38 3.4E+38 /end CHARACTERISTIC
/begin CHARACTERISTIC throttlePedalDriverOverrideThreshold_percent "" VALUE 0xfd01f8 /* @ECU_Address@throttlePedalDriverOverrideThreshold_percent@ */ Scalar_FLOAT32_IEEE 0 Toaster_ES1274A_CM_single -3.4E+38 3.4E+38 /end CHARACTERISTIC
/begin CHARACTERISTIC throttlePedalDriverOverrideThreshold_ticks "" VALUE 0xfd01fc /* @ECU_Address@throttlePedalDriverOverrideThreshold_ticks@ */ Scalar_FLOAT32_IEEE 0 Toaster_ES1274A_CM_single -3.4E+38 3.4E+38 /end CHARACTERISTIC
/begin CHARACTERISTIC throttlePedalPositionOvrCal_val "" VALUE 0xfd0200 /* @ECU_Address@throttlePedalPositionOvrCal_val@ */ Scalar_FLOAT32_IEEE 0 Toaster_ES1274A_CM_single -3.4E+38 3.4E+38 /end CHARACTERISTIC
/begin CHARACTERISTIC throttlePedalPositionRateLimit_percentps "" VALUE 0xfd0208 /* @ECU_Address@throttlePedalPositionRateLimit_percentps@ */ Scalar_FLOAT32_IEEE 0 Toaster_ES1274A_CM_single -3.4E+38 3.4E+38 /end CHARACTERISTIC
/begin CHARACTERISTIC CAL_LedBrightnessDutyCycle_OFF "" VALUE 0xfd0018 /* @ECU_Address@CAL_LedBrightnessDutyCycle_OFF@ */ Scalar_ULONG 0 Toaster_ES1274A_CM_uint32 0 4294967295 /end CHARACTERISTIC
/begin CHARACTERISTIC CAL_LedBrightnessDutyCycle_ON "" VALUE 0xfd001c /* @ECU_Address@CAL_LedBrightnessDutyCycle_ON@ */ Scalar_ULONG 0 Toaster_ES1274A_CM_uint32 0 4294967295 /end CHARACTERISTIC
/begin CHARACTERISTIC greenLEDDutyOvrCal_val "" VALUE 0xfd014c /* @ECU_Address@greenLEDDutyOvrCal_val@ */ Scalar_ULONG 0 Toaster_ES1274A_CM_uint32 0 4294967295 /end CHARACTERISTIC
/begin CHARACTERISTIC greenLEDFreqOvrCal_val "" VALUE 0xfd0154 /* @ECU_Address@greenLEDFreqOvrCal_val@ */ Scalar_ULONG 0 Toaster_ES1274A_CM_uint32 0 4294967295 /end CHARACTERISTIC
/begin CHARACTERISTIC redLEDDutyOvrCal_val "" VALUE 0xfd015c /* @ECU_Address@redLEDDutyOvrCal_val@ */ Scalar_ULONG 0 Toaster_ES1274A_CM_uint32 0 4294967295 /end CHARACTERISTIC
/begin CHARACTERISTIC redLEDFreqOvrCal_val "" VALUE 0xfd0164 /* @ECU_Address@redLEDFreqOvrCal_val@ */ Scalar_ULONG 0 Toaster_ES1274A_CM_uint32 0 4294967295 /end CHARACTERISTIC
/begin CHARACTERISTIC systemAgeOvrCal_val "" VALUE 0xfd01c0 /* @ECU_Address@systemAgeOvrCal_val@ */ Scalar_ULONG 0 Toaster_ES1274A_CM_uint32 0 4294967295 /end CHARACTERISTIC
/begin CHARACTERISTIC yellowLEDDutyOvrCal_val "" VALUE 0xfd0230 /* @ECU_Address@yellowLEDDutyOvrCal_val@ */ Scalar_ULONG 0 Toaster_ES1274A_CM_uint32 0 4294967295 /end CHARACTERISTIC
/begin CHARACTERISTIC yellowLEDFreqOvrCal_val "" VALUE 0xfd0238 /* @ECU_Address@yellowLEDFreqOvrCal_val@ */ Scalar_ULONG 0 Toaster_ES1274A_CM_uint32 0 4294967295 /end CHARACTERISTIC
/begin CHARACTERISTIC Bypass_BeepFrqSetting "" VALUE 0xfd0014 /* @ECU_Address@Bypass_BeepFrqSetting@ */ Scalar_UWORD 0 Toaster_ES1274A_CM_uint16 0 65535 /end CHARACTERISTIC
/begin CHARACTERISTIC Bypass_BeepPattern "" VALUE 0xfd0016 /* @ECU_Address@Bypass_BeepPattern@ */ Scalar_UWORD 0 Toaster_ES1274A_CM_uint16 0 65535 /end CHARACTERISTIC
/begin CHARACTERISTIC DriveCmd_GearCmdOvrCal_val "" VALUE 0xfd0036 /* @ECU_Address@DriveCmd_GearCmdOvrCal_val@ */ Scalar_UWORD 0 Toaster_ES1274A_CM_uint16 0 65535 /end CHARACTERISTIC
/begin CHARACTERISTIC DuringOfBuzzerOnAfterEpoPressed_tick "" VALUE 0xfd003a /* @ECU_Address@DuringOfBuzzerOnAfterEpoPressed_tick@ */ Scalar_UWORD 0 Toaster_ES1274A_CM_uint16 0 65535 /end CHARACTERISTIC
/begin CHARACTERISTIC SetBuzzerBeepFrqHi_Tick "" VALUE 0xfd007c /* @ECU_Address@SetBuzzerBeepFrqHi_Tick@ */ Scalar_UWORD 0 Toaster_ES1274A_CM_uint16 0 65535 /end CHARACTERISTIC
/begin CHARACTERISTIC SetBuzzerBeepFrqLo_tick "" VALUE 0xfd007e /* @ECU_Address@SetBuzzerBeepFrqLo_tick@ */ Scalar_UWORD 0 Toaster_ES1274A_CM_uint16 0 65535 /end CHARACTERISTIC
/begin CHARACTERISTIC SetBuzzerChirpDuration_Tick "" VALUE 0xfd0080 /* @ECU_Address@SetBuzzerChirpDuration_Tick@ */ Scalar_UWORD 0 Toaster_ES1274A_CM_uint16 0 65535 /end CHARACTERISTIC
/begin CHARACTERISTIC SetBuzzerChirpGap_Tick "" VALUE 0xfd0082 /* @ECU_Address@SetBuzzerChirpGap_Tick@ */ Scalar_UWORD 0 Toaster_ES1274A_CM_uint16 0 65535 /end CHARACTERISTIC
/begin CHARACTERISTIC accessoryCommandAgeThreshold "" VALUE 0xfd00f0 /* @ECU_Address@accessoryCommandAgeThreshold@ */ Scalar_UWORD 0 Toaster_ES1274A_CM_uint16 0 65535 /end CHARACTERISTIC
/begin CHARACTERISTIC brakeCommandAgeThreshold "" VALUE 0xfd00fe /* @ECU_Address@brakeCommandAgeThreshold@ */ Scalar_UWORD 0 Toaster_ES1274A_CM_uint16 0 65535 /end CHARACTERISTIC
/begin CHARACTERISTIC shiftCommandAgeThreshold "" VALUE 0xfd017a /* @ECU_Address@shiftCommandAgeThreshold@ */ Scalar_UWORD 0 Toaster_ES1274A_CM_uint16 0 65535 /end CHARACTERISTIC
/begin CHARACTERISTIC steerCommandAgeThreshold "" VALUE 0xfd0186 /* @ECU_Address@steerCommandAgeThreshold@ */ Scalar_UWORD 0 Toaster_ES1274A_CM_uint16 0 65535 /end CHARACTERISTIC
/begin CHARACTERISTIC steeringWheelAngle_rawOvrCal_val "" VALUE 0xfd01ae /* @ECU_Address@steeringWheelAngle_rawOvrCal_val@ */ Scalar_UWORD 0 Toaster_ES1274A_CM_uint16 0 65535 /end CHARACTERISTIC
/begin CHARACTERISTIC steeringWheelDriverOverrideThreshold_ticks "" VALUE 0xfd01b2 /* @ECU_Address@steeringWheelDriverOverrideThreshold_ticks@ */ Scalar_UWORD 0 Toaster_ES1274A_CM_uint16 0 65535 /end CHARACTERISTIC
/begin CHARACTERISTIC steeringWheelFaultOverrideThreshold_ticks "" VALUE 0xfd01b4 /* @ECU_Address@steeringWheelFaultOverrideThreshold_ticks@ */ Scalar_UWORD 0 Toaster_ES1274A_CM_uint16 0 65535 /end CHARACTERISTIC
/begin CHARACTERISTIC systemCommandAgeThreshold "" VALUE 0xfd01d4 /* @ECU_Address@systemCommandAgeThreshold@ */ Scalar_UWORD 0 Toaster_ES1274A_CM_uint16 0 65535 /end CHARACTERISTIC
/begin CHARACTERISTIC throttleCommandAgeThreshold "" VALUE 0xfd01e4 /* @ECU_Address@throttleCommandAgeThreshold@ */ Scalar_UWORD 0 Toaster_ES1274A_CM_uint16 0 65535 /end CHARACTERISTIC
/begin CHARACTERISTIC vehicle7B0AgeThreshold "" VALUE 0xfd0216 /* @ECU_Address@vehicle7B0AgeThreshold@ */ Scalar_UWORD 0 Toaster_ES1274A_CM_uint16 0 65535 /end CHARACTERISTIC
/begin CHARACTERISTIC vehicle7B1AgeThreshold "" VALUE 0xfd0218 /* @ECU_Address@vehicle7B1AgeThreshold@ */ Scalar_UWORD 0 Toaster_ES1274A_CM_uint16 0 65535 /end CHARACTERISTIC
/begin CHARACTERISTIC vehicle7B3AgeThreshold "" VALUE 0xfd021a /* @ECU_Address@vehicle7B3AgeThreshold@ */ Scalar_UWORD 0 Toaster_ES1274A_CM_uint16 0 65535 /end CHARACTERISTIC
/begin CHARACTERISTIC vehicle7B4AgeThreshold "" VALUE 0xfd021c /* @ECU_Address@vehicle7B4AgeThreshold@ */ Scalar_UWORD 0 Toaster_ES1274A_CM_uint16 0 65535 /end CHARACTERISTIC
/begin CHARACTERISTIC vehicle7B5AgeThreshold "" VALUE 0xfd021e /* @ECU_Address@vehicle7B5AgeThreshold@ */ Scalar_UWORD 0 Toaster_ES1274A_CM_uint16 0 65535 /end CHARACTERISTIC
/begin CHARACTERISTIC vehicle7B9AgeThreshold "" VALUE 0xfd0220 /* @ECU_Address@vehicle7B9AgeThreshold@ */ Scalar_UWORD 0 Toaster_ES1274A_CM_uint16 0 65535 /end CHARACTERISTIC
/begin CHARACTERISTIC vehicle7BAAgeThreshold "" VALUE 0xfd0222 /* @ECU_Address@vehicle7BAAgeThreshold@ */ Scalar_UWORD 0 Toaster_ES1274A_CM_uint16 0 65535 /end CHARACTERISTIC
/begin CHARACTERISTIC vehicle7BBAgeThreshold "" VALUE 0xfd0224 /* @ECU_Address@vehicle7BBAgeThreshold@ */ Scalar_UWORD 0 Toaster_ES1274A_CM_uint16 0 65535 /end CHARACTERISTIC
/begin CHARACTERISTIC vehicle7BCAgeThreshold "" VALUE 0xfd0226 /* @ECU_Address@vehicle7BCAgeThreshold@ */ Scalar_UWORD 0 Toaster_ES1274A_CM_uint16 0 65535 /end CHARACTERISTIC
/begin CHARACTERISTIC vehicle7BEAgeThreshold "" VALUE 0xfd0228 /* @ECU_Address@vehicle7BEAgeThreshold@ */ Scalar_UWORD 0 Toaster_ES1274A_CM_uint16 0 65535 /end CHARACTERISTIC
/begin CHARACTERISTIC vehicle7BFAgeThreshold "" VALUE 0xfd022a /* @ECU_Address@vehicle7BFAgeThreshold@ */ Scalar_UWORD 0 Toaster_ES1274A_CM_uint16 0 65535 /end CHARACTERISTIC
/begin CHARACTERISTIC vehicle7D3AgeThreshold "" VALUE 0xfd022c /* @ECU_Address@vehicle7D3AgeThreshold@ */ Scalar_UWORD 0 Toaster_ES1274A_CM_uint16 0 65535 /end CHARACTERISTIC
/begin CHARACTERISTIC ByPass_ValidateAccessoryCommandAge "" VALUE 0xfd0001 /* @ECU_Address@ByPass_ValidateAccessoryCommandAge@ */ Scalar_BOOLEAN 0 Toaster_ES1274A_CM_boolean 0 1 /end CHARACTERISTIC
/begin CHARACTERISTIC ByPass_ValidateAccessoryCommandCRC "" VALUE 0xfd0002 /* @ECU_Address@ByPass_ValidateAccessoryCommandCRC@ */ Scalar_BOOLEAN 0 Toaster_ES1274A_CM_boolean 0 1 /end CHARACTERISTIC
/begin CHARACTERISTIC ByPass_ValidateAccessoryCommandCounter "" VALUE 0xfd0003 /* @ECU_Address@ByPass_ValidateAccessoryCommandCounter@ */ Scalar_BOOLEAN 0 Toaster_ES1274A_CM_boolean 0 1 /end CHARACTERISTIC
/begin CHARACTERISTIC ByPass_ValidateBrakeCommandCRC "" VALUE 0xfd0004 /* @ECU_Address@ByPass_ValidateBrakeCommandCRC@ */ Scalar_BOOLEAN 0 Toaster_ES1274A_CM_boolean 0 1 /end CHARACTERISTIC
/begin CHARACTERISTIC ByPass_ValidateBrakeCommandCounter "" VALUE 0xfd0005 /* @ECU_Address@ByPass_ValidateBrakeCommandCounter@ */ Scalar_BOOLEAN 0 Toaster_ES1274A_CM_boolean 0 1 /end CHARACTERISTIC
/begin CHARACTERISTIC ByPass_ValidateShiftCommandAge "" VALUE 0xfd0006 /* @ECU_Address@ByPass_ValidateShiftCommandAge@ */ Scalar_BOOLEAN 0 Toaster_ES1274A_CM_boolean 0 1 /end CHARACTERISTIC
/begin CHARACTERISTIC ByPass_ValidateShiftCommandCRC "" VALUE 0xfd0007 /* @ECU_Address@ByPass_ValidateShiftCommandCRC@ */ Scalar_BOOLEAN 0 Toaster_ES1274A_CM_boolean 0 1 /end CHARACTERISTIC
/begin CHARACTERISTIC ByPass_ValidateShiftCommandCounter "" VALUE 0xfd0008 /* @ECU_Address@ByPass_ValidateShiftCommandCounter@ */ Scalar_BOOLEAN 0 Toaster_ES1274A_CM_boolean 0 1 /end CHARACTERISTIC
/begin CHARACTERISTIC ByPass_ValidateSteerCommandAge "" VALUE 0xfd0009 /* @ECU_Address@ByPass_ValidateSteerCommandAge@ */ Scalar_BOOLEAN 0 Toaster_ES1274A_CM_boolean 0 1 /end CHARACTERISTIC
/begin CHARACTERISTIC ByPass_ValidateSteerCommandCRC "" VALUE 0xfd000a /* @ECU_Address@ByPass_ValidateSteerCommandCRC@ */ Scalar_BOOLEAN 0 Toaster_ES1274A_CM_boolean 0 1 /end CHARACTERISTIC
/begin CHARACTERISTIC ByPass_ValidateSteerCommandCounter "" VALUE 0xfd000b /* @ECU_Address@ByPass_ValidateSteerCommandCounter@ */ Scalar_BOOLEAN 0 Toaster_ES1274A_CM_boolean 0 1 /end CHARACTERISTIC
/begin CHARACTERISTIC ByPass_ValidateSystemCommandAge "" VALUE 0xfd000c /* @ECU_Address@ByPass_ValidateSystemCommandAge@ */ Scalar_BOOLEAN 0 Toaster_ES1274A_CM_boolean 0 1 /end CHARACTERISTIC
/begin CHARACTERISTIC ByPass_ValidateSystemCommandCRC "" VALUE 0xfd000d /* @ECU_Address@ByPass_ValidateSystemCommandCRC@ */ Scalar_BOOLEAN 0 Toaster_ES1274A_CM_boolean 0 1 /end CHARACTERISTIC
/begin CHARACTERISTIC ByPass_ValidateSystemCommandCounter "" VALUE 0xfd000e /* @ECU_Address@ByPass_ValidateSystemCommandCounter@ */ Scalar_BOOLEAN 0 Toaster_ES1274A_CM_boolean 0 1 /end CHARACTERISTIC
/begin CHARACTERISTIC ByPass_ValidateThrottleCommandAge "" VALUE 0xfd000f /* @ECU_Address@ByPass_ValidateThrottleCommandAge@ */ Scalar_BOOLEAN 0 Toaster_ES1274A_CM_boolean 0 1 /end CHARACTERISTIC
/begin CHARACTERISTIC ByPass_ValidateThrottleCommandCRC "" VALUE 0xfd0010 /* @ECU_Address@ByPass_ValidateThrottleCommandCRC@ */ Scalar_BOOLEAN 0 Toaster_ES1274A_CM_boolean 0 1 /end CHARACTERISTIC
/begin CHARACTERISTIC ByPass_ValidateThrottleCommandCounter "" VALUE 0xfd0011 /* @ECU_Address@ByPass_ValidateThrottleCommandCounter@ */ Scalar_BOOLEAN 0 Toaster_ES1274A_CM_boolean 0 1 /end CHARACTERISTIC
/begin CHARACTERISTIC ByPass_ValidatekBrakeCommandAge "" VALUE 0xfd0012 /* @ECU_Address@ByPass_ValidatekBrakeCommandAge@ */ Scalar_BOOLEAN 0 Toaster_ES1274A_CM_boolean 0 1 /end CHARACTERISTIC
/begin CHARACTERISTIC CMD_DoorFROvrEn_val "Override Control" VALUE 0xfd0021 /* @ECU_Address@CMD_DoorFROvrEn_val@ */ Scalar_BOOLEAN 0 Toaster_ES1274A_CM_boolean 0 1 /end CHARACTERISTIC
/begin CHARACTERISTIC CMD_hornOvrEn_val "Override Control" VALUE 0xfd0023 /* @ECU_Address@CMD_hornOvrEn_val@ */ Scalar_BOOLEAN 0 Toaster_ES1274A_CM_boolean 0 1 /end CHARACTERISTIC
/begin CHARACTERISTIC DBW_EPB_cmd_7A4OvrEn_val "Override Control" VALUE 0xfd0025 /* @ECU_Address@DBW_EPB_cmd_7A4OvrEn_val@ */ Scalar_BOOLEAN 0 Toaster_ES1274A_CM_boolean 0 1 /end CHARACTERISTIC
/begin CHARACTERISTIC DriveCmd_AccCmdOvrEn_val "Override Control" VALUE 0xfd002c /* @ECU_Address@DriveCmd_AccCmdOvrEn_val@ */ Scalar_BOOLEAN 0 Toaster_ES1274A_CM_boolean 0 1 /end CHARACTERISTIC
/begin CHARACTERISTIC DriveCmd_BrakeDecelCmdOvrEn_val "Override Control" VALUE 0xfd0034 /* @ECU_Address@DriveCmd_BrakeDecelCmdOvrEn_val@ */ Scalar_BOOLEAN 0 Toaster_ES1274A_CM_boolean 0 1 /end CHARACTERISTIC
/begin CHARACTERISTIC DriveCmd_GearCmdOvrEn_val "Override Control" VALUE 0xfd0038 /* @ECU_Address@DriveCmd_GearCmdOvrEn_val@ */ Scalar_BOOLEAN 0 Toaster_ES1274A_CM_boolean 0 1 /end CHARACTERISTIC
/begin CHARACTERISTIC EPOOvrCal_val "" VALUE 0xfd003c /* @ECU_Address@EPOOvrCal_val@ */ Scalar_BOOLEAN 0 Toaster_ES1274A_CM_boolean 0 1 /end CHARACTERISTIC
/begin CHARACTERISTIC EPOOvrEn_val "Override Control" VALUE 0xfd003d /* @ECU_Address@EPOOvrEn_val@ */ Scalar_BOOLEAN 0 Toaster_ES1274A_CM_boolean 0 1 /end CHARACTERISTIC
/begin CHARACTERISTIC Enable_BuzzerOnAfterEpoPressed "" VALUE 0xfd003e /* @ECU_Address@Enable_BuzzerOnAfterEpoPressed@ */ Scalar_BOOLEAN 0 Toaster_ES1274A_CM_boolean 0 1 /end CHARACTERISTIC
/begin CHARACTERISTIC FWDOvrCal_val "" VALUE 0xfd003f /* @ECU_Address@FWDOvrCal_val@ */ Scalar_BOOLEAN 0 Toaster_ES1274A_CM_boolean 0 1 /end CHARACTERISTIC
/begin CHARACTERISTIC FWDOvrEn_val "Override Control" VALUE 0xfd0040 /* @ECU_Address@FWDOvrEn_val@ */ Scalar_BOOLEAN 0 Toaster_ES1274A_CM_boolean 0 1 /end CHARACTERISTIC
/begin CHARACTERISTIC F_R_2OvrCal_val "" VALUE 0xfd0041 /* @ECU_Address@F_R_2OvrCal_val@ */ Scalar_BOOLEAN 0 Toaster_ES1274A_CM_boolean 0 1 /end CHARACTERISTIC
/begin CHARACTERISTIC F_R_2OvrEn_val "Override Control" VALUE 0xfd0042 /* @ECU_Address@F_R_2OvrEn_val@ */ Scalar_BOOLEAN 0 Toaster_ES1274A_CM_boolean 0 1 /end CHARACTERISTIC
/begin CHARACTERISTIC LSO03_PIN14OvrCal_val "" VALUE 0xfd0043 /* @ECU_Address@LSO03_PIN14OvrCal_val@ */ Scalar_BOOLEAN 0 Toaster_ES1274A_CM_boolean 0 1 /end CHARACTERISTIC
/begin CHARACTERISTIC LSO03_PIN14OvrEn_val "Override Control" VALUE 0xfd0044 /* @ECU_Address@LSO03_PIN14OvrEn_val@ */ Scalar_BOOLEAN 0 Toaster_ES1274A_CM_boolean 0 1 /end CHARACTERISTIC
/begin CHARACTERISTIC LSO04_PIN45OvrCal_val "" VALUE 0xfd0045 /* @ECU_Address@LSO04_PIN45OvrCal_val@ */ Scalar_BOOLEAN 0 Toaster_ES1274A_CM_boolean 0 1 /end CHARACTERISTIC
/begin CHARACTERISTIC LSO04_PIN45OvrEn_val "Override Control" VALUE 0xfd0046 /* @ECU_Address@LSO04_PIN45OvrEn_val@ */ Scalar_BOOLEAN 0 Toaster_ES1274A_CM_boolean 0 1 /end CHARACTERISTIC
/begin CHARACTERISTIC LSO05_PIN46OvrCal_val "" VALUE 0xfd0047 /* @ECU_Address@LSO05_PIN46OvrCal_val@ */ Scalar_BOOLEAN 0 Toaster_ES1274A_CM_boolean 0 1 /end CHARACTERISTIC
/begin CHARACTERISTIC LSO05_PIN46OvrEn_val "Override Control" VALUE 0xfd0048 /* @ECU_Address@LSO05_PIN46OvrEn_val@ */ Scalar_BOOLEAN 0 Toaster_ES1274A_CM_boolean 0 1 /end CHARACTERISTIC
/begin CHARACTERISTIC LSO06_PIN13OvrCal_val "" VALUE 0xfd0049 /* @ECU_Address@LSO06_PIN13OvrCal_val@ */ Scalar_BOOLEAN 0 Toaster_ES1274A_CM_boolean 0 1 /end CHARACTERISTIC
/begin CHARACTERISTIC LSO06_PIN13OvrEn_val "Override Control" VALUE 0xfd004a /* @ECU_Address@LSO06_PIN13OvrEn_val@ */ Scalar_BOOLEAN 0 Toaster_ES1274A_CM_boolean 0 1 /end CHARACTERISTIC
/begin CHARACTERISTIC LightControl_HighBeamOvrCal_val "" VALUE 0xfd004b /* @ECU_Address@LightControl_HighBeamOvrCal_val@ */ Scalar_BOOLEAN 0 Toaster_ES1274A_CM_boolean 0 1 /end CHARACTERISTIC
/begin CHARACTERISTIC LightControl_HighBeamOvrEn_val "Override Control" VALUE 0xfd004c /* @ECU_Address@LightControl_HighBeamOvrEn_val@ */ Scalar_BOOLEAN 0 Toaster_ES1274A_CM_boolean 0 1 /end CHARACTERISTIC
/begin CHARACTERISTIC LightControl_LowBeamOvrCal_val "" VALUE 0xfd004d /* @ECU_Address@LightControl_LowBeamOvrCal_val@ */ Scalar_BOOLEAN 0 Toaster_ES1274A_CM_boolean 0 1 /end CHARACTERISTIC
/begin CHARACTERISTIC LightControl_LowBeamOvrEn_val "Override Control" VALUE 0xfd004e /* @ECU_Address@LightControl_LowBeamOvrEn_val@ */ Scalar_BOOLEAN 0 Toaster_ES1274A_CM_boolean 0 1 /end CHARACTERISTIC
/begin CHARACTERISTIC MAIN_NOOvrCal_val "" VALUE 0xfd004f /* @ECU_Address@MAIN_NOOvrCal_val@ */ Scalar_BOOLEAN 0 Toaster_ES1274A_CM_boolean 0 1 /end CHARACTERISTIC
/begin CHARACTERISTIC MAIN_NOOvrEn_val "Override Control" VALUE 0xfd0050 /* @ECU_Address@MAIN_NOOvrEn_val@ */ Scalar_BOOLEAN 0 Toaster_ES1274A_CM_boolean 0 1 /end CHARACTERISTIC
/begin CHARACTERISTIC MiscControl_HazardOvrCal_val "" VALUE 0xfd0051 /* @ECU_Address@MiscControl_HazardOvrCal_val@ */ Scalar_BOOLEAN 0 Toaster_ES1274A_CM_boolean 0 1 /end CHARACTERISTIC
/begin CHARACTERISTIC MiscControl_HazardOvrEn_val "Override Control" VALUE 0xfd0052 /* @ECU_Address@MiscControl_HazardOvrEn_val@ */ Scalar_BOOLEAN 0 Toaster_ES1274A_CM_boolean 0 1 /end CHARACTERISTIC
/begin CHARACTERISTIC MiscControl_LeftturnOvrCal_val "" VALUE 0xfd0053 /* @ECU_Address@MiscControl_LeftturnOvrCal_val@ */ Scalar_BOOLEAN 0 Toaster_ES1274A_CM_boolean 0 1 /end CHARACTERISTIC
/begin CHARACTERISTIC MiscControl_LeftturnOvrEn_val "Override Control" VALUE 0xfd0054 /* @ECU_Address@MiscControl_LeftturnOvrEn_val@ */ Scalar_BOOLEAN 0 Toaster_ES1274A_CM_boolean 0 1 /end CHARACTERISTIC
/begin CHARACTERISTIC MiscControl_RightturnOvrCal_val "" VALUE 0xfd0055 /* @ECU_Address@MiscControl_RightturnOvrCal_val@ */ Scalar_BOOLEAN 0 Toaster_ES1274A_CM_boolean 0 1 /end CHARACTERISTIC
/begin CHARACTERISTIC MiscControl_RightturnOvrEn_val "Override Control" VALUE 0xfd0056 /* @ECU_Address@MiscControl_RightturnOvrEn_val@ */ Scalar_BOOLEAN 0 Toaster_ES1274A_CM_boolean 0 1 /end CHARACTERISTIC
/begin CHARACTERISTIC MiscControl_horn_flgOvrCal_val "" VALUE 0xfd0057 /* @ECU_Address@MiscControl_horn_flgOvrCal_val@ */ Scalar_BOOLEAN 0 Toaster_ES1274A_CM_boolean 0 1 /end CHARACTERISTIC
/begin CHARACTERISTIC MiscControl_horn_flgOvrEn_val "Override Control" VALUE 0xfd0058 /* @ECU_Address@MiscControl_horn_flgOvrEn_val@ */ Scalar_BOOLEAN 0 Toaster_ES1274A_CM_boolean 0 1 /end CHARACTERISTIC
/begin CHARACTERISTIC REVOvrCal_val "" VALUE 0xfd0060 /* @ECU_Address@REVOvrCal_val@ */ Scalar_BOOLEAN 0 Toaster_ES1274A_CM_boolean 0 1 /end CHARACTERISTIC
/begin CHARACTERISTIC REVOvrEn_val "Override Control" VALUE 0xfd0061 /* @ECU_Address@REVOvrEn_val@ */ Scalar_BOOLEAN 0 Toaster_ES1274A_CM_boolean 0 1 /end CHARACTERISTIC
/begin CHARACTERISTIC SSC_adcCapableOvrCal_val "" VALUE 0xfd0068 /* @ECU_Address@SSC_adcCapableOvrCal_val@ */ Scalar_BOOLEAN 0 Toaster_ES1274A_CM_boolean 0 1 /end CHARACTERISTIC
/begin CHARACTERISTIC SSC_adcCapableOvrEn_val "Override Control" VALUE 0xfd0069 /* @ECU_Address@SSC_adcCapableOvrEn_val@ */ Scalar_BOOLEAN 0 Toaster_ES1274A_CM_boolean 0 1 /end CHARACTERISTIC
/begin CHARACTERISTIC SSC_canFaultOvrCal_val "" VALUE 0xfd006a /* @ECU_Address@SSC_canFaultOvrCal_val@ */ Scalar_BOOLEAN 0 Toaster_ES1274A_CM_boolean 0 1 /end CHARACTERISTIC
/begin CHARACTERISTIC SSC_canFaultOvrEn_val "Override Control" VALUE 0xfd006b /* @ECU_Address@SSC_canFaultOvrEn_val@ */ Scalar_BOOLEAN 0 Toaster_ES1274A_CM_boolean 0 1 /end CHARACTERISTIC
/begin CHARACTERISTIC SSC_clearOverrideOvrCal_val "" VALUE 0xfd006c /* @ECU_Address@SSC_clearOverrideOvrCal_val@ */ Scalar_BOOLEAN 0 Toaster_ES1274A_CM_boolean 0 1 /end CHARACTERISTIC
/begin CHARACTERISTIC SSC_clearOverrideOvrEn_val "Override Control" VALUE 0xfd006d /* @ECU_Address@SSC_clearOverrideOvrEn_val@ */ Scalar_BOOLEAN 0 Toaster_ES1274A_CM_boolean 0 1 /end CHARACTERISTIC
/begin CHARACTERISTIC SSC_driverActivityOvrCal_val "" VALUE 0xfd006e /* @ECU_Address@SSC_driverActivityOvrCal_val@ */ Scalar_BOOLEAN 0 Toaster_ES1274A_CM_boolean 0 1 /end CHARACTERISTIC
/begin CHARACTERISTIC SSC_driverActivityOvrEn_val "Override Control" VALUE 0xfd006f /* @ECU_Address@SSC_driverActivityOvrEn_val@ */ Scalar_BOOLEAN 0 Toaster_ES1274A_CM_boolean 0 1 /end CHARACTERISTIC
/begin CHARACTERISTIC SSC_driverOverrideByteOvrEn_val "Override Control" VALUE 0xfd0071 /* @ECU_Address@SSC_driverOverrideByteOvrEn_val@ */ Scalar_BOOLEAN 0 Toaster_ES1274A_CM_boolean 0 1 /end CHARACTERISTIC
/begin CHARACTERISTIC SSC_driverOverrideOvrCal_val "" VALUE 0xfd0072 /* @ECU_Address@SSC_driverOverrideOvrCal_val@ */ Scalar_BOOLEAN 0 Toaster_ES1274A_CM_boolean 0 1 /end CHARACTERISTIC
/begin CHARACTERISTIC SSC_driverOverrideOvrEn_val "Override Control" VALUE 0xfd0073 /* @ECU_Address@SSC_driverOverrideOvrEn_val@ */ Scalar_BOOLEAN 0 Toaster_ES1274A_CM_boolean 0 1 /end CHARACTERISTIC
/begin CHARACTERISTIC SSC_faultOverrideByteOvrEn_val "Override Control" VALUE 0xfd0075 /* @ECU_Address@SSC_faultOverrideByteOvrEn_val@ */ Scalar_BOOLEAN 0 Toaster_ES1274A_CM_boolean 0 1 /end CHARACTERISTIC
/begin CHARACTERISTIC SSC_faultOvrCal_val "" VALUE 0xfd0076 /* @ECU_Address@SSC_faultOvrCal_val@ */ Scalar_BOOLEAN 0 Toaster_ES1274A_CM_boolean 0 1 /end CHARACTERISTIC
/begin CHARACTERISTIC SSC_faultOvrEn_val "Override Control" VALUE 0xfd0077 /* @ECU_Address@SSC_faultOvrEn_val@ */ Scalar_BOOLEAN 0 Toaster_ES1274A_CM_boolean 0 1 /end CHARACTERISTIC
/begin CHARACTERISTIC SSC_requestADSEngagedOvrCal_val "" VALUE 0xfd0078 /* @ECU_Address@SSC_requestADSEngagedOvrCal_val@ */ Scalar_BOOLEAN 0 Toaster_ES1274A_CM_boolean 0 1 /end CHARACTERISTIC
/begin CHARACTERISTIC SSC_requestADSEngagedOvrEn_val "Override Control" VALUE 0xfd0079 /* @ECU_Address@SSC_requestADSEngagedOvrEn_val@ */ Scalar_BOOLEAN 0 Toaster_ES1274A_CM_boolean 0 1 /end CHARACTERISTIC
/begin CHARACTERISTIC SSC_subsystemSelectOvrEn_val "Override Control" VALUE 0xfd007b /* @ECU_Address@SSC_subsystemSelectOvrEn_val@ */ Scalar_BOOLEAN 0 Toaster_ES1274A_CM_boolean 0 1 /end CHARACTERISTIC
/begin CHARACTERISTIC SteeringCmd_AngelCmdOvrEn_val "Override Control" VALUE 0xfd0090 /* @ECU_Address@SteeringCmd_AngelCmdOvrEn_val@ */ Scalar_BOOLEAN 0 Toaster_ES1274A_CM_boolean 0 1 /end CHARACTERISTIC
/begin CHARACTERISTIC SteeringCmd_AngelRateCmdOvrEn_val "Override Control" VALUE 0xfd0098 /* @ECU_Address@SteeringCmd_AngelRateCmdOvrEn_val@ */ Scalar_BOOLEAN 0 Toaster_ES1274A_CM_boolean 0 1 /end CHARACTERISTIC
/begin CHARACTERISTIC Veh_7B2ageValidOvrCal_val "" VALUE 0xfd00a0 /* @ECU_Address@Veh_7B2ageValidOvrCal_val@ */ Scalar_BOOLEAN 0 Toaster_ES1274A_CM_boolean 0 1 /end CHARACTERISTIC
/begin CHARACTERISTIC Veh_7B2ageValidOvrEn_val "Override Control" VALUE 0xfd00a1 /* @ECU_Address@Veh_7B2ageValidOvrEn_val@ */ Scalar_BOOLEAN 0 Toaster_ES1274A_CM_boolean 0 1 /end CHARACTERISTIC
/begin CHARACTERISTIC Veh_7BCLF_Wheel_spdOvrEn_val "Override Control" VALUE 0xfd00a8 /* @ECU_Address@Veh_7BCLF_Wheel_spdOvrEn_val@ */ Scalar_BOOLEAN 0 Toaster_ES1274A_CM_boolean 0 1 /end CHARACTERISTIC
/begin CHARACTERISTIC Veh_7BCLR_Wheel_spdOvrEn_val "Override Control" VALUE 0xfd00b0 /* @ECU_Address@Veh_7BCLR_Wheel_spdOvrEn_val@ */ Scalar_BOOLEAN 0 Toaster_ES1274A_CM_boolean 0 1 /end CHARACTERISTIC
/begin CHARACTERISTIC Veh_7BCRF_Wheel_spdOvrEn_val "Override Control" VALUE 0xfd00b8 /* @ECU_Address@Veh_7BCRF_Wheel_spdOvrEn_val@ */ Scalar_BOOLEAN 0 Toaster_ES1274A_CM_boolean 0 1 /end CHARACTERISTIC
/begin CHARACTERISTIC Veh_7BCRR_Wheel_spdOvrEn_val "Override Control" VALUE 0xfd00c0 /* @ECU_Address@Veh_7BCRR_Wheel_spdOvrEn_val@ */ Scalar_BOOLEAN 0 Toaster_ES1274A_CM_boolean 0 1 /end CHARACTERISTIC
/begin CHARACTERISTIC Vehicle7B0AgeValidOvrCal_val "" VALUE 0xfd00c1 /* @ECU_Address@Vehicle7B0AgeValidOvrCal_val@ */ Scalar_BOOLEAN 0 Toaster_ES1274A_CM_boolean 0 1 /end CHARACTERISTIC
/begin CHARACTERISTIC Vehicle7B0AgeValidOvrEn_val "Override Control" VALUE 0xfd00c2 /* @ECU_Address@Vehicle7B0AgeValidOvrEn_val@ */ Scalar_BOOLEAN 0 Toaster_ES1274A_CM_boolean 0 1 /end CHARACTERISTIC
/begin CHARACTERISTIC Vehicle7B1AgeValidOvrCal_val "" VALUE 0xfd00c3 /* @ECU_Address@Vehicle7B1AgeValidOvrCal_val@ */ Scalar_BOOLEAN 0 Toaster_ES1274A_CM_boolean 0 1 /end CHARACTERISTIC
/begin CHARACTERISTIC Vehicle7B1AgeValidOvrEn_val "Override Control" VALUE 0xfd00c4 /* @ECU_Address@Vehicle7B1AgeValidOvrEn_val@ */ Scalar_BOOLEAN 0 Toaster_ES1274A_CM_boolean 0 1 /end CHARACTERISTIC
/begin CHARACTERISTIC Vehicle7B3AgeValidOvrCal_val "" VALUE 0xfd00c5 /* @ECU_Address@Vehicle7B3AgeValidOvrCal_val@ */ Scalar_BOOLEAN 0 Toaster_ES1274A_CM_boolean 0 1 /end CHARACTERISTIC
/begin CHARACTERISTIC Vehicle7B3AgeValidOvrEn_val "Override Control" VALUE 0xfd00c6 /* @ECU_Address@Vehicle7B3AgeValidOvrEn_val@ */ Scalar_BOOLEAN 0 Toaster_ES1274A_CM_boolean 0 1 /end CHARACTERISTIC
/begin CHARACTERISTIC Vehicle7B4AgeValidOvrCal_val "" VALUE 0xfd00c7 /* @ECU_Address@Vehicle7B4AgeValidOvrCal_val@ */ Scalar_BOOLEAN 0 Toaster_ES1274A_CM_boolean 0 1 /end CHARACTERISTIC
/begin CHARACTERISTIC Vehicle7B4AgeValidOvrEn_val "Override Control" VALUE 0xfd00c8 /* @ECU_Address@Vehicle7B4AgeValidOvrEn_val@ */ Scalar_BOOLEAN 0 Toaster_ES1274A_CM_boolean 0 1 /end CHARACTERISTIC
/begin CHARACTERISTIC Vehicle7B5AgeValidOvrCal_val "" VALUE 0xfd00c9 /* @ECU_Address@Vehicle7B5AgeValidOvrCal_val@ */ Scalar_BOOLEAN 0 Toaster_ES1274A_CM_boolean 0 1 /end CHARACTERISTIC
/begin CHARACTERISTIC Vehicle7B5AgeValidOvrEn_val "Override Control" VALUE 0xfd00ca /* @ECU_Address@Vehicle7B5AgeValidOvrEn_val@ */ Scalar_BOOLEAN 0 Toaster_ES1274A_CM_boolean 0 1 /end CHARACTERISTIC
/begin CHARACTERISTIC Vehicle7B9AgeValidOvrCal_val "" VALUE 0xfd00cb /* @ECU_Address@Vehicle7B9AgeValidOvrCal_val@ */ Scalar_BOOLEAN 0 Toaster_ES1274A_CM_boolean 0 1 /end CHARACTERISTIC
/begin CHARACTERISTIC Vehicle7B9AgeValidOvrEn_val "Override Control" VALUE 0xfd00cc /* @ECU_Address@Vehicle7B9AgeValidOvrEn_val@ */ Scalar_BOOLEAN 0 Toaster_ES1274A_CM_boolean 0 1 /end CHARACTERISTIC
/begin CHARACTERISTIC Vehicle7BA_AgeValidOvrCal_val "" VALUE 0xfd00cd /* @ECU_Address@Vehicle7BA_AgeValidOvrCal_val@ */ Scalar_BOOLEAN 0 Toaster_ES1274A_CM_boolean 0 1 /end CHARACTERISTIC
/begin CHARACTERISTIC Vehicle7BA_AgeValidOvrEn_val "Override Control" VALUE 0xfd00ce /* @ECU_Address@Vehicle7BA_AgeValidOvrEn_val@ */ Scalar_BOOLEAN 0 Toaster_ES1274A_CM_boolean 0 1 /end CHARACTERISTIC
/begin CHARACTERISTIC Vehicle7BBAgeValidOvrCal_val "" VALUE 0xfd00cf /* @ECU_Address@Vehicle7BBAgeValidOvrCal_val@ */ Scalar_BOOLEAN 0 Toaster_ES1274A_CM_boolean 0 1 /end CHARACTERISTIC
/begin CHARACTERISTIC Vehicle7BBAgeValidOvrEn_val "Override Control" VALUE 0xfd00d0 /* @ECU_Address@Vehicle7BBAgeValidOvrEn_val@ */ Scalar_BOOLEAN 0 Toaster_ES1274A_CM_boolean 0 1 /end CHARACTERISTIC
/begin CHARACTERISTIC Vehicle7BCAgeValidOvrCal_val "" VALUE 0xfd00d1 /* @ECU_Address@Vehicle7BCAgeValidOvrCal_val@ */ Scalar_BOOLEAN 0 Toaster_ES1274A_CM_boolean 0 1 /end CHARACTERISTIC
/begin CHARACTERISTIC Vehicle7BCAgeValidOvrEn_val "Override Control" VALUE 0xfd00d2 /* @ECU_Address@Vehicle7BCAgeValidOvrEn_val@ */ Scalar_BOOLEAN 0 Toaster_ES1274A_CM_boolean 0 1 /end CHARACTERISTIC
/begin CHARACTERISTIC Vehicle7BEAgeValidOvrCal_val "" VALUE 0xfd00d3 /* @ECU_Address@Vehicle7BEAgeValidOvrCal_val@ */ Scalar_BOOLEAN 0 Toaster_ES1274A_CM_boolean 0 1 /end CHARACTERISTIC
/begin CHARACTERISTIC Vehicle7BEAgeValidOvrEn_val "Override Control" VALUE 0xfd00d4 /* @ECU_Address@Vehicle7BEAgeValidOvrEn_val@ */ Scalar_BOOLEAN 0 Toaster_ES1274A_CM_boolean 0 1 /end CHARACTERISTIC
/begin CHARACTERISTIC Vehicle7BFAgeValidOvrCal_val "" VALUE 0xfd00d5 /* @ECU_Address@Vehicle7BFAgeValidOvrCal_val@ */ Scalar_BOOLEAN 0 Toaster_ES1274A_CM_boolean 0 1 /end CHARACTERISTIC
/begin CHARACTERISTIC Vehicle7BFAgeValidOvrEn_val "Override Control" VALUE 0xfd00d6 /* @ECU_Address@Vehicle7BFAgeValidOvrEn_val@ */ Scalar_BOOLEAN 0 Toaster_ES1274A_CM_boolean 0 1 /end CHARACTERISTIC
/begin CHARACTERISTIC Vehicle7D3AgeValidOvrCal_val "" VALUE 0xfd00d7 /* @ECU_Address@Vehicle7D3AgeValidOvrCal_val@ */ Scalar_BOOLEAN 0 Toaster_ES1274A_CM_boolean 0 1 /end CHARACTERISTIC
/begin CHARACTERISTIC Vehicle7D3AgeValidOvrEn_val "Override Control" VALUE 0xfd00d8 /* @ECU_Address@Vehicle7D3AgeValidOvrEn_val@ */ Scalar_BOOLEAN 0 Toaster_ES1274A_CM_boolean 0 1 /end CHARACTERISTIC
/begin CHARACTERISTIC acceleratorPositionOvrEn_val "Override Control" VALUE 0xfd00e0 /* @ECU_Address@acceleratorPositionOvrEn_val@ */ Scalar_BOOLEAN 0 Toaster_ES1274A_CM_boolean 0 1 /end CHARACTERISTIC
/begin CHARACTERISTIC acceleratorPositionRateOvrEn_val "Override Control" VALUE 0xfd00e8 /* @ECU_Address@acceleratorPositionRateOvrEn_val@ */ Scalar_BOOLEAN 0 Toaster_ES1274A_CM_boolean 0 1 /end CHARACTERISTIC
/begin CHARACTERISTIC accessoryAgeValidOvrCal_val "" VALUE 0xfd00e9 /* @ECU_Address@accessoryAgeValidOvrCal_val@ */ Scalar_BOOLEAN 0 Toaster_ES1274A_CM_boolean 0 1 /end CHARACTERISTIC
/begin CHARACTERISTIC accessoryAgeValidOvrEn_val "Override Control" VALUE 0xfd00ea /* @ECU_Address@accessoryAgeValidOvrEn_val@ */ Scalar_BOOLEAN 0 Toaster_ES1274A_CM_boolean 0 1 /end CHARACTERISTIC
/begin CHARACTERISTIC accessoryCanFaultOvrCal_val "" VALUE 0xfd00eb /* @ECU_Address@accessoryCanFaultOvrCal_val@ */ Scalar_BOOLEAN 0 Toaster_ES1274A_CM_boolean 0 1 /end CHARACTERISTIC
/begin CHARACTERISTIC accessoryCanFaultOvrEn_val "Override Control" VALUE 0xfd00ec /* @ECU_Address@accessoryCanFaultOvrEn_val@ */ Scalar_BOOLEAN 0 Toaster_ES1274A_CM_boolean 0 1 /end CHARACTERISTIC
/begin CHARACTERISTIC accessoryCntValidOvrCal_val "" VALUE 0xfd00ed /* @ECU_Address@accessoryCntValidOvrCal_val@ */ Scalar_BOOLEAN 0 Toaster_ES1274A_CM_boolean 0 1 /end CHARACTERISTIC
/begin CHARACTERISTIC accessoryCntValidOvrEn_val "Override Control" VALUE 0xfd00ee /* @ECU_Address@accessoryCntValidOvrEn_val@ */ Scalar_BOOLEAN 0 Toaster_ES1274A_CM_boolean 0 1 /end CHARACTERISTIC
/begin CHARACTERISTIC accessoryCrcValidOvrCal_val "" VALUE 0xfd00f2 /* @ECU_Address@accessoryCrcValidOvrCal_val@ */ Scalar_BOOLEAN 0 Toaster_ES1274A_CM_boolean 0 1 /end CHARACTERISTIC
/begin CHARACTERISTIC accessoryCrcValidOvrEn_val "Override Control" VALUE 0xfd00f3 /* @ECU_Address@accessoryCrcValidOvrEn_val@ */ Scalar_BOOLEAN 0 Toaster_ES1274A_CM_boolean 0 1 /end CHARACTERISTIC
/begin CHARACTERISTIC accessoryFaultOvrCal_val "" VALUE 0xfd00f4 /* @ECU_Address@accessoryFaultOvrCal_val@ */ Scalar_BOOLEAN 0 Toaster_ES1274A_CM_boolean 0 1 /end CHARACTERISTIC
/begin CHARACTERISTIC accessoryFaultOvrEn_val "Override Control" VALUE 0xfd00f5 /* @ECU_Address@accessoryFaultOvrEn_val@ */ Scalar_BOOLEAN 0 Toaster_ES1274A_CM_boolean 0 1 /end CHARACTERISTIC
/begin CHARACTERISTIC adcCapableOvrCal_val "" VALUE 0xfd00f6 /* @ECU_Address@adcCapableOvrCal_val@ */ Scalar_BOOLEAN 0 Toaster_ES1274A_CM_boolean 0 1 /end CHARACTERISTIC
/begin CHARACTERISTIC adcCapableOvrEn_val "Override Control" VALUE 0xfd00f7 /* @ECU_Address@adcCapableOvrEn_val@ */ Scalar_BOOLEAN 0 Toaster_ES1274A_CM_boolean 0 1 /end CHARACTERISTIC
/begin CHARACTERISTIC brakeAgeValidOvrCal_val "" VALUE 0xfd00f8 /* @ECU_Address@brakeAgeValidOvrCal_val@ */ Scalar_BOOLEAN 0 Toaster_ES1274A_CM_boolean 0 1 /end CHARACTERISTIC
/begin CHARACTERISTIC brakeAgeValidOvrEn_val "Override Control" VALUE 0xfd00f9 /* @ECU_Address@brakeAgeValidOvrEn_val@ */ Scalar_BOOLEAN 0 Toaster_ES1274A_CM_boolean 0 1 /end CHARACTERISTIC
/begin CHARACTERISTIC brakeCanFaultOvrCal_val "" VALUE 0xfd00fa /* @ECU_Address@brakeCanFaultOvrCal_val@ */ Scalar_BOOLEAN 0 Toaster_ES1274A_CM_boolean 0 1 /end CHARACTERISTIC
/begin CHARACTERISTIC brakeCanFaultOvrEn_val "Override Control" VALUE 0xfd00fb /* @ECU_Address@brakeCanFaultOvrEn_val@ */ Scalar_BOOLEAN 0 Toaster_ES1274A_CM_boolean 0 1 /end CHARACTERISTIC
/begin CHARACTERISTIC brakeCntValidOvrCal_val "" VALUE 0xfd00fc /* @ECU_Address@brakeCntValidOvrCal_val@ */ Scalar_BOOLEAN 0 Toaster_ES1274A_CM_boolean 0 1 /end CHARACTERISTIC
/begin CHARACTERISTIC brakeCntValidOvrEn_val "Override Control" VALUE 0xfd00fd /* @ECU_Address@brakeCntValidOvrEn_val@ */ Scalar_BOOLEAN 0 Toaster_ES1274A_CM_boolean 0 1 /end CHARACTERISTIC
/begin CHARACTERISTIC brakeCrcValidOvrCal_val "" VALUE 0xfd0100 /* @ECU_Address@brakeCrcValidOvrCal_val@ */ Scalar_BOOLEAN 0 Toaster_ES1274A_CM_boolean 0 1 /end CHARACTERISTIC
/begin CHARACTERISTIC brakeCrcValidOvrEn_val "Override Control" VALUE 0xfd0101 /* @ECU_Address@brakeCrcValidOvrEn_val@ */ Scalar_BOOLEAN 0 Toaster_ES1274A_CM_boolean 0 1 /end CHARACTERISTIC
/begin CHARACTERISTIC brakeDriverActivityOvrCal_val "" VALUE 0xfd0102 /* @ECU_Address@brakeDriverActivityOvrCal_val@ */ Scalar_BOOLEAN 0 Toaster_ES1274A_CM_boolean 0 1 /end CHARACTERISTIC
/begin CHARACTERISTIC brakeDriverActivityOvrEn_val "Override Control" VALUE 0xfd0103 /* @ECU_Address@brakeDriverActivityOvrEn_val@ */ Scalar_BOOLEAN 0 Toaster_ES1274A_CM_boolean 0 1 /end CHARACTERISTIC
/begin CHARACTERISTIC brakeDriverOverride_CANOvrCal_val "" VALUE 0xfd0104 /* @ECU_Address@brakeDriverOverride_CANOvrCal_val@ */ Scalar_BOOLEAN 0 Toaster_ES1274A_CM_boolean 0 1 /end CHARACTERISTIC
/begin CHARACTERISTIC brakeDriverOverride_CANOvrEn_val "Override Control" VALUE 0xfd0105 /* @ECU_Address@brakeDriverOverride_CANOvrEn_val@ */ Scalar_BOOLEAN 0 Toaster_ES1274A_CM_boolean 0 1 /end CHARACTERISTIC
/begin CHARACTERISTIC brakeDriverOverride_PedalOvrCal_val "" VALUE 0xfd0106 /* @ECU_Address@brakeDriverOverride_PedalOvrCal_val@ */ Scalar_BOOLEAN 0 Toaster_ES1274A_CM_boolean 0 1 /end CHARACTERISTIC
/begin CHARACTERISTIC brakeDriverOverride_PedalOvrEn_val "Override Control" VALUE 0xfd0107 /* @ECU_Address@brakeDriverOverride_PedalOvrEn_val@ */ Scalar_BOOLEAN 0 Toaster_ES1274A_CM_boolean 0 1 /end CHARACTERISTIC
/begin CHARACTERISTIC brakeFaultOvrCal_val "" VALUE 0xfd0108 /* @ECU_Address@brakeFaultOvrCal_val@ */ Scalar_BOOLEAN 0 Toaster_ES1274A_CM_boolean 0 1 /end CHARACTERISTIC
/begin CHARACTERISTIC brakeFaultOvrEn_val "Override Control" VALUE 0xfd0109 /* @ECU_Address@brakeFaultOvrEn_val@ */ Scalar_BOOLEAN 0 Toaster_ES1274A_CM_boolean 0 1 /end CHARACTERISTIC
/begin CHARACTERISTIC brakePedalPositionOvrEn_val "Override Control" VALUE 0xfd0120 /* @ECU_Address@brakePedalPositionOvrEn_val@ */ Scalar_BOOLEAN 0 Toaster_ES1274A_CM_boolean 0 1 /end CHARACTERISTIC
/begin CHARACTERISTIC button_debouncedOvrCal_val "" VALUE 0xfd0128 /* @ECU_Address@button_debouncedOvrCal_val@ */ Scalar_BOOLEAN 0 Toaster_ES1274A_CM_boolean 0 1 /end CHARACTERISTIC
/begin CHARACTERISTIC button_debouncedOvrEn_val "Override Control" VALUE 0xfd0129 /* @ECU_Address@button_debouncedOvrEn_val@ */ Scalar_BOOLEAN 0 Toaster_ES1274A_CM_boolean 0 1 /end CHARACTERISTIC
/begin CHARACTERISTIC button_inputOvrCal_val "" VALUE 0xfd012a /* @ECU_Address@button_inputOvrCal_val@ */ Scalar_BOOLEAN 0 Toaster_ES1274A_CM_boolean 0 1 /end CHARACTERISTIC
/begin CHARACTERISTIC button_inputOvrEn_val "Override Control" VALUE 0xfd012b /* @ECU_Address@button_inputOvrEn_val@ */ Scalar_BOOLEAN 0 Toaster_ES1274A_CM_boolean 0 1 /end CHARACTERISTIC
/begin CHARACTERISTIC buzzerOvrCal_val "" VALUE 0xfd012c /* @ECU_Address@buzzerOvrCal_val@ */ Scalar_BOOLEAN 0 Toaster_ES1274A_CM_boolean 0 1 /end CHARACTERISTIC
/begin CHARACTERISTIC buzzerOvrEn_val "Override Control" VALUE 0xfd012d /* @ECU_Address@buzzerOvrEn_val@ */ Scalar_BOOLEAN 0 Toaster_ES1274A_CM_boolean 0 1 /end CHARACTERISTIC
/begin CHARACTERISTIC cmd_EPB_45OvrEn_val "Override Control" VALUE 0xfd012f /* @ECU_Address@cmd_EPB_45OvrEn_val@ */ Scalar_BOOLEAN 0 Toaster_ES1274A_CM_boolean 0 1 /end CHARACTERISTIC
/begin CHARACTERISTIC cmd_brakeLightsOvrCal_val "" VALUE 0xfd0130 /* @ECU_Address@cmd_brakeLightsOvrCal_val@ */ Scalar_BOOLEAN 0 Toaster_ES1274A_CM_boolean 0 1 /end CHARACTERISTIC
/begin CHARACTERISTIC cmd_brakeLightsOvrEn_val "Override Control" VALUE 0xfd0131 /* @ECU_Address@cmd_brakeLightsOvrEn_val@ */ Scalar_BOOLEAN 0 Toaster_ES1274A_CM_boolean 0 1 /end CHARACTERISTIC
/begin CHARACTERISTIC cmd_brakePedalPositionOvrEn_val "Override Control" VALUE 0xfd0138 /* @ECU_Address@cmd_brakePedalPositionOvrEn_val@ */ Scalar_BOOLEAN 0 Toaster_ES1274A_CM_boolean 0 1 /end CHARACTERISTIC
/begin CHARACTERISTIC cmd_brakePedalPositionRateOvrEn_val "Override Control" VALUE 0xfd0140 /* @ECU_Address@cmd_brakePedalPositionRateOvrEn_val@ */ Scalar_BOOLEAN 0 Toaster_ES1274A_CM_boolean 0 1 /end CHARACTERISTIC
/begin CHARACTERISTIC commandedGearOvrEn_val "Override Control" VALUE 0xfd0142 /* @ECU_Address@commandedGearOvrEn_val@ */ Scalar_BOOLEAN 0 Toaster_ES1274A_CM_boolean 0 1 /end CHARACTERISTIC
/begin CHARACTERISTIC drivingLightsOvrEn_val "Override Control" VALUE 0xfd0144 /* @ECU_Address@drivingLightsOvrEn_val@ */ Scalar_BOOLEAN 0 Toaster_ES1274A_CM_boolean 0 1 /end CHARACTERISTIC
/begin CHARACTERISTIC engaged_engagedOvrCal_val "" VALUE 0xfd0145 /* @ECU_Address@engaged_engagedOvrCal_val@ */ Scalar_BOOLEAN 0 Toaster_ES1274A_CM_boolean 0 1 /end CHARACTERISTIC
/begin CHARACTERISTIC engaged_engagedOvrEn_val "Override Control" VALUE 0xfd0146 /* @ECU_Address@engaged_engagedOvrEn_val@ */ Scalar_BOOLEAN 0 Toaster_ES1274A_CM_boolean 0 1 /end CHARACTERISTIC
/begin CHARACTERISTIC gearOvrEn_val "Override Control" VALUE 0xfd0148 /* @ECU_Address@gearOvrEn_val@ */ Scalar_BOOLEAN 0 Toaster_ES1274A_CM_boolean 0 1 /end CHARACTERISTIC
/begin CHARACTERISTIC greenLEDDutyOvrEn_val "Override Control" VALUE 0xfd0150 /* @ECU_Address@greenLEDDutyOvrEn_val@ */ Scalar_BOOLEAN 0 Toaster_ES1274A_CM_boolean 0 1 /end CHARACTERISTIC
/begin CHARACTERISTIC greenLEDEnableOvrCal_val "" VALUE 0xfd0151 /* @ECU_Address@greenLEDEnableOvrCal_val@ */ Scalar_BOOLEAN 0 Toaster_ES1274A_CM_boolean 0 1 /end CHARACTERISTIC
/begin CHARACTERISTIC greenLEDEnableOvrEn_val "Override Control" VALUE 0xfd0152 /* @ECU_Address@greenLEDEnableOvrEn_val@ */ Scalar_BOOLEAN 0 Toaster_ES1274A_CM_boolean 0 1 /end CHARACTERISTIC
/begin CHARACTERISTIC greenLEDFreqOvrEn_val "Override Control" VALUE 0xfd0158 /* @ECU_Address@greenLEDFreqOvrEn_val@ */ Scalar_BOOLEAN 0 Toaster_ES1274A_CM_boolean 0 1 /end CHARACTERISTIC
/begin CHARACTERISTIC redLEDDutyOvrEn_val "Override Control" VALUE 0xfd0160 /* @ECU_Address@redLEDDutyOvrEn_val@ */ Scalar_BOOLEAN 0 Toaster_ES1274A_CM_boolean 0 1 /end CHARACTERISTIC
/begin CHARACTERISTIC redLEDEnableOvrCal_val "" VALUE 0xfd0161 /* @ECU_Address@redLEDEnableOvrCal_val@ */ Scalar_BOOLEAN 0 Toaster_ES1274A_CM_boolean 0 1 /end CHARACTERISTIC
/begin CHARACTERISTIC redLEDEnableOvrEn_val "Override Control" VALUE 0xfd0162 /* @ECU_Address@redLEDEnableOvrEn_val@ */ Scalar_BOOLEAN 0 Toaster_ES1274A_CM_boolean 0 1 /end CHARACTERISTIC
/begin CHARACTERISTIC redLEDFreqOvrEn_val "Override Control" VALUE 0xfd0168 /* @ECU_Address@redLEDFreqOvrEn_val@ */ Scalar_BOOLEAN 0 Toaster_ES1274A_CM_boolean 0 1 /end CHARACTERISTIC
/begin CHARACTERISTIC selectAccessoryOvrCal_val "" VALUE 0xfd0169 /* @ECU_Address@selectAccessoryOvrCal_val@ */ Scalar_BOOLEAN 0 Toaster_ES1274A_CM_boolean 0 1 /end CHARACTERISTIC
/begin CHARACTERISTIC selectAccessoryOvrEn_val "Override Control" VALUE 0xfd016a /* @ECU_Address@selectAccessoryOvrEn_val@ */ Scalar_BOOLEAN 0 Toaster_ES1274A_CM_boolean 0 1 /end CHARACTERISTIC
/begin CHARACTERISTIC selectBrakeOvrCal_val "" VALUE 0xfd016b /* @ECU_Address@selectBrakeOvrCal_val@ */ Scalar_BOOLEAN 0 Toaster_ES1274A_CM_boolean 0 1 /end CHARACTERISTIC
/begin CHARACTERISTIC selectBrakeOvrEn_val "Override Control" VALUE 0xfd016c /* @ECU_Address@selectBrakeOvrEn_val@ */ Scalar_BOOLEAN 0 Toaster_ES1274A_CM_boolean 0 1 /end CHARACTERISTIC
/begin CHARACTERISTIC selectShiftOvrCal_val "" VALUE 0xfd016d /* @ECU_Address@selectShiftOvrCal_val@ */ Scalar_BOOLEAN 0 Toaster_ES1274A_CM_boolean 0 1 /end CHARACTERISTIC
/begin CHARACTERISTIC selectShiftOvrEn_val "Override Control" VALUE 0xfd016e /* @ECU_Address@selectShiftOvrEn_val@ */ Scalar_BOOLEAN 0 Toaster_ES1274A_CM_boolean 0 1 /end CHARACTERISTIC
/begin CHARACTERISTIC selectSteerOvrCal_val "" VALUE 0xfd016f /* @ECU_Address@selectSteerOvrCal_val@ */ Scalar_BOOLEAN 0 Toaster_ES1274A_CM_boolean 0 1 /end CHARACTERISTIC
/begin CHARACTERISTIC selectSteerOvrEn_val "Override Control" VALUE 0xfd0170 /* @ECU_Address@selectSteerOvrEn_val@ */ Scalar_BOOLEAN 0 Toaster_ES1274A_CM_boolean 0 1 /end CHARACTERISTIC
/begin CHARACTERISTIC selectThrottleOvrCal_val "" VALUE 0xfd0171 /* @ECU_Address@selectThrottleOvrCal_val@ */ Scalar_BOOLEAN 0 Toaster_ES1274A_CM_boolean 0 1 /end CHARACTERISTIC
/begin CHARACTERISTIC selectThrottleOvrEn_val "Override Control" VALUE 0xfd0172 /* @ECU_Address@selectThrottleOvrEn_val@ */ Scalar_BOOLEAN 0 Toaster_ES1274A_CM_boolean 0 1 /end CHARACTERISTIC
/begin CHARACTERISTIC shiftAgeValidOvrCal_val "" VALUE 0xfd0173 /* @ECU_Address@shiftAgeValidOvrCal_val@ */ Scalar_BOOLEAN 0 Toaster_ES1274A_CM_boolean 0 1 /end CHARACTERISTIC
/begin CHARACTERISTIC shiftAgeValidOvrEn_val "Override Control" VALUE 0xfd0174 /* @ECU_Address@shiftAgeValidOvrEn_val@ */ Scalar_BOOLEAN 0 Toaster_ES1274A_CM_boolean 0 1 /end CHARACTERISTIC
/begin CHARACTERISTIC shiftCanFaultOvrCal_val "" VALUE 0xfd0175 /* @ECU_Address@shiftCanFaultOvrCal_val@ */ Scalar_BOOLEAN 0 Toaster_ES1274A_CM_boolean 0 1 /end CHARACTERISTIC
/begin CHARACTERISTIC shiftCanFaultOvrEn_val "Override Control" VALUE 0xfd0176 /* @ECU_Address@shiftCanFaultOvrEn_val@ */ Scalar_BOOLEAN 0 Toaster_ES1274A_CM_boolean 0 1 /end CHARACTERISTIC
/begin CHARACTERISTIC shiftCntValidOvrCal_val "" VALUE 0xfd0177 /* @ECU_Address@shiftCntValidOvrCal_val@ */ Scalar_BOOLEAN 0 Toaster_ES1274A_CM_boolean 0 1 /end CHARACTERISTIC
/begin CHARACTERISTIC shiftCntValidOvrEn_val "Override Control" VALUE 0xfd0178 /* @ECU_Address@shiftCntValidOvrEn_val@ */ Scalar_BOOLEAN 0 Toaster_ES1274A_CM_boolean 0 1 /end CHARACTERISTIC
/begin CHARACTERISTIC shiftCrcValidOvrCal_val "" VALUE 0xfd017c /* @ECU_Address@shiftCrcValidOvrCal_val@ */ Scalar_BOOLEAN 0 Toaster_ES1274A_CM_boolean 0 1 /end CHARACTERISTIC
/begin CHARACTERISTIC shiftCrcValidOvrEn_val "Override Control" VALUE 0xfd017d /* @ECU_Address@shiftCrcValidOvrEn_val@ */ Scalar_BOOLEAN 0 Toaster_ES1274A_CM_boolean 0 1 /end CHARACTERISTIC
/begin CHARACTERISTIC shiftFaultOvrCal_val "" VALUE 0xfd017e /* @ECU_Address@shiftFaultOvrCal_val@ */ Scalar_BOOLEAN 0 Toaster_ES1274A_CM_boolean 0 1 /end CHARACTERISTIC
/begin CHARACTERISTIC shiftFaultOvrEn_val "Override Control" VALUE 0xfd017f /* @ECU_Address@shiftFaultOvrEn_val@ */ Scalar_BOOLEAN 0 Toaster_ES1274A_CM_boolean 0 1 /end CHARACTERISTIC
/begin CHARACTERISTIC steerAgeValidOvrCal_val "" VALUE 0xfd0180 /* @ECU_Address@steerAgeValidOvrCal_val@ */ Scalar_BOOLEAN 0 Toaster_ES1274A_CM_boolean 0 1 /end CHARACTERISTIC
/begin CHARACTERISTIC steerAgeValidOvrEn_val "Override Control" VALUE 0xfd0181 /* @ECU_Address@steerAgeValidOvrEn_val@ */ Scalar_BOOLEAN 0 Toaster_ES1274A_CM_boolean 0 1 /end CHARACTERISTIC
/begin CHARACTERISTIC steerCanFaultOvrCal_val "" VALUE 0xfd0182 /* @ECU_Address@steerCanFaultOvrCal_val@ */ Scalar_BOOLEAN 0 Toaster_ES1274A_CM_boolean 0 1 /end CHARACTERISTIC
/begin CHARACTERISTIC steerCanFaultOvrEn_val "Override Control" VALUE 0xfd0183 /* @ECU_Address@steerCanFaultOvrEn_val@ */ Scalar_BOOLEAN 0 Toaster_ES1274A_CM_boolean 0 1 /end CHARACTERISTIC
/begin CHARACTERISTIC steerCntValidOvrCal_val "" VALUE 0xfd0184 /* @ECU_Address@steerCntValidOvrCal_val@ */ Scalar_BOOLEAN 0 Toaster_ES1274A_CM_boolean 0 1 /end CHARACTERISTIC
/begin CHARACTERISTIC steerCntValidOvrEn_val "Override Control" VALUE 0xfd0185 /* @ECU_Address@steerCntValidOvrEn_val@ */ Scalar_BOOLEAN 0 Toaster_ES1274A_CM_boolean 0 1 /end CHARACTERISTIC
/begin CHARACTERISTIC steerCrcValidOvrCal_val "" VALUE 0xfd0188 /* @ECU_Address@steerCrcValidOvrCal_val@ */ Scalar_BOOLEAN 0 Toaster_ES1274A_CM_boolean 0 1 /end CHARACTERISTIC
/begin CHARACTERISTIC steerCrcValidOvrEn_val "Override Control" VALUE 0xfd0189 /* @ECU_Address@steerCrcValidOvrEn_val@ */ Scalar_BOOLEAN 0 Toaster_ES1274A_CM_boolean 0 1 /end CHARACTERISTIC
/begin CHARACTERISTIC steerDriverOverrideOvrCal_val "" VALUE 0xfd018a /* @ECU_Address@steerDriverOverrideOvrCal_val@ */ Scalar_BOOLEAN 0 Toaster_ES1274A_CM_boolean 0 1 /end CHARACTERISTIC
/begin CHARACTERISTIC steerDriverOverrideOvrEn_val "Override Control" VALUE 0xfd018b /* @ECU_Address@steerDriverOverrideOvrEn_val@ */ Scalar_BOOLEAN 0 Toaster_ES1274A_CM_boolean 0 1 /end CHARACTERISTIC
/begin CHARACTERISTIC steerEngagedOvrCal_val "" VALUE 0xfd018c /* @ECU_Address@steerEngagedOvrCal_val@ */ Scalar_BOOLEAN 0 Toaster_ES1274A_CM_boolean 0 1 /end CHARACTERISTIC
/begin CHARACTERISTIC steerEngagedOvrEn_val "Override Control" VALUE 0xfd018d /* @ECU_Address@steerEngagedOvrEn_val@ */ Scalar_BOOLEAN 0 Toaster_ES1274A_CM_boolean 0 1 /end CHARACTERISTIC
/begin CHARACTERISTIC steerFaultOvrCal_val "" VALUE 0xfd018e /* @ECU_Address@steerFaultOvrCal_val@ */ Scalar_BOOLEAN 0 Toaster_ES1274A_CM_boolean 0 1 /end CHARACTERISTIC
/begin CHARACTERISTIC steerFaultOvrEn_val "Override Control" VALUE 0xfd018f /* @ECU_Address@steerFaultOvrEn_val@ */ Scalar_BOOLEAN 0 Toaster_ES1274A_CM_boolean 0 1 /end CHARACTERISTIC
/begin CHARACTERISTIC steeringWheelAngleCommand_DegOvrEn_val "Override Control" VALUE 0xfd0194 /* @ECU_Address@steeringWheelAngleCommand_DegOvrEn_val@ */ Scalar_BOOLEAN 0 Toaster_ES1274A_CM_boolean 0 1 /end CHARACTERISTIC
/begin CHARACTERISTIC steeringWheelAngleRateCommandOvrEn_val "Override Control" VALUE 0xfd019c /* @ECU_Address@steeringWheelAngleRateCommandOvrEn_val@ */ Scalar_BOOLEAN 0 Toaster_ES1274A_CM_boolean 0 1 /end CHARACTERISTIC
/begin CHARACTERISTIC steeringWheelAngleRateSetpointOvrEn_val "Override Control" VALUE 0xfd01a4 /* @ECU_Address@steeringWheelAngleRateSetpointOvrEn_val@ */ Scalar_BOOLEAN 0 Toaster_ES1274A_CM_boolean 0 1 /end CHARACTERISTIC
/begin CHARACTERISTIC steeringWheelAngleSetpoint_DegOvrEn_val "Override Control" VALUE 0xfd01ac /* @ECU_Address@steeringWheelAngleSetpoint_DegOvrEn_val@ */ Scalar_BOOLEAN 0 Toaster_ES1274A_CM_boolean 0 1 /end CHARACTERISTIC
/begin CHARACTERISTIC steeringWheelAngle_rawOvrEn_val "Override Control" VALUE 0xfd01b0 /* @ECU_Address@steeringWheelAngle_rawOvrEn_val@ */ Scalar_BOOLEAN 0 Toaster_ES1274A_CM_boolean 0 1 /end CHARACTERISTIC
/begin CHARACTERISTIC steering_feedback_eps_statusOvrEn_val "Override Control" VALUE 0xfd01bc /* @ECU_Address@steering_feedback_eps_statusOvrEn_val@ */ Scalar_BOOLEAN 0 Toaster_ES1274A_CM_boolean 0 1 /end CHARACTERISTIC
/begin CHARACTERISTIC subsystemSelectOvrEn_val "Override Control" VALUE 0xfd01be /* @ECU_Address@subsystemSelectOvrEn_val@ */ Scalar_BOOLEAN 0 Toaster_ES1274A_CM_boolean 0 1 /end CHARACTERISTIC
/begin CHARACTERISTIC systemAgeOvrEn_val "Override Control" VALUE 0xfd01c4 /* @ECU_Address@systemAgeOvrEn_val@ */ Scalar_BOOLEAN 0 Toaster_ES1274A_CM_boolean 0 1 /end CHARACTERISTIC
/begin CHARACTERISTIC systemAgeValidOvrEn_val "Override Control" VALUE 0xfd01cc /* @ECU_Address@systemAgeValidOvrEn_val@ */ Scalar_BOOLEAN 0 Toaster_ES1274A_CM_boolean 0 1 /end CHARACTERISTIC
/begin CHARACTERISTIC systemCanFaultOvrCal_val "" VALUE 0xfd01cd /* @ECU_Address@systemCanFaultOvrCal_val@ */ Scalar_BOOLEAN 0 Toaster_ES1274A_CM_boolean 0 1 /end CHARACTERISTIC
/begin CHARACTERISTIC systemCanFaultOvrEn_val "Override Control" VALUE 0xfd01ce /* @ECU_Address@systemCanFaultOvrEn_val@ */ Scalar_BOOLEAN 0 Toaster_ES1274A_CM_boolean 0 1 /end CHARACTERISTIC
/begin CHARACTERISTIC systemClearOverrideOvrCal_val "" VALUE 0xfd01cf /* @ECU_Address@systemClearOverrideOvrCal_val@ */ Scalar_BOOLEAN 0 Toaster_ES1274A_CM_boolean 0 1 /end CHARACTERISTIC
/begin CHARACTERISTIC systemClearOverrideOvrEn_val "Override Control" VALUE 0xfd01d0 /* @ECU_Address@systemClearOverrideOvrEn_val@ */ Scalar_BOOLEAN 0 Toaster_ES1274A_CM_boolean 0 1 /end CHARACTERISTIC
/begin CHARACTERISTIC systemCntValidOvrCal_val "" VALUE 0xfd01d1 /* @ECU_Address@systemCntValidOvrCal_val@ */ Scalar_BOOLEAN 0 Toaster_ES1274A_CM_boolean 0 1 /end CHARACTERISTIC
/begin CHARACTERISTIC systemCntValidOvrEn_val "Override Control" VALUE 0xfd01d2 /* @ECU_Address@systemCntValidOvrEn_val@ */ Scalar_BOOLEAN 0 Toaster_ES1274A_CM_boolean 0 1 /end CHARACTERISTIC
/begin CHARACTERISTIC systemCrcValidOvrCal_val "" VALUE 0xfd01d6 /* @ECU_Address@systemCrcValidOvrCal_val@ */ Scalar_BOOLEAN 0 Toaster_ES1274A_CM_boolean 0 1 /end CHARACTERISTIC
/begin CHARACTERISTIC systemCrcValidOvrEn_val "Override Control" VALUE 0xfd01d7 /* @ECU_Address@systemCrcValidOvrEn_val@ */ Scalar_BOOLEAN 0 Toaster_ES1274A_CM_boolean 0 1 /end CHARACTERISTIC
/begin CHARACTERISTIC systemFaultOvrCal_val "" VALUE 0xfd01d8 /* @ECU_Address@systemFaultOvrCal_val@ */ Scalar_BOOLEAN 0 Toaster_ES1274A_CM_boolean 0 1 /end CHARACTERISTIC
/begin CHARACTERISTIC systemFaultOvrEn_val "Override Control" VALUE 0xfd01d9 /* @ECU_Address@systemFaultOvrEn_val@ */ Scalar_BOOLEAN 0 Toaster_ES1274A_CM_boolean 0 1 /end CHARACTERISTIC
/begin CHARACTERISTIC systemRequestADSEngagedOvrCal_val "" VALUE 0xfd01da /* @ECU_Address@systemRequestADSEngagedOvrCal_val@ */ Scalar_BOOLEAN 0 Toaster_ES1274A_CM_boolean 0 1 /end CHARACTERISTIC
/begin CHARACTERISTIC systemRequestADSEngagedOvrEn_val "Override Control" VALUE 0xfd01db /* @ECU_Address@systemRequestADSEngagedOvrEn_val@ */ Scalar_BOOLEAN 0 Toaster_ES1274A_CM_boolean 0 1 /end CHARACTERISTIC
/begin CHARACTERISTIC testShiftEngagedOvrCal_val "" VALUE 0xfd01dc /* @ECU_Address@testShiftEngagedOvrCal_val@ */ Scalar_BOOLEAN 0 Toaster_ES1274A_CM_boolean 0 1 /end CHARACTERISTIC
/begin CHARACTERISTIC testShiftEngagedOvrEn_val "Override Control" VALUE 0xfd01dd /* @ECU_Address@testShiftEngagedOvrEn_val@ */ Scalar_BOOLEAN 0 Toaster_ES1274A_CM_boolean 0 1 /end CHARACTERISTIC
/begin CHARACTERISTIC throttleAgeValidOvrCal_val "" VALUE 0xfd01de /* @ECU_Address@throttleAgeValidOvrCal_val@ */ Scalar_BOOLEAN 0 Toaster_ES1274A_CM_boolean 0 1 /end CHARACTERISTIC
/begin CHARACTERISTIC throttleAgeValidOvrEn_val "Override Control" VALUE 0xfd01df /* @ECU_Address@throttleAgeValidOvrEn_val@ */ Scalar_BOOLEAN 0 Toaster_ES1274A_CM_boolean 0 1 /end CHARACTERISTIC
/begin CHARACTERISTIC throttleCanFaultOvrCal_val "" VALUE 0xfd01e0 /* @ECU_Address@throttleCanFaultOvrCal_val@ */ Scalar_BOOLEAN 0 Toaster_ES1274A_CM_boolean 0 1 /end CHARACTERISTIC
/begin CHARACTERISTIC throttleCanFaultOvrEn_val "Override Control" VALUE 0xfd01e1 /* @ECU_Address@throttleCanFaultOvrEn_val@ */ Scalar_BOOLEAN 0 Toaster_ES1274A_CM_boolean 0 1 /end CHARACTERISTIC
/begin CHARACTERISTIC throttleCntValidOvrCal_val "" VALUE 0xfd01e2 /* @ECU_Address@throttleCntValidOvrCal_val@ */ Scalar_BOOLEAN 0 Toaster_ES1274A_CM_boolean 0 1 /end CHARACTERISTIC
/begin CHARACTERISTIC throttleCntValidOvrEn_val "Override Control" VALUE 0xfd01e3 /* @ECU_Address@throttleCntValidOvrEn_val@ */ Scalar_BOOLEAN 0 Toaster_ES1274A_CM_boolean 0 1 /end CHARACTERISTIC
/begin CHARACTERISTIC throttleCrcValidOvrCal_val "" VALUE 0xfd01e6 /* @ECU_Address@throttleCrcValidOvrCal_val@ */ Scalar_BOOLEAN 0 Toaster_ES1274A_CM_boolean 0 1 /end CHARACTERISTIC
/begin CHARACTERISTIC throttleCrcValidOvrEn_val "Override Control" VALUE 0xfd01e7 /* @ECU_Address@throttleCrcValidOvrEn_val@ */ Scalar_BOOLEAN 0 Toaster_ES1274A_CM_boolean 0 1 /end CHARACTERISTIC
/begin CHARACTERISTIC throttleDriverActivityOvrCal_val "" VALUE 0xfd01e8 /* @ECU_Address@throttleDriverActivityOvrCal_val@ */ Scalar_BOOLEAN 0 Toaster_ES1274A_CM_boolean 0 1 /end CHARACTERISTIC
/begin CHARACTERISTIC throttleDriverActivityOvrEn_val "Override Control" VALUE 0xfd01e9 /* @ECU_Address@throttleDriverActivityOvrEn_val@ */ Scalar_BOOLEAN 0 Toaster_ES1274A_CM_boolean 0 1 /end CHARACTERISTIC
/begin CHARACTERISTIC throttleDriverOverride_CANOvrCal_val "" VALUE 0xfd01ea /* @ECU_Address@throttleDriverOverride_CANOvrCal_val@ */ Scalar_BOOLEAN 0 Toaster_ES1274A_CM_boolean 0 1 /end CHARACTERISTIC
/begin CHARACTERISTIC throttleDriverOverride_CANOvrEn_val "Override Control" VALUE 0xfd01eb /* @ECU_Address@throttleDriverOverride_CANOvrEn_val@ */ Scalar_BOOLEAN 0 Toaster_ES1274A_CM_boolean 0 1 /end CHARACTERISTIC
/begin CHARACTERISTIC throttleDriverOverride_PedalOvrCal_val "" VALUE 0xfd01ec /* @ECU_Address@throttleDriverOverride_PedalOvrCal_val@ */ Scalar_BOOLEAN 0 Toaster_ES1274A_CM_boolean 0 1 /end CHARACTERISTIC
/begin CHARACTERISTIC throttleDriverOverride_PedalOvrEn_val "Override Control" VALUE 0xfd01ed /* @ECU_Address@throttleDriverOverride_PedalOvrEn_val@ */ Scalar_BOOLEAN 0 Toaster_ES1274A_CM_boolean 0 1 /end CHARACTERISTIC
/begin CHARACTERISTIC throttleFaultOvrCal_val "" VALUE 0xfd01ee /* @ECU_Address@throttleFaultOvrCal_val@ */ Scalar_BOOLEAN 0 Toaster_ES1274A_CM_boolean 0 1 /end CHARACTERISTIC
/begin CHARACTERISTIC throttleFaultOvrEn_val "Override Control" VALUE 0xfd01ef /* @ECU_Address@throttleFaultOvrEn_val@ */ Scalar_BOOLEAN 0 Toaster_ES1274A_CM_boolean 0 1 /end CHARACTERISTIC
/begin CHARACTERISTIC throttlePedalPositionOvrEn_val "Override Control" VALUE 0xfd0204 /* @ECU_Address@throttlePedalPositionOvrEn_val@ */ Scalar_BOOLEAN 0 Toaster_ES1274A_CM_boolean 0 1 /end CHARACTERISTIC
/begin CHARACTERISTIC turnSignalOvrEn_val "Override Control" VALUE 0xfd020d /* @ECU_Address@turnSignalOvrEn_val@ */ Scalar_BOOLEAN 0 Toaster_ES1274A_CM_boolean 0 1 /end CHARACTERISTIC
/begin CHARACTERISTIC userCallForHelpOvrCal_val "" VALUE 0xfd020e /* @ECU_Address@userCallForHelpOvrCal_val@ */ Scalar_BOOLEAN 0 Toaster_ES1274A_CM_boolean 0 1 /end CHARACTERISTIC
/begin CHARACTERISTIC userCallForHelpOvrEn_val "Override Control" VALUE 0xfd020f /* @ECU_Address@userCallForHelpOvrEn_val@ */ Scalar_BOOLEAN 0 Toaster_ES1274A_CM_boolean 0 1 /end CHARACTERISTIC
/begin CHARACTERISTIC userEstopOvrCal_val "" VALUE 0xfd0210 /* @ECU_Address@userEstopOvrCal_val@ */ Scalar_BOOLEAN 0 Toaster_ES1274A_CM_boolean 0 1 /end CHARACTERISTIC
/begin CHARACTERISTIC userEstopOvrEn_val "Override Control" VALUE 0xfd0211 /* @ECU_Address@userEstopOvrEn_val@ */ Scalar_BOOLEAN 0 Toaster_ES1274A_CM_boolean 0 1 /end CHARACTERISTIC
/begin CHARACTERISTIC userLockUnlockOvrCal_val "" VALUE 0xfd0212 /* @ECU_Address@userLockUnlockOvrCal_val@ */ Scalar_BOOLEAN 0 Toaster_ES1274A_CM_boolean 0 1 /end CHARACTERISTIC
/begin CHARACTERISTIC userLockUnlockOvrEn_val "Override Control" VALUE 0xfd0213 /* @ECU_Address@userLockUnlockOvrEn_val@ */ Scalar_BOOLEAN 0 Toaster_ES1274A_CM_boolean 0 1 /end CHARACTERISTIC
/begin CHARACTERISTIC userPulloverOvrCal_val "" VALUE 0xfd0214 /* @ECU_Address@userPulloverOvrCal_val@ */ Scalar_BOOLEAN 0 Toaster_ES1274A_CM_boolean 0 1 /end CHARACTERISTIC
/begin CHARACTERISTIC userPulloverOvrEn_val "Override Control" VALUE 0xfd0215 /* @ECU_Address@userPulloverOvrEn_val@ */ Scalar_BOOLEAN 0 Toaster_ES1274A_CM_boolean 0 1 /end CHARACTERISTIC
/begin CHARACTERISTIC wiperOvrEn_val "Override Control" VALUE 0xfd022f /* @ECU_Address@wiperOvrEn_val@ */ Scalar_BOOLEAN 0 Toaster_ES1274A_CM_boolean 0 1 /end CHARACTERISTIC
/begin CHARACTERISTIC yellowLEDDutyOvrEn_val "Override Control" VALUE 0xfd0234 /* @ECU_Address@yellowLEDDutyOvrEn_val@ */ Scalar_BOOLEAN 0 Toaster_ES1274A_CM_boolean 0 1 /end CHARACTERISTIC
/begin CHARACTERISTIC yellowLEDEnableOvrCal_val "" VALUE 0xfd0235 /* @ECU_Address@yellowLEDEnableOvrCal_val@ */ Scalar_BOOLEAN 0 Toaster_ES1274A_CM_boolean 0 1 /end CHARACTERISTIC
/begin CHARACTERISTIC yellowLEDEnableOvrEn_val "Override Control" VALUE 0xfd0236 /* @ECU_Address@yellowLEDEnableOvrEn_val@ */ Scalar_BOOLEAN 0 Toaster_ES1274A_CM_boolean 0 1 /end CHARACTERISTIC
/begin CHARACTERISTIC yellowLEDFreqOvrEn_val "Override Control" VALUE 0xfd023c /* @ECU_Address@yellowLEDFreqOvrEn_val@ */ Scalar_BOOLEAN 0 Toaster_ES1274A_CM_boolean 0 1 /end CHARACTERISTIC
/begin CHARACTERISTIC ADC_BrakepedalPOS "" VALUE 0xfd0000 /* @ECU_Address@ADC_BrakepedalPOS@ */ Scalar_UBYTE 0 Toaster_ES1274A_CM_uint8 0 255 /end CHARACTERISTIC
/begin CHARACTERISTIC CMD_DoorFROvrCal_val "" VALUE 0xfd0020 /* @ECU_Address@CMD_DoorFROvrCal_val@ */ Scalar_UBYTE 0 Toaster_ES1274A_CM_uint8 0 255 /end CHARACTERISTIC
/begin CHARACTERISTIC CMD_hornOvrCal_val "" VALUE 0xfd0022 /* @ECU_Address@CMD_hornOvrCal_val@ */ Scalar_UBYTE 0 Toaster_ES1274A_CM_uint8 0 255 /end CHARACTERISTIC
/begin CHARACTERISTIC DBW_EPB_cmd_7A4OvrCal_val "" VALUE 0xfd0024 /* @ECU_Address@DBW_EPB_cmd_7A4OvrCal_val@ */ Scalar_UBYTE 0 Toaster_ES1274A_CM_uint8 0 255 /end CHARACTERISTIC
/begin CHARACTERISTIC SSC_driverOverrideByteOvrCal_val "" VALUE 0xfd0070 /* @ECU_Address@SSC_driverOverrideByteOvrCal_val@ */ Scalar_UBYTE 0 Toaster_ES1274A_CM_uint8 0 255 /end CHARACTERISTIC
/begin CHARACTERISTIC SSC_faultOverrideByteOvrCal_val "" VALUE 0xfd0074 /* @ECU_Address@SSC_faultOverrideByteOvrCal_val@ */ Scalar_UBYTE 0 Toaster_ES1274A_CM_uint8 0 255 /end CHARACTERISTIC
/begin CHARACTERISTIC SSC_subsystemSelectOvrCal_val "" VALUE 0xfd007a /* @ECU_Address@SSC_subsystemSelectOvrCal_val@ */ Scalar_UBYTE 0 Toaster_ES1274A_CM_uint8 0 255 /end CHARACTERISTIC
/begin CHARACTERISTIC Set_AllowedFaultOccuranceOfMsgCounter_AccessoryCommand "" VALUE 0xfd0084 /* @ECU_Address@Set_AllowedFaultOccuranceOfMsgCounter_AccessoryCommand@ */ Scalar_UBYTE 0 Toaster_ES1274A_CM_uint8 0 255 /end CHARACTERISTIC
/begin CHARACTERISTIC Set_AllowedFaultOccuranceOfMsgCounter_BrakeCommand "" VALUE 0xfd0085 /* @ECU_Address@Set_AllowedFaultOccuranceOfMsgCounter_BrakeCommand@ */ Scalar_UBYTE 0 Toaster_ES1274A_CM_uint8 0 255 /end CHARACTERISTIC
/begin CHARACTERISTIC Set_AllowedFaultOccuranceOfMsgCounter_ShiftCommand "" VALUE 0xfd0086 /* @ECU_Address@Set_AllowedFaultOccuranceOfMsgCounter_ShiftCommand@ */ Scalar_UBYTE 0 Toaster_ES1274A_CM_uint8 0 255 /end CHARACTERISTIC
/begin CHARACTERISTIC Set_AllowedFaultOccuranceOfMsgCounter_SteerCommand "" VALUE 0xfd0087 /* @ECU_Address@Set_AllowedFaultOccuranceOfMsgCounter_SteerCommand@ */ Scalar_UBYTE 0 Toaster_ES1274A_CM_uint8 0 255 /end CHARACTERISTIC
/begin CHARACTERISTIC Set_AllowedFaultOccuranceOfMsgCounter_SystemCommand "" VALUE 0xfd0088 /* @ECU_Address@Set_AllowedFaultOccuranceOfMsgCounter_SystemCommand@ */ Scalar_UBYTE 0 Toaster_ES1274A_CM_uint8 0 255 /end CHARACTERISTIC
/begin CHARACTERISTIC Set_AllowedFaultOccuranceOfMsgCounter_ThrottleCommand "" VALUE 0xfd0089 /* @ECU_Address@Set_AllowedFaultOccuranceOfMsgCounter_ThrottleCommand@ */ Scalar_UBYTE 0 Toaster_ES1274A_CM_uint8 0 255 /end CHARACTERISTIC
/begin CHARACTERISTIC cmd_EPB_45OvrCal_val "" VALUE 0xfd012e /* @ECU_Address@cmd_EPB_45OvrCal_val@ */ Scalar_UBYTE 0 Toaster_ES1274A_CM_uint8 0 255 /end CHARACTERISTIC
/begin CHARACTERISTIC commandedGearOvrCal_val "" VALUE 0xfd0141 /* @ECU_Address@commandedGearOvrCal_val@ */ Scalar_UBYTE 0 Toaster_ES1274A_CM_uint8 0 255 /end CHARACTERISTIC
/begin CHARACTERISTIC drivingLightsOvrCal_val "" VALUE 0xfd0143 /* @ECU_Address@drivingLightsOvrCal_val@ */ Scalar_UBYTE 0 Toaster_ES1274A_CM_uint8 0 255 /end CHARACTERISTIC
/begin CHARACTERISTIC gearOvrCal_val "" VALUE 0xfd0147 /* @ECU_Address@gearOvrCal_val@ */ Scalar_UBYTE 0 Toaster_ES1274A_CM_uint8 0 255 /end CHARACTERISTIC
/begin CHARACTERISTIC subsystemSelectOvrCal_val "" VALUE 0xfd01bd /* @ECU_Address@subsystemSelectOvrCal_val@ */ Scalar_UBYTE 0 Toaster_ES1274A_CM_uint8 0 255 /end CHARACTERISTIC
/begin CHARACTERISTIC turnSignalOvrCal_val "" VALUE 0xfd020c /* @ECU_Address@turnSignalOvrCal_val@ */ Scalar_UBYTE 0 Toaster_ES1274A_CM_uint8 0 255 /end CHARACTERISTIC
/begin CHARACTERISTIC wiperOvrCal_val "" VALUE 0xfd022e /* @ECU_Address@wiperOvrCal_val@ */ Scalar_UBYTE 0 Toaster_ES1274A_CM_uint8 0 255 /end CHARACTERISTIC
/begin MEASUREMENT systemAgeOvrMsr "" ULONG Toaster_ES1274A_CM_uint32 0 0 0 4294967295 ECU_ADDRESS 0x400080e8 /* @ECU_Address@systemAgeOvrMsr@ */ /end MEASUREMENT
/begin MEASUREMENT redLEDDutyOvrMsr "" ULONG Toaster_ES1274A_CM_uint32 0 0 0 4294967295 ECU_ADDRESS 0x400080a8 /* @ECU_Address@redLEDDutyOvrMsr@ */ /end MEASUREMENT
/begin MEASUREMENT greenLEDDutyOvrMsr "" ULONG Toaster_ES1274A_CM_uint32 0 0 0 4294967295 ECU_ADDRESS 0x4000809c /* @ECU_Address@greenLEDDutyOvrMsr@ */ /end MEASUREMENT
/begin MEASUREMENT yellowLEDDutyOvrMsr "" ULONG Toaster_ES1274A_CM_uint32 0 0 0 4294967295 ECU_ADDRESS 0x4000810c /* @ECU_Address@yellowLEDDutyOvrMsr@ */ /end MEASUREMENT
/begin MEASUREMENT greenLEDFreqOvrMsr "" ULONG Toaster_ES1274A_CM_uint32 0 0 0 4294967295 ECU_ADDRESS 0x400080a4 /* @ECU_Address@greenLEDFreqOvrMsr@ */ /end MEASUREMENT
/begin MEASUREMENT yellowLEDFreqOvrMsr "" ULONG Toaster_ES1274A_CM_uint32 0 0 0 4294967295 ECU_ADDRESS 0x40008114 /* @ECU_Address@yellowLEDFreqOvrMsr@ */ /end MEASUREMENT
/begin MEASUREMENT redLEDFreqOvrMsr "" ULONG Toaster_ES1274A_CM_uint32 0 0 0 4294967295 ECU_ADDRESS 0x400080b0 /* @ECU_Address@redLEDFreqOvrMsr@ */ /end MEASUREMENT
/begin MEASUREMENT systemAgeValidOvrMsr "" FLOAT32_IEEE Toaster_ES1274A_CM_single 0 0 -3.4E+38 3.4E+38 ECU_ADDRESS 0x400080ec /* @ECU_Address@systemAgeValidOvrMsr@ */ /end MEASUREMENT
/begin MEASUREMENT acceleratorPositionRateOvrMsr "" FLOAT32_IEEE Toaster_ES1274A_CM_single 0 0 -3.4E+38 3.4E+38 ECU_ADDRESS 0x40008070 /* @ECU_Address@acceleratorPositionRateOvrMsr@ */ /end MEASUREMENT
/begin MEASUREMENT acceleratorPositionOvrMsr "" FLOAT32_IEEE Toaster_ES1274A_CM_single 0 0 -3.4E+38 3.4E+38 ECU_ADDRESS 0x4000806c /* @ECU_Address@acceleratorPositionOvrMsr@ */ /end MEASUREMENT
/begin MEASUREMENT cmd_brakePedalPositionRateOvrMsr "" FLOAT32_IEEE Toaster_ES1274A_CM_single 0 0 -3.4E+38 3.4E+38 ECU_ADDRESS 0x40008094 /* @ECU_Address@cmd_brakePedalPositionRateOvrMsr@ */ /end MEASUREMENT
/begin MEASUREMENT cmd_brakePedalPositionOvrMsr "" FLOAT32_IEEE Toaster_ES1274A_CM_single 0 0 -3.4E+38 3.4E+38 ECU_ADDRESS 0x40008090 /* @ECU_Address@cmd_brakePedalPositionOvrMsr@ */ /end MEASUREMENT
/begin MEASUREMENT Veh_7BCLF_Wheel_spdOvrMsr "" FLOAT32_IEEE Toaster_ES1274A_CM_single 0 0 -3.4E+38 3.4E+38 ECU_ADDRESS 0x40008050 /* @ECU_Address@Veh_7BCLF_Wheel_spdOvrMsr@ */ /end MEASUREMENT
/begin MEASUREMENT Veh_7BCRF_Wheel_spdOvrMsr "" FLOAT32_IEEE Toaster_ES1274A_CM_single 0 0 -3.4E+38 3.4E+38 ECU_ADDRESS 0x40008058 /* @ECU_Address@Veh_7BCRF_Wheel_spdOvrMsr@ */ /end MEASUREMENT
/begin MEASUREMENT Veh_7BCLR_Wheel_spdOvrMsr "" FLOAT32_IEEE Toaster_ES1274A_CM_single 0 0 -3.4E+38 3.4E+38 ECU_ADDRESS 0x40008054 /* @ECU_Address@Veh_7BCLR_Wheel_spdOvrMsr@ */ /end MEASUREMENT
/begin MEASUREMENT Veh_7BCRR_Wheel_spdOvrMsr "" FLOAT32_IEEE Toaster_ES1274A_CM_single 0 0 -3.4E+38 3.4E+38 ECU_ADDRESS 0x4000805c /* @ECU_Address@Veh_7BCRR_Wheel_spdOvrMsr@ */ /end MEASUREMENT
/begin MEASUREMENT brakePedalPositionOvrMsr "" FLOAT32_IEEE Toaster_ES1274A_CM_single 0 0 -3.4E+38 3.4E+38 ECU_ADDRESS 0x40008084 /* @ECU_Address@brakePedalPositionOvrMsr@ */ /end MEASUREMENT
/begin MEASUREMENT throttlePedalPositionOvrMsr "" FLOAT32_IEEE Toaster_ES1274A_CM_single 0 0 -3.4E+38 3.4E+38 ECU_ADDRESS 0x40008100 /* @ECU_Address@throttlePedalPositionOvrMsr@ */ /end MEASUREMENT
/begin MEASUREMENT steeringWheelAngleCommand_DegOvrMsr "" FLOAT32_IEEE Toaster_ES1274A_CM_single 0 0 -3.4E+38 3.4E+38 ECU_ADDRESS 0x400080cc /* @ECU_Address@steeringWheelAngleCommand_DegOvrMsr@ */ /end MEASUREMENT
/begin MEASUREMENT steeringWheelAngleSetpoint_DegOvrMsr "" FLOAT32_IEEE Toaster_ES1274A_CM_single 0 0 -3.4E+38 3.4E+38 ECU_ADDRESS 0x400080d8 /* @ECU_Address@steeringWheelAngleSetpoint_DegOvrMsr@ */ /end MEASUREMENT
/begin MEASUREMENT DriveCmd_AccCmdOvrMsr "" FLOAT32_IEEE Toaster_ES1274A_CM_single 0 0 -3.4E+38 3.4E+38 ECU_ADDRESS 0x40008018 /* @ECU_Address@DriveCmd_AccCmdOvrMsr@ */ /end MEASUREMENT
/begin MEASUREMENT DriveCmd_BrakeDecelCmdOvrMsr "" FLOAT32_IEEE Toaster_ES1274A_CM_single 0 0 -3.4E+38 3.4E+38 ECU_ADDRESS 0x4000801c /* @ECU_Address@DriveCmd_BrakeDecelCmdOvrMsr@ */ /end MEASUREMENT
/begin MEASUREMENT SteeringCmd_AngelCmdOvrMsr "" FLOAT32_IEEE Toaster_ES1274A_CM_single 0 0 -3.4E+38 3.4E+38 ECU_ADDRESS 0x40008044 /* @ECU_Address@SteeringCmd_AngelCmdOvrMsr@ */ /end MEASUREMENT
/begin MEASUREMENT steeringWheelAngleRateCommandOvrMsr "" FLOAT32_IEEE Toaster_ES1274A_CM_single 0 0 -3.4E+38 3.4E+38 ECU_ADDRESS 0x400080d0 /* @ECU_Address@steeringWheelAngleRateCommandOvrMsr@ */ /end MEASUREMENT
/begin MEASUREMENT steeringWheelAngleRateSetpointOvrMsr "" FLOAT32_IEEE Toaster_ES1274A_CM_single 0 0 -3.4E+38 3.4E+38 ECU_ADDRESS 0x400080d4 /* @ECU_Address@steeringWheelAngleRateSetpointOvrMsr@ */ /end MEASUREMENT
/begin MEASUREMENT SteeringCmd_AngelRateCmdOvrMsr "" FLOAT32_IEEE Toaster_ES1274A_CM_single 0 0 -3.4E+38 3.4E+38 ECU_ADDRESS 0x40008048 /* @ECU_Address@SteeringCmd_AngelRateCmdOvrMsr@ */ /end MEASUREMENT
/begin MEASUREMENT steering_feedback_eps_statusOvrMsr "" FLOAT32_IEEE Toaster_ES1274A_CM_single 0 0 -3.4E+38 3.4E+38 ECU_ADDRESS 0x400080e0 /* @ECU_Address@steering_feedback_eps_statusOvrMsr@ */ /end MEASUREMENT
/begin MEASUREMENT steer_angle_cmd_byte_0 "" UWORD Toaster_ES1274A_CM_uint16 0 0 0 65535 ECU_ADDRESS 0x400080c6 /* @ECU_Address@steer_angle_cmd_byte_0@ */ /end MEASUREMENT
/begin MEASUREMENT steer_angle_cmd_byte_1 "" UWORD Toaster_ES1274A_CM_uint16 0 0 0 65535 ECU_ADDRESS 0x400080c8 /* @ECU_Address@steer_angle_cmd_byte_1@ */ /end MEASUREMENT
/begin MEASUREMENT steeringWheelAngle_rawOvrMsr "" UWORD Toaster_ES1274A_CM_uint16 0 0 0 65535 ECU_ADDRESS 0x400080dc /* @ECU_Address@steeringWheelAngle_rawOvrMsr@ */ /end MEASUREMENT
/begin MEASUREMENT DriveCmd_GearCmdOvrMsr "" UWORD Toaster_ES1274A_CM_uint16 0 0 0 65535 ECU_ADDRESS 0x40008020 /* @ECU_Address@DriveCmd_GearCmdOvrMsr@ */ /end MEASUREMENT
/begin MEASUREMENT subsystemSelectOvrMsr "" UBYTE Toaster_ES1274A_CM_uint8 0 0 0 255 ECU_ADDRESS 0x400080e4 /* @ECU_Address@subsystemSelectOvrMsr@ */ /end MEASUREMENT
/begin MEASUREMENT SSC_subsystemSelectOvrMsr "" UBYTE Toaster_ES1274A_CM_uint8 0 0 0 255 ECU_ADDRESS 0x40008040 /* @ECU_Address@SSC_subsystemSelectOvrMsr@ */ /end MEASUREMENT
/begin MEASUREMENT SSC_driverOverrideByteOvrMsr "" UBYTE Toaster_ES1274A_CM_uint8 0 0 0 255 ECU_ADDRESS 0x4000803b /* @ECU_Address@SSC_driverOverrideByteOvrMsr@ */ /end MEASUREMENT
/begin MEASUREMENT SSC_faultOverrideByteOvrMsr "" UBYTE Toaster_ES1274A_CM_uint8 0 0 0 255 ECU_ADDRESS 0x4000803d /* @ECU_Address@SSC_faultOverrideByteOvrMsr@ */ /end MEASUREMENT
/begin MEASUREMENT drivingLightsOvrMsr "" UBYTE Toaster_ES1274A_CM_uint8 0 0 0 255 ECU_ADDRESS 0x40008099 /* @ECU_Address@drivingLightsOvrMsr@ */ /end MEASUREMENT
/begin MEASUREMENT gearOvrMsr "" UBYTE Toaster_ES1274A_CM_uint8 0 0 0 255 ECU_ADDRESS 0x4000809b /* @ECU_Address@gearOvrMsr@ */ /end MEASUREMENT
/begin MEASUREMENT commandedGearOvrMsr "" UBYTE Toaster_ES1274A_CM_uint8 0 0 0 255 ECU_ADDRESS 0x40008098 /* @ECU_Address@commandedGearOvrMsr@ */ /end MEASUREMENT
/begin MEASUREMENT CMD_DoorFROvrMsr "" UBYTE Toaster_ES1274A_CM_uint8 0 0 0 255 ECU_ADDRESS 0x40008000 /* @ECU_Address@CMD_DoorFROvrMsr@ */ /end MEASUREMENT
/begin MEASUREMENT turnSignalOvrMsr "" UBYTE Toaster_ES1274A_CM_uint8 0 0 0 255 ECU_ADDRESS 0x40008104 /* @ECU_Address@turnSignalOvrMsr@ */ /end MEASUREMENT
/begin MEASUREMENT CMD_hornOvrMsr "" UBYTE Toaster_ES1274A_CM_uint8 0 0 0 255 ECU_ADDRESS 0x40008001 /* @ECU_Address@CMD_hornOvrMsr@ */ /end MEASUREMENT
/begin MEASUREMENT cmd_EPB_45OvrMsr "" UBYTE Toaster_ES1274A_CM_uint8 0 0 0 255 ECU_ADDRESS 0x4000808b /* @ECU_Address@cmd_EPB_45OvrMsr@ */ /end MEASUREMENT
/begin MEASUREMENT DBW_EPB_cmd_7A4OvrMsr "" UBYTE Toaster_ES1274A_CM_uint8 0 0 0 255 ECU_ADDRESS 0x40008002 /* @ECU_Address@DBW_EPB_cmd_7A4OvrMsr@ */ /end MEASUREMENT
/begin MEASUREMENT systemState "{'Initializing', 'NotReady', 'Ready', 'Enabled', 'DriverOverridden', 'FaultOverridden', 'Disabled'}" UBYTE Toaster_ES1274A_CM_uint8 0 0 0 255 ECU_ADDRESS 0x400080f6 /* @ECU_Address@systemState@ */ /end MEASUREMENT
/begin MEASUREMENT wiperOvrMsr "" UBYTE Toaster_ES1274A_CM_uint8 0 0 0 255 ECU_ADDRESS 0x40008109 /* @ECU_Address@wiperOvrMsr@ */ /end MEASUREMENT
/begin MEASUREMENT Diag_CheckThrottleCommandCounter_faultCount "" UBYTE Toaster_ES1274A_CM_uint8 0 0 0 255 ECU_ADDRESS 0x40008013 /* @ECU_Address@Diag_CheckThrottleCommandCounter_faultCount@ */ /end MEASUREMENT
/begin MEASUREMENT Diag_CheckThrottleCommandCounter_prev "" UBYTE Toaster_ES1274A_CM_uint8 0 0 0 255 ECU_ADDRESS 0x40008014 /* @ECU_Address@Diag_CheckThrottleCommandCounter_prev@ */ /end MEASUREMENT
/begin MEASUREMENT Diag_CheckThrottleCommandCounter_crt "" UBYTE Toaster_ES1274A_CM_uint8 0 0 0 255 ECU_ADDRESS 0x40008012 /* @ECU_Address@Diag_CheckThrottleCommandCounter_crt@ */ /end MEASUREMENT
/begin MEASUREMENT Diag_CheckSystemCommandCounter_faultCount "" UBYTE Toaster_ES1274A_CM_uint8 0 0 0 255 ECU_ADDRESS 0x40008010 /* @ECU_Address@Diag_CheckSystemCommandCounter_faultCount@ */ /end MEASUREMENT
/begin MEASUREMENT Diag_CheckSystemCommandCounter_prev "" UBYTE Toaster_ES1274A_CM_uint8 0 0 0 255 ECU_ADDRESS 0x40008011 /* @ECU_Address@Diag_CheckSystemCommandCounter_prev@ */ /end MEASUREMENT
/begin MEASUREMENT Diag_CheckSystemCommandCounter_crt "" UBYTE Toaster_ES1274A_CM_uint8 0 0 0 255 ECU_ADDRESS 0x4000800f /* @ECU_Address@Diag_CheckSystemCommandCounter_crt@ */ /end MEASUREMENT
/begin MEASUREMENT Diag_CheckSteerCommandCounter_faultCount "" UBYTE Toaster_ES1274A_CM_uint8 0 0 0 255 ECU_ADDRESS 0x4000800d /* @ECU_Address@Diag_CheckSteerCommandCounter_faultCount@ */ /end MEASUREMENT
/begin MEASUREMENT Diag_CheckSteerCommandCounter_prev "" UBYTE Toaster_ES1274A_CM_uint8 0 0 0 255 ECU_ADDRESS 0x4000800e /* @ECU_Address@Diag_CheckSteerCommandCounter_prev@ */ /end MEASUREMENT
/begin MEASUREMENT Diag_CheckSteerCommandCounter_crt "" UBYTE Toaster_ES1274A_CM_uint8 0 0 0 255 ECU_ADDRESS 0x4000800c /* @ECU_Address@Diag_CheckSteerCommandCounter_crt@ */ /end MEASUREMENT
/begin MEASUREMENT Diag_CheckShiftCommandCounter_faultCount "" UBYTE Toaster_ES1274A_CM_uint8 0 0 0 255 ECU_ADDRESS 0x4000800a /* @ECU_Address@Diag_CheckShiftCommandCounter_faultCount@ */ /end MEASUREMENT
/begin MEASUREMENT Diag_CheckShiftCommandCounter_prev "" UBYTE Toaster_ES1274A_CM_uint8 0 0 0 255 ECU_ADDRESS 0x4000800b /* @ECU_Address@Diag_CheckShiftCommandCounter_prev@ */ /end MEASUREMENT
/begin MEASUREMENT Diag_CheckShiftCommandCounter_crt "" UBYTE Toaster_ES1274A_CM_uint8 0 0 0 255 ECU_ADDRESS 0x40008009 /* @ECU_Address@Diag_CheckShiftCommandCounter_crt@ */ /end MEASUREMENT
/begin MEASUREMENT Diag_CheckBrakeCommandCounter_faultCount "" UBYTE Toaster_ES1274A_CM_uint8 0 0 0 255 ECU_ADDRESS 0x40008007 /* @ECU_Address@Diag_CheckBrakeCommandCounter_faultCount@ */ /end MEASUREMENT
/begin MEASUREMENT Diag_CheckBrakeCommandCounter_prev "" UBYTE Toaster_ES1274A_CM_uint8 0 0 0 255 ECU_ADDRESS 0x40008008 /* @ECU_Address@Diag_CheckBrakeCommandCounter_prev@ */ /end MEASUREMENT
/begin MEASUREMENT Diag_CheckBrakeCommandCounter_crt "" UBYTE Toaster_ES1274A_CM_uint8 0 0 0 255 ECU_ADDRESS 0x40008006 /* @ECU_Address@Diag_CheckBrakeCommandCounter_crt@ */ /end MEASUREMENT
/begin MEASUREMENT Diag_CheckAccessoryCommandCounter_faultCount "" UBYTE Toaster_ES1274A_CM_uint8 0 0 0 255 ECU_ADDRESS 0x40008004 /* @ECU_Address@Diag_CheckAccessoryCommandCounter_faultCount@ */ /end MEASUREMENT
/begin MEASUREMENT Diag_CheckAccessoryCommandCounter_prev "" UBYTE Toaster_ES1274A_CM_uint8 0 0 0 255 ECU_ADDRESS 0x40008005 /* @ECU_Address@Diag_CheckAccessoryCommandCounter_prev@ */ /end MEASUREMENT
/begin MEASUREMENT Diag_CheckAccessoryCommandCounter_crt "" UBYTE Toaster_ES1274A_CM_uint8 0 0 0 255 ECU_ADDRESS 0x40008003 /* @ECU_Address@Diag_CheckAccessoryCommandCounter_crt@ */ /end MEASUREMENT
/begin MEASUREMENT accessoryFaultOvrMsr "" UBYTE Toaster_ES1274A_CM_boolean 0 0 0 1 ECU_ADDRESS 0x40008078 /* @ECU_Address@accessoryFaultOvrMsr@ */ /end MEASUREMENT
/begin MEASUREMENT Vehicle7BBAgeValidOvrMsr "" UBYTE Toaster_ES1274A_CM_boolean 0 0 0 1 ECU_ADDRESS 0x40008067 /* @ECU_Address@Vehicle7BBAgeValidOvrMsr@ */ /end MEASUREMENT
/begin MEASUREMENT brakeFaultOvrMsr "" UBYTE Toaster_ES1274A_CM_boolean 0 0 0 1 ECU_ADDRESS 0x40008081 /* @ECU_Address@brakeFaultOvrMsr@ */ /end MEASUREMENT
/begin MEASUREMENT Vehicle7B9AgeValidOvrMsr "" UBYTE Toaster_ES1274A_CM_boolean 0 0 0 1 ECU_ADDRESS 0x40008065 /* @ECU_Address@Vehicle7B9AgeValidOvrMsr@ */ /end MEASUREMENT
/begin MEASUREMENT shiftFaultOvrMsr "" UBYTE Toaster_ES1274A_CM_boolean 0 0 0 1 ECU_ADDRESS 0x400080bd /* @ECU_Address@shiftFaultOvrMsr@ */ /end MEASUREMENT
/begin MEASUREMENT throttleFaultOvrMsr "" UBYTE Toaster_ES1274A_CM_boolean 0 0 0 1 ECU_ADDRESS 0x400080ff /* @ECU_Address@throttleFaultOvrMsr@ */ /end MEASUREMENT
/begin MEASUREMENT EPOOvrMsr "" UBYTE Toaster_ES1274A_CM_boolean 0 0 0 1 ECU_ADDRESS 0x40008022 /* @ECU_Address@EPOOvrMsr@ */ /end MEASUREMENT
/begin MEASUREMENT systemFaultOvrMsr "" UBYTE Toaster_ES1274A_CM_boolean 0 0 0 1 ECU_ADDRESS 0x400080f4 /* @ECU_Address@systemFaultOvrMsr@ */ /end MEASUREMENT
/begin MEASUREMENT SSC_faultOvrMsr "" UBYTE Toaster_ES1274A_CM_boolean 0 0 0 1 ECU_ADDRESS 0x4000803e /* @ECU_Address@SSC_faultOvrMsr@ */ /end MEASUREMENT
/begin MEASUREMENT brakeDriverActivityOvrMsr "" UBYTE Toaster_ES1274A_CM_boolean 0 0 0 1 ECU_ADDRESS 0x4000807e /* @ECU_Address@brakeDriverActivityOvrMsr@ */ /end MEASUREMENT
/begin MEASUREMENT throttleDriverActivityOvrMsr "" UBYTE Toaster_ES1274A_CM_boolean 0 0 0 1 ECU_ADDRESS 0x400080fc /* @ECU_Address@throttleDriverActivityOvrMsr@ */ /end MEASUREMENT
/begin MEASUREMENT SSC_driverActivityOvrMsr "" UBYTE Toaster_ES1274A_CM_boolean 0 0 0 1 ECU_ADDRESS 0x4000803a /* @ECU_Address@SSC_driverActivityOvrMsr@ */ /end MEASUREMENT
/begin MEASUREMENT systemCntValidOvrMsr "" UBYTE Toaster_ES1274A_CM_boolean 0 0 0 1 ECU_ADDRESS 0x400080f2 /* @ECU_Address@systemCntValidOvrMsr@ */ /end MEASUREMENT
/begin MEASUREMENT systemCrcValidOvrMsr "" UBYTE Toaster_ES1274A_CM_boolean 0 0 0 1 ECU_ADDRESS 0x400080f3 /* @ECU_Address@systemCrcValidOvrMsr@ */ /end MEASUREMENT
/begin MEASUREMENT systemRequestADSEngagedOvrMsr "" UBYTE Toaster_ES1274A_CM_boolean 0 0 0 1 ECU_ADDRESS 0x400080f5 /* @ECU_Address@systemRequestADSEngagedOvrMsr@ */ /end MEASUREMENT
/begin MEASUREMENT SSC_requestADSEngagedOvrMsr "" UBYTE Toaster_ES1274A_CM_boolean 0 0 0 1 ECU_ADDRESS 0x4000803f /* @ECU_Address@SSC_requestADSEngagedOvrMsr@ */ /end MEASUREMENT
/begin MEASUREMENT selectAccessoryOvrMsr "" UBYTE Toaster_ES1274A_CM_boolean 0 0 0 1 ECU_ADDRESS 0x400080b4 /* @ECU_Address@selectAccessoryOvrMsr@ */ /end MEASUREMENT
/begin MEASUREMENT selectBrakeOvrMsr "" UBYTE Toaster_ES1274A_CM_boolean 0 0 0 1 ECU_ADDRESS 0x400080b5 /* @ECU_Address@selectBrakeOvrMsr@ */ /end MEASUREMENT
/begin MEASUREMENT selectShiftOvrMsr "" UBYTE Toaster_ES1274A_CM_boolean 0 0 0 1 ECU_ADDRESS 0x400080b6 /* @ECU_Address@selectShiftOvrMsr@ */ /end MEASUREMENT
/begin MEASUREMENT selectSteerOvrMsr "" UBYTE Toaster_ES1274A_CM_boolean 0 0 0 1 ECU_ADDRESS 0x400080b7 /* @ECU_Address@selectSteerOvrMsr@ */ /end MEASUREMENT
/begin MEASUREMENT selectThrottleOvrMsr "" UBYTE Toaster_ES1274A_CM_boolean 0 0 0 1 ECU_ADDRESS 0x400080b8 /* @ECU_Address@selectThrottleOvrMsr@ */ /end MEASUREMENT
/begin MEASUREMENT systemClearOverrideOvrMsr "" UBYTE Toaster_ES1274A_CM_boolean 0 0 0 1 ECU_ADDRESS 0x400080f1 /* @ECU_Address@systemClearOverrideOvrMsr@ */ /end MEASUREMENT
/begin MEASUREMENT SSC_clearOverrideOvrMsr "" UBYTE Toaster_ES1274A_CM_boolean 0 0 0 1 ECU_ADDRESS 0x40008039 /* @ECU_Address@SSC_clearOverrideOvrMsr@ */ /end MEASUREMENT
/begin MEASUREMENT brakeDriverOverride_CANOvrMsr "" UBYTE Toaster_ES1274A_CM_boolean 0 0 0 1 ECU_ADDRESS 0x4000807f /* @ECU_Address@brakeDriverOverride_CANOvrMsr@ */ /end MEASUREMENT
/begin MEASUREMENT brakeDriverOverride_PedalOvrMsr "" UBYTE Toaster_ES1274A_CM_boolean 0 0 0 1 ECU_ADDRESS 0x40008080 /* @ECU_Address@brakeDriverOverride_PedalOvrMsr@ */ /end MEASUREMENT
/begin MEASUREMENT steerDriverOverrideOvrMsr "" UBYTE Toaster_ES1274A_CM_boolean 0 0 0 1 ECU_ADDRESS 0x400080c2 /* @ECU_Address@steerDriverOverrideOvrMsr@ */ /end MEASUREMENT
/begin MEASUREMENT throttleDriverOverride_CANOvrMsr "" UBYTE Toaster_ES1274A_CM_boolean 0 0 0 1 ECU_ADDRESS 0x400080fd /* @ECU_Address@throttleDriverOverride_CANOvrMsr@ */ /end MEASUREMENT
/begin MEASUREMENT throttleDriverOverride_PedalOvrMsr "" UBYTE Toaster_ES1274A_CM_boolean 0 0 0 1 ECU_ADDRESS 0x400080fe /* @ECU_Address@throttleDriverOverride_PedalOvrMsr@ */ /end MEASUREMENT
/begin MEASUREMENT SSC_driverOverrideOvrMsr "" UBYTE Toaster_ES1274A_CM_boolean 0 0 0 1 ECU_ADDRESS 0x4000803c /* @ECU_Address@SSC_driverOverrideOvrMsr@ */ /end MEASUREMENT
/begin MEASUREMENT accessoryAgeValidOvrMsr "" UBYTE Toaster_ES1274A_CM_boolean 0 0 0 1 ECU_ADDRESS 0x40008074 /* @ECU_Address@accessoryAgeValidOvrMsr@ */ /end MEASUREMENT
/begin MEASUREMENT accessoryCntValidOvrMsr "" UBYTE Toaster_ES1274A_CM_boolean 0 0 0 1 ECU_ADDRESS 0x40008076 /* @ECU_Address@accessoryCntValidOvrMsr@ */ /end MEASUREMENT
/begin MEASUREMENT accessoryCrcValidOvrMsr "" UBYTE Toaster_ES1274A_CM_boolean 0 0 0 1 ECU_ADDRESS 0x40008077 /* @ECU_Address@accessoryCrcValidOvrMsr@ */ /end MEASUREMENT
/begin MEASUREMENT accessoryCanFaultOvrMsr "" UBYTE Toaster_ES1274A_CM_boolean 0 0 0 1 ECU_ADDRESS 0x40008075 /* @ECU_Address@accessoryCanFaultOvrMsr@ */ /end MEASUREMENT
/begin MEASUREMENT brakeAgeValidOvrMsr "" UBYTE Toaster_ES1274A_CM_boolean 0 0 0 1 ECU_ADDRESS 0x4000807a /* @ECU_Address@brakeAgeValidOvrMsr@ */ /end MEASUREMENT
/begin MEASUREMENT brakeCntValidOvrMsr "" UBYTE Toaster_ES1274A_CM_boolean 0 0 0 1 ECU_ADDRESS 0x4000807c /* @ECU_Address@brakeCntValidOvrMsr@ */ /end MEASUREMENT
/begin MEASUREMENT brakeCrcValidOvrMsr "" UBYTE Toaster_ES1274A_CM_boolean 0 0 0 1 ECU_ADDRESS 0x4000807d /* @ECU_Address@brakeCrcValidOvrMsr@ */ /end MEASUREMENT
/begin MEASUREMENT brakeCanFaultOvrMsr "" UBYTE Toaster_ES1274A_CM_boolean 0 0 0 1 ECU_ADDRESS 0x4000807b /* @ECU_Address@brakeCanFaultOvrMsr@ */ /end MEASUREMENT
/begin MEASUREMENT shiftAgeValidOvrMsr "" UBYTE Toaster_ES1274A_CM_boolean 0 0 0 1 ECU_ADDRESS 0x400080b9 /* @ECU_Address@shiftAgeValidOvrMsr@ */ /end MEASUREMENT
/begin MEASUREMENT shiftCntValidOvrMsr "" UBYTE Toaster_ES1274A_CM_boolean 0 0 0 1 ECU_ADDRESS 0x400080bb /* @ECU_Address@shiftCntValidOvrMsr@ */ /end MEASUREMENT
/begin MEASUREMENT shiftCrcValidOvrMsr "" UBYTE Toaster_ES1274A_CM_boolean 0 0 0 1 ECU_ADDRESS 0x400080bc /* @ECU_Address@shiftCrcValidOvrMsr@ */ /end MEASUREMENT
/begin MEASUREMENT shiftCanFaultOvrMsr "" UBYTE Toaster_ES1274A_CM_boolean 0 0 0 1 ECU_ADDRESS 0x400080ba /* @ECU_Address@shiftCanFaultOvrMsr@ */ /end MEASUREMENT
/begin MEASUREMENT steerAgeValidOvrMsr "" UBYTE Toaster_ES1274A_CM_boolean 0 0 0 1 ECU_ADDRESS 0x400080be /* @ECU_Address@steerAgeValidOvrMsr@ */ /end MEASUREMENT
/begin MEASUREMENT steerCntValidOvrMsr "" UBYTE Toaster_ES1274A_CM_boolean 0 0 0 1 ECU_ADDRESS 0x400080c0 /* @ECU_Address@steerCntValidOvrMsr@ */ /end MEASUREMENT
/begin MEASUREMENT steerCrcValidOvrMsr "" UBYTE Toaster_ES1274A_CM_boolean 0 0 0 1 ECU_ADDRESS 0x400080c1 /* @ECU_Address@steerCrcValidOvrMsr@ */ /end MEASUREMENT
/begin MEASUREMENT steerCanFaultOvrMsr "" UBYTE Toaster_ES1274A_CM_boolean 0 0 0 1 ECU_ADDRESS 0x400080bf /* @ECU_Address@steerCanFaultOvrMsr@ */ /end MEASUREMENT
/begin MEASUREMENT throttleAgeValidOvrMsr "" UBYTE Toaster_ES1274A_CM_boolean 0 0 0 1 ECU_ADDRESS 0x400080f8 /* @ECU_Address@throttleAgeValidOvrMsr@ */ /end MEASUREMENT
/begin MEASUREMENT throttleCntValidOvrMsr "" UBYTE Toaster_ES1274A_CM_boolean 0 0 0 1 ECU_ADDRESS 0x400080fa /* @ECU_Address@throttleCntValidOvrMsr@ */ /end MEASUREMENT
/begin MEASUREMENT throttleCrcValidOvrMsr "" UBYTE Toaster_ES1274A_CM_boolean 0 0 0 1 ECU_ADDRESS 0x400080fb /* @ECU_Address@throttleCrcValidOvrMsr@ */ /end MEASUREMENT
/begin MEASUREMENT throttleCanFaultOvrMsr "" UBYTE Toaster_ES1274A_CM_boolean 0 0 0 1 ECU_ADDRESS 0x400080f9 /* @ECU_Address@throttleCanFaultOvrMsr@ */ /end MEASUREMENT
/begin MEASUREMENT systemCanFaultOvrMsr "" UBYTE Toaster_ES1274A_CM_boolean 0 0 0 1 ECU_ADDRESS 0x400080f0 /* @ECU_Address@systemCanFaultOvrMsr@ */ /end MEASUREMENT
/begin MEASUREMENT SSC_canFaultOvrMsr "" UBYTE Toaster_ES1274A_CM_boolean 0 0 0 1 ECU_ADDRESS 0x40008038 /* @ECU_Address@SSC_canFaultOvrMsr@ */ /end MEASUREMENT
/begin MEASUREMENT adcCapableOvrMsr "" UBYTE Toaster_ES1274A_CM_boolean 0 0 0 1 ECU_ADDRESS 0x40008079 /* @ECU_Address@adcCapableOvrMsr@ */ /end MEASUREMENT
/begin MEASUREMENT SSC_adcCapableOvrMsr "" UBYTE Toaster_ES1274A_CM_boolean 0 0 0 1 ECU_ADDRESS 0x40008037 /* @ECU_Address@SSC_adcCapableOvrMsr@ */ /end MEASUREMENT
/begin MEASUREMENT button_inputOvrMsr "" UBYTE Toaster_ES1274A_CM_boolean 0 0 0 1 ECU_ADDRESS 0x40008089 /* @ECU_Address@button_inputOvrMsr@ */ /end MEASUREMENT
/begin MEASUREMENT REVOvrMsr "" UBYTE Toaster_ES1274A_CM_boolean 0 0 0 1 ECU_ADDRESS 0x40008036 /* @ECU_Address@REVOvrMsr@ */ /end MEASUREMENT
/begin MEASUREMENT F_R_2OvrMsr "" UBYTE Toaster_ES1274A_CM_boolean 0 0 0 1 ECU_ADDRESS 0x40008024 /* @ECU_Address@F_R_2OvrMsr@ */ /end MEASUREMENT
/begin MEASUREMENT MAIN_NOOvrMsr "" UBYTE Toaster_ES1274A_CM_boolean 0 0 0 1 ECU_ADDRESS 0x4000802b /* @ECU_Address@MAIN_NOOvrMsr@ */ /end MEASUREMENT
/begin MEASUREMENT FWDOvrMsr "" UBYTE Toaster_ES1274A_CM_boolean 0 0 0 1 ECU_ADDRESS 0x40008023 /* @ECU_Address@FWDOvrMsr@ */ /end MEASUREMENT
/begin MEASUREMENT userPulloverOvrMsr "" UBYTE Toaster_ES1274A_CM_boolean 0 0 0 1 ECU_ADDRESS 0x40008108 /* @ECU_Address@userPulloverOvrMsr@ */ /end MEASUREMENT
/begin MEASUREMENT userLockUnlockOvrMsr "" UBYTE Toaster_ES1274A_CM_boolean 0 0 0 1 ECU_ADDRESS 0x40008107 /* @ECU_Address@userLockUnlockOvrMsr@ */ /end MEASUREMENT
/begin MEASUREMENT userCallForHelpOvrMsr "" UBYTE Toaster_ES1274A_CM_boolean 0 0 0 1 ECU_ADDRESS 0x40008105 /* @ECU_Address@userCallForHelpOvrMsr@ */ /end MEASUREMENT
/begin MEASUREMENT userEstopOvrMsr "" UBYTE Toaster_ES1274A_CM_boolean 0 0 0 1 ECU_ADDRESS 0x40008106 /* @ECU_Address@userEstopOvrMsr@ */ /end MEASUREMENT
/begin MEASUREMENT greenLEDEnableOvrMsr "" UBYTE Toaster_ES1274A_CM_boolean 0 0 0 1 ECU_ADDRESS 0x400080a0 /* @ECU_Address@greenLEDEnableOvrMsr@ */ /end MEASUREMENT
/begin MEASUREMENT LSO03_PIN14OvrMsr "" UBYTE Toaster_ES1274A_CM_boolean 0 0 0 1 ECU_ADDRESS 0x40008025 /* @ECU_Address@LSO03_PIN14OvrMsr@ */ /end MEASUREMENT
/begin MEASUREMENT yellowLEDEnableOvrMsr "" UBYTE Toaster_ES1274A_CM_boolean 0 0 0 1 ECU_ADDRESS 0x40008110 /* @ECU_Address@yellowLEDEnableOvrMsr@ */ /end MEASUREMENT
/begin MEASUREMENT LSO05_PIN46OvrMsr "" UBYTE Toaster_ES1274A_CM_boolean 0 0 0 1 ECU_ADDRESS 0x40008027 /* @ECU_Address@LSO05_PIN46OvrMsr@ */ /end MEASUREMENT
/begin MEASUREMENT redLEDEnableOvrMsr "" UBYTE Toaster_ES1274A_CM_boolean 0 0 0 1 ECU_ADDRESS 0x400080ac /* @ECU_Address@redLEDEnableOvrMsr@ */ /end MEASUREMENT
/begin MEASUREMENT LSO04_PIN45OvrMsr "" UBYTE Toaster_ES1274A_CM_boolean 0 0 0 1 ECU_ADDRESS 0x40008026 /* @ECU_Address@LSO04_PIN45OvrMsr@ */ /end MEASUREMENT
/begin MEASUREMENT buzzerOvrMsr "" UBYTE Toaster_ES1274A_CM_boolean 0 0 0 1 ECU_ADDRESS 0x4000808a /* @ECU_Address@buzzerOvrMsr@ */ /end MEASUREMENT
/begin MEASUREMENT LSO06_PIN13OvrMsr "" UBYTE Toaster_ES1274A_CM_boolean 0 0 0 1 ECU_ADDRESS 0x40008028 /* @ECU_Address@LSO06_PIN13OvrMsr@ */ /end MEASUREMENT
/begin MEASUREMENT engaged_engagedOvrMsr "" UBYTE Toaster_ES1274A_CM_boolean 0 0 0 1 ECU_ADDRESS 0x4000809a /* @ECU_Address@engaged_engagedOvrMsr@ */ /end MEASUREMENT
/begin MEASUREMENT LightControl_LowBeamOvrMsr "" UBYTE Toaster_ES1274A_CM_boolean 0 0 0 1 ECU_ADDRESS 0x4000802a /* @ECU_Address@LightControl_LowBeamOvrMsr@ */ /end MEASUREMENT
/begin MEASUREMENT LightControl_HighBeamOvrMsr "" UBYTE Toaster_ES1274A_CM_boolean 0 0 0 1 ECU_ADDRESS 0x40008029 /* @ECU_Address@LightControl_HighBeamOvrMsr@ */ /end MEASUREMENT
/begin MEASUREMENT steerEngagedOvrMsr "" UBYTE Toaster_ES1274A_CM_boolean 0 0 0 1 ECU_ADDRESS 0x400080c3 /* @ECU_Address@steerEngagedOvrMsr@ */ /end MEASUREMENT
/begin MEASUREMENT MiscControl_LeftturnOvrMsr "" UBYTE Toaster_ES1274A_CM_boolean 0 0 0 1 ECU_ADDRESS 0x4000802d /* @ECU_Address@MiscControl_LeftturnOvrMsr@ */ /end MEASUREMENT
/begin MEASUREMENT MiscControl_HazardOvrMsr "" UBYTE Toaster_ES1274A_CM_boolean 0 0 0 1 ECU_ADDRESS 0x4000802c /* @ECU_Address@MiscControl_HazardOvrMsr@ */ /end MEASUREMENT
/begin MEASUREMENT MiscControl_RightturnOvrMsr "" UBYTE Toaster_ES1274A_CM_boolean 0 0 0 1 ECU_ADDRESS 0x4000802e /* @ECU_Address@MiscControl_RightturnOvrMsr@ */ /end MEASUREMENT
/begin MEASUREMENT MiscControl_horn_flgOvrMsr "" UBYTE Toaster_ES1274A_CM_boolean 0 0 0 1 ECU_ADDRESS 0x4000802f /* @ECU_Address@MiscControl_horn_flgOvrMsr@ */ /end MEASUREMENT
/begin MEASUREMENT button_debouncedOvrMsr "" UBYTE Toaster_ES1274A_CM_boolean 0 0 0 1 ECU_ADDRESS 0x40008088 /* @ECU_Address@button_debouncedOvrMsr@ */ /end MEASUREMENT
/begin MEASUREMENT Vehicle7BCAgeValidOvrMsr "" UBYTE Toaster_ES1274A_CM_boolean 0 0 0 1 ECU_ADDRESS 0x40008068 /* @ECU_Address@Vehicle7BCAgeValidOvrMsr@ */ /end MEASUREMENT
/begin MEASUREMENT Vehicle7B4AgeValidOvrMsr "" UBYTE Toaster_ES1274A_CM_boolean 0 0 0 1 ECU_ADDRESS 0x40008063 /* @ECU_Address@Vehicle7B4AgeValidOvrMsr@ */ /end MEASUREMENT
/begin MEASUREMENT Vehicle7B5AgeValidOvrMsr "" UBYTE Toaster_ES1274A_CM_boolean 0 0 0 1 ECU_ADDRESS 0x40008064 /* @ECU_Address@Vehicle7B5AgeValidOvrMsr@ */ /end MEASUREMENT
/begin MEASUREMENT Vehicle7BFAgeValidOvrMsr "" UBYTE Toaster_ES1274A_CM_boolean 0 0 0 1 ECU_ADDRESS 0x4000806a /* @ECU_Address@Vehicle7BFAgeValidOvrMsr@ */ /end MEASUREMENT
/begin MEASUREMENT Veh_7B2ageValidOvrMsr "" UBYTE Toaster_ES1274A_CM_boolean 0 0 0 1 ECU_ADDRESS 0x4000804c /* @ECU_Address@Veh_7B2ageValidOvrMsr@ */ /end MEASUREMENT
/begin MEASUREMENT Vehicle7BA_AgeValidOvrMsr "" UBYTE Toaster_ES1274A_CM_boolean 0 0 0 1 ECU_ADDRESS 0x40008066 /* @ECU_Address@Vehicle7BA_AgeValidOvrMsr@ */ /end MEASUREMENT
/begin MEASUREMENT Vehicle7D3AgeValidOvrMsr "" UBYTE Toaster_ES1274A_CM_boolean 0 0 0 1 ECU_ADDRESS 0x4000806b /* @ECU_Address@Vehicle7D3AgeValidOvrMsr@ */ /end MEASUREMENT
/begin MEASUREMENT Vehicle7BEAgeValidOvrMsr "" UBYTE Toaster_ES1274A_CM_boolean 0 0 0 1 ECU_ADDRESS 0x40008069 /* @ECU_Address@Vehicle7BEAgeValidOvrMsr@ */ /end MEASUREMENT
/begin MEASUREMENT Vehicle7B0AgeValidOvrMsr "" UBYTE Toaster_ES1274A_CM_boolean 0 0 0 1 ECU_ADDRESS 0x40008060 /* @ECU_Address@Vehicle7B0AgeValidOvrMsr@ */ /end MEASUREMENT
/begin MEASUREMENT Vehicle7B1AgeValidOvrMsr "" UBYTE Toaster_ES1274A_CM_boolean 0 0 0 1 ECU_ADDRESS 0x40008061 /* @ECU_Address@Vehicle7B1AgeValidOvrMsr@ */ /end MEASUREMENT
/begin MEASUREMENT Vehicle7B3AgeValidOvrMsr "" UBYTE Toaster_ES1274A_CM_boolean 0 0 0 1 ECU_ADDRESS 0x40008062 /* @ECU_Address@Vehicle7B3AgeValidOvrMsr@ */ /end MEASUREMENT
/begin MEASUREMENT testShiftEngagedOvrMsr "" UBYTE Toaster_ES1274A_CM_boolean 0 0 0 1 ECU_ADDRESS 0x400080f7 /* @ECU_Address@testShiftEngagedOvrMsr@ */ /end MEASUREMENT
/begin MEASUREMENT cmd_brakeLightsOvrMsr "" UBYTE Toaster_ES1274A_CM_boolean 0 0 0 1 ECU_ADDRESS 0x4000808c /* @ECU_Address@cmd_brakeLightsOvrMsr@ */ /end MEASUREMENT
/begin MEASUREMENT steerFaultOvrMsr "" UBYTE Toaster_ES1274A_CM_boolean 0 0 0 1 ECU_ADDRESS 0x400080c4 /* @ECU_Address@steerFaultOvrMsr@ */ /end MEASUREMENT
/begin MEASUREMENT Pwr_flgKeyOn "" UBYTE Toaster_ES1274A_CM_boolean 0 0 0 1 ECU_ADDRESS 0x40008033 /* @ECU_Address@Pwr_flgKeyOn@ */ /end MEASUREMENT
/begin MEASUREMENT Pwr_flgKeyOnDbnc "" UBYTE Toaster_ES1274A_CM_boolean 0 0 0 1 ECU_ADDRESS 0x40008034 /* @ECU_Address@Pwr_flgKeyOnDbnc@ */ /end MEASUREMENT
/begin MEASUREMENT Pwr_flgKeyOnRaw "" UBYTE Toaster_ES1274A_CM_boolean 0 0 0 1 ECU_ADDRESS 0x40008035 /* @ECU_Address@Pwr_flgKeyOnRaw@ */ /end MEASUREMENT
/begin MEASUREMENT Pwr_flgCANARx "" UBYTE Toaster_ES1274A_CM_boolean 0 0 0 1 ECU_ADDRESS 0x40008032 /* @ECU_Address@Pwr_flgCANARx@ */ /end MEASUREMENT
/begin MEASUREMENT PwrM_flgKeyOnDelay "" UBYTE Toaster_ES1274A_CM_boolean 0 0 0 1 ECU_ADDRESS 0x40008030 /* @ECU_Address@PwrM_flgKeyOnDelay@ */ /end MEASUREMENT
/begin MEASUREMENT PwrM_flgKeyOnRaw "" UBYTE Toaster_ES1274A_CM_boolean 0 0 0 1 ECU_ADDRESS 0x40008031 /* @ECU_Address@PwrM_flgKeyOnRaw@ */ /end MEASUREMENT
/begin COMPU_METHOD Toaster_ES1274A_CM_single "Q = V" RAT_FUNC "%8.6" "" COEFFS 0 1 0 0 0 1 /end COMPU_METHOD
/begin COMPU_METHOD Toaster_ES1274A_CM_single_s "Q = V" RAT_FUNC "%8.6" "s" COEFFS 0 1 0 0 0 1 /end COMPU_METHOD
/begin COMPU_METHOD Toaster_ES1274A_CM_single_mm "Q = V" RAT_FUNC "%8.6" "mm" COEFFS 0 1 0 0 0 1 /end COMPU_METHOD
/begin COMPU_METHOD Toaster_ES1274A_CM_uint32 "Q = V" RAT_FUNC "%10.0" "" COEFFS 0 1 0 0 0 1 /end COMPU_METHOD
/begin COMPU_METHOD Toaster_ES1274A_CM_uint16 "Q = V" RAT_FUNC "%5.0" "" COEFFS 0 1 0 0 0 1 /end COMPU_METHOD
/begin COMPU_METHOD Toaster_ES1274A_CM_boolean "Q = V" RAT_FUNC "%1.0" "" COEFFS 0 1 0 0 0 1 /end COMPU_METHOD
/begin COMPU_METHOD Toaster_ES1274A_CM_uint8 "Q = V" RAT_FUNC "%3.0" "" COEFFS 0 1 0 0 0 1 /end COMPU_METHOD
/begin GROUP Toaster_ES1274A "Toaster_ES1274A" /* Root */ ROOT /begin SUB_GROUP Root_Main1 Root_Power_Management_Example1 Root_PwrOnCtrl /end SUB_GROUP /end GROUP
/begin GROUP Root_Main1 "Toaster_ES1274A/Main1" /begin SUB_GROUP S3_Control S3_Input S3_Output /end SUB_GROUP /end GROUP
/begin GROUP Root_Power_Management_Example1 "Toaster_ES1274A/Power Management Example1" /begin SUB_GROUP S4_Power_Off_Management /end SUB_GROUP /end GROUP
/begin GROUP Root_PwrOnCtrl "Toaster_ES1274A/PwrOnCtrl" /begin SUB_GROUP S5_PwrOnCtrl /end SUB_GROUP /end GROUP
/begin GROUP S3_Control "Toaster_ES1274A/Main1/Control"
 /begin SUB_GROUP S52_ByWireSubsystemControl S52__Override_Probe S52__Override_Probe1 S52__Override_Probe2 S52__Override_Probe3 S52__Override_Probe4 S52__Override_Probe5 S52__Override_Probe6 S52__Override_Probe7 S52__Override_Probe8 S52__Override_Probe9 /end SUB_GROUP
 /begin REF_MEASUREMENT systemState /end REF_MEASUREMENT
/end GROUP
/begin GROUP S3_Input "Toaster_ES1274A/Main1/Input"
 /begin SUB_GROUP S53_Assign_Logical_Meaning_to_Digital_Inputs S53_By_Wire_System_Signal_Processing S53_Read_ADC_CAN S53_Read_Vehicle_CAN /end SUB_GROUP
/end GROUP
/begin GROUP S3_Output "Toaster_ES1274A/Main1/Output" /begin SUB_GROUP S54_Digital S54_Physical S54_VEHICLE_CAN /end SUB_GROUP /end GROUP
/begin GROUP S4_Power_Off_Management "Toaster_ES1274A/Power Management Example1/Power Off Management" /begin SUB_GROUP S398_Get_flgKeyOn S398_TOfD_xxxx1 /end SUB_GROUP /end GROUP
/begin GROUP S5_PwrOnCtrl "Toaster_ES1274A/PwrOnCtrl/PwrOnCtrl" /begin SUB_GROUP S423_FlexRayForcetoHalt /end SUB_GROUP /begin REF_MEASUREMENT Pwr_flgCANARx Pwr_flgKeyOnRaw /end REF_MEASUREMENT /end GROUP
/begin GROUP S52__Override_Probe "Toaster_ES1274A/Main1/Control/ Override Probe"
 /begin REF_CHARACTERISTIC SSC_requestADSEngagedOvrCal_val SSC_requestADSEngagedOvrEn_val /end REF_CHARACTERISTIC
 /begin REF_MEASUREMENT SSC_requestADSEngagedOvrMsr /end REF_MEASUREMENT
/end GROUP
/begin GROUP S52__Override_Probe1 "Toaster_ES1274A/Main1/Control/ Override Probe1" /begin REF_CHARACTERISTIC SSC_subsystemSelectOvrCal_val SSC_subsystemSelectOvrEn_val /end REF_CHARACTERISTIC /begin REF_MEASUREMENT SSC_subsystemSelectOvrMsr /end REF_MEASUREMENT /end GROUP
/begin GROUP S52__Override_Probe2 "Toaster_ES1274A/Main1/Control/ Override Probe2" /begin REF_CHARACTERISTIC SSC_clearOverrideOvrCal_val SSC_clearOverrideOvrEn_val /end REF_CHARACTERISTIC /begin REF_MEASUREMENT SSC_clearOverrideOvrMsr /end REF_MEASUREMENT /end GROUP
/begin GROUP S52__Override_Probe3 "Toaster_ES1274A/Main1/Control/ Override Probe3" /begin REF_CHARACTERISTIC SSC_driverActivityOvrCal_val SSC_driverActivityOvrEn_val /end REF_CHARACTERISTIC /begin REF_MEASUREMENT SSC_driverActivityOvrMsr /end REF_MEASUREMENT /end GROUP
/begin GROUP S52__Override_Probe4 "Toaster_ES1274A/Main1/Control/ Override Probe4" /begin REF_CHARACTERISTIC SSC_driverOverrideOvrCal_val SSC_driverOverrideOvrEn_val /end REF_CHARACTERISTIC /begin REF_MEASUREMENT SSC_driverOverrideOvrMsr /end REF_MEASUREMENT /end GROUP
/begin GROUP S52__Override_Probe5 "Toaster_ES1274A/Main1/Control/ Override Probe5"
 /begin REF_CHARACTERISTIC SSC_driverOverrideByteOvrCal_val SSC_driverOverrideByteOvrEn_val /end REF_CHARACTERISTIC
 /begin REF_MEASUREMENT SSC_driverOverrideByteOvrMsr /end REF_MEASUREMENT
/end GROUP
/begin GROUP S52__Override_Probe6 "Toaster_ES1274A/Main1/Control/ Override Probe6" /begin REF_CHARACTERISTIC SSC_faultOvrCal_val SSC_faultOvrEn_val /end REF_CHARACTERISTIC /begin REF_MEASUREMENT SSC_faultOvrMsr /end REF_MEASUREMENT /end GROUP
/begin GROUP S52__Override_Probe7 "Toaster_ES1274A/Main1/Control/ Override Probe7" /begin REF_CHARACTERISTIC SSC_canFaultOvrCal_val SSC_canFaultOvrEn_val /end REF_CHARACTERISTIC /begin REF_MEASUREMENT SSC_canFaultOvrMsr /end REF_MEASUREMENT /end GROUP
/begin GROUP S52__Override_Probe8 "Toaster_ES1274A/Main1/Control/ Override Probe8"
 /begin REF_CHARACTERISTIC SSC_faultOverrideByteOvrCal_val SSC_faultOverrideByteOvrEn_val /end REF_CHARACTERISTIC
 /begin REF_MEASUREMENT SSC_faultOverrideByteOvrMsr /end REF_MEASUREMENT
/end GROUP
/begin GROUP S52__Override_Probe9 "Toaster_ES1274A/Main1/Control/ Override Probe9" /begin REF_CHARACTERISTIC SSC_adcCapableOvrCal_val SSC_adcCapableOvrEn_val /end REF_CHARACTERISTIC /begin REF_MEASUREMENT SSC_adcCapableOvrMsr /end REF_MEASUREMENT /end GROUP
/begin GROUP S52_ByWireSubsystemControl "Toaster_ES1274A/Main1/Control/ByWireSubsystemControl"
 /begin SUB_GROUP S65_BrakeControl S65_SensoryIndicators S65_ShiftControl S65_SteerControl S65_ThrottleControl /end SUB_GROUP
/end GROUP
/begin GROUP S53_Assign_Logical_Meaning_to_Digital_Inputs "Toaster_ES1274A/Main1/Input/Assign Logical Meaning to Digital Inputs"
 /begin SUB_GROUP S102__Override_Probe S102__Override_Probe1 S102__Override_Probe19 S102__Override_Probe2 S102__Override_Probe20 S102__Override_Probe3 S102__Override_Probe5 S102__Override_Probe6 S102__Override_Probe7 S102__Override_Probe8 /end SUB_GROUP
/end GROUP
/begin GROUP S53_By_Wire_System_Signal_Processing "Toaster_ES1274A/Main1/Input/By-Wire System Signal Processing"
 /begin SUB_GROUP S103_AccessorySignalProcessing S103_BrakeSignalProcessing S103_ShiftSignalProcessing S103_SteerSignalProcessing S103_SystemSignalProcessing S103_ThrottleSignalProcessing S103_wheel_speed_km__h_2_r__min /end SUB_GROUP
/end GROUP
/begin GROUP S53_Read_ADC_CAN "Toaster_ES1274A/Main1/Input/Read ADC CAN"
 /begin SUB_GROUP S104_CANReceiveAndProcess_AccessoryCommand S104_CANReceiveAndProcess_BrakeCommand S104_CANReceiveAndProcess_ShiftCommand S104_CANReceiveAndProcess_SteerCommand S104_CANReceiveAndProcess_SystemCommand S104_CANReceiveAndProcess_ThrottleCommand /end SUB_GROUP
/end GROUP
/begin GROUP S53_Read_Vehicle_CAN "Toaster_ES1274A/Main1/Input/Read Vehicle CAN"
 /begin SUB_GROUP S106__Override_Probe S106__Override_Probe1 S106__Override_Probe10 S106__Override_Probe11 S106__Override_Probe12 S106__Override_Probe13 S106__Override_Probe14 S106__Override_Probe15 S106__Override_Probe16 S106__Override_Probe2 S106__Override_Probe3 S106__Override_Probe4 S106__Override_Probe5 S106__Override_Probe6 S106__Override_Probe7 S106__Override_Probe8 S106__Override_Probe9 /end SUB_GROUP
 /begin REF_CHARACTERISTIC vehicle7B0AgeThreshold vehicle7B1AgeThreshold vehicle7B3AgeThreshold vehicle7B4AgeThreshold vehicle7B5AgeThreshold vehicle7B9AgeThreshold vehicle7BAAgeThreshold vehicle7BBAgeThreshold vehicle7BCAgeThreshold vehicle7BEAgeThreshold vehicle7BFAgeThreshold vehicle7D3AgeThreshold /end REF_CHARACTERISTIC
/end GROUP
/begin GROUP S54_Digital "Toaster_ES1274A/Main1/Output/Digital"
 /begin SUB_GROUP S320__Override_Probe2 S320__Override_Probe21 S320__Override_Probe22 S320__Override_Probe24 S320__Override_Probe25 S320__Override_Probe26 S320__Override_Probe27 S320__Override_Probe28 S320__Override_Probe29 S320__Override_Probe30 /end SUB_GROUP
 /begin REF_CHARACTERISTIC CAL_LedBrightnessDutyCycle_OFF CAL_LedBrightnessDutyCycle_ON DuringOfBuzzerOnAfterEpoPressed_tick Enable_BuzzerOnAfterEpoPressed /end REF_CHARACTERISTIC
/end GROUP
/begin GROUP S54_Physical "Toaster_ES1274A/Main1/Output/Physical" /begin SUB_GROUP S321_Digital /end SUB_GROUP /end GROUP
/begin GROUP S54_VEHICLE_CAN "Toaster_ES1274A/Main1/Output/VEHICLE_CAN"
 /begin SUB_GROUP S322__Override_Probe1 S322__Override_Probe2 S322__Override_Probe27 S322__Override_Probe28 S322__Override_Probe29 S322__Override_Probe3 S322__Override_Probe30 S322__Override_Probe31 S322__Override_Probe32 S322__Override_Probe33 S322__Override_Probe34 S322__Override_Probe35 S322__Override_Probe36 /end SUB_GROUP
 /begin REF_CHARACTERISTIC ADC_BrakepedalPOS /end REF_CHARACTERISTIC
/end GROUP
/begin GROUP S398_Get_flgKeyOn "Toaster_ES1274A/Power Management Example1/Power Off Management/Get flgKeyOn" /begin REF_MEASUREMENT PwrM_flgKeyOnRaw /end REF_MEASUREMENT /end GROUP
/begin GROUP S398_TOfD_xxxx1 "Toaster_ES1274A/Power Management Example1/Power Off Management/TOfD_xxxx1" /begin REF_MEASUREMENT PwrM_flgKeyOnDelay /end REF_MEASUREMENT /end GROUP
/begin GROUP S423_FlexRayForcetoHalt "Toaster_ES1274A/PwrOnCtrl/PwrOnCtrl/FlexRayForcetoHalt" /begin SUB_GROUP S424_Falling_Edge_Debounce /end SUB_GROUP /begin REF_CHARACTERISTIC Pwr_tOffDelay_val /end REF_CHARACTERISTIC /begin REF_MEASUREMENT Pwr_flgKeyOn /end REF_MEASUREMENT /end GROUP
/begin GROUP S65_BrakeControl "Toaster_ES1274A/Main1/Control/ByWireSubsystemControl/BrakeControl" /begin REF_CHARACTERISTIC Remote_max_decl brakePedalPositionRateLimit_percentps /end REF_CHARACTERISTIC /end GROUP
/begin GROUP S65_SensoryIndicators "Toaster_ES1274A/Main1/Control/ByWireSubsystemControl/SensoryIndicators"
 /begin REF_CHARACTERISTIC Bypass_BeepFrqSetting Bypass_BeepPattern SetBuzzerBeepFrqHi_Tick SetBuzzerBeepFrqLo_tick SetBuzzerChirpDuration_Tick SetBuzzerChirpGap_Tick /end REF_CHARACTERISTIC
/end GROUP
/begin GROUP S65_ShiftControl "Toaster_ES1274A/Main1/Control/ByWireSubsystemControl/ShiftControl" /begin SUB_GROUP S73__Override_Probe S73__Override_Probe1 /end SUB_GROUP /end GROUP
/begin GROUP S65_SteerControl "Toaster_ES1274A/Main1/Control/ByWireSubsystemControl/SteerControl"
 /begin SUB_GROUP S74__Override_Probe S74__Override_Probe1 S74__Override_Probe2 /end SUB_GROUP
/end GROUP
/begin GROUP S65_ThrottleControl "Toaster_ES1274A/Main1/Control/ByWireSubsystemControl/ThrottleControl" /begin REF_CHARACTERISTIC throttlePedalPositionRateLimit_percentps /end REF_CHARACTERISTIC /end GROUP
/begin GROUP S102__Override_Probe "Toaster_ES1274A/Main1/Input/Assign Logical Meaning to Digital Inputs/ Override Probe" /begin REF_CHARACTERISTIC MAIN_NOOvrCal_val MAIN_NOOvrEn_val /end REF_CHARACTERISTIC /begin REF_MEASUREMENT MAIN_NOOvrMsr /end REF_MEASUREMENT /end GROUP
/begin GROUP S102__Override_Probe1 "Toaster_ES1274A/Main1/Input/Assign Logical Meaning to Digital Inputs/ Override Probe1" /begin REF_CHARACTERISTIC FWDOvrCal_val FWDOvrEn_val /end REF_CHARACTERISTIC /begin REF_MEASUREMENT FWDOvrMsr /end REF_MEASUREMENT /end GROUP
/begin GROUP S102__Override_Probe19 "Toaster_ES1274A/Main1/Input/Assign Logical Meaning to Digital Inputs/ Override Probe19" /begin REF_CHARACTERISTIC F_R_2OvrCal_val F_R_2OvrEn_val /end REF_CHARACTERISTIC /begin REF_MEASUREMENT F_R_2OvrMsr /end REF_MEASUREMENT /end GROUP
/begin GROUP S102__Override_Probe2 "Toaster_ES1274A/Main1/Input/Assign Logical Meaning to Digital Inputs/ Override Probe2" /begin REF_CHARACTERISTIC userPulloverOvrCal_val userPulloverOvrEn_val /end REF_CHARACTERISTIC /begin REF_MEASUREMENT userPulloverOvrMsr /end REF_MEASUREMENT /end GROUP
/begin GROUP S102__Override_Probe20 "Toaster_ES1274A/Main1/Input/Assign Logical Meaning to Digital Inputs/ Override Probe20" /begin REF_CHARACTERISTIC REVOvrCal_val REVOvrEn_val /end REF_CHARACTERISTIC /begin REF_MEASUREMENT REVOvrMsr /end REF_MEASUREMENT /end GROUP
/begin GROUP S102__Override_Probe3 "Toaster_ES1274A/Main1/Input/Assign Logical Meaning to Digital Inputs/ Override Probe3" /begin REF_CHARACTERISTIC userCallForHelpOvrCal_val userCallForHelpOvrEn_val /end REF_CHARACTERISTIC /begin REF_MEASUREMENT userCallForHelpOvrMsr /end REF_MEASUREMENT /end GROUP
/begin GROUP S102__Override_Probe5 "Toaster_ES1274A/Main1/Input/Assign Logical Meaning to Digital Inputs/ Override Probe5" /begin REF_CHARACTERISTIC userLockUnlockOvrCal_val userLockUnlockOvrEn_val /end REF_CHARACTERISTIC /begin REF_MEASUREMENT userLockUnlockOvrMsr /end REF_MEASUREMENT /end GROUP
/begin GROUP S102__Override_Probe6 "Toaster_ES1274A/Main1/Input/Assign Logical Meaning to Digital Inputs/ Override Probe6" /begin REF_CHARACTERISTIC button_inputOvrCal_val button_inputOvrEn_val /end REF_CHARACTERISTIC /begin REF_MEASUREMENT button_inputOvrMsr /end REF_MEASUREMENT /end GROUP
/begin GROUP S102__Override_Probe7 "Toaster_ES1274A/Main1/Input/Assign Logical Meaning to Digital Inputs/ Override Probe7" /begin REF_CHARACTERISTIC EPOOvrCal_val EPOOvrEn_val /end REF_CHARACTERISTIC /begin REF_MEASUREMENT EPOOvrMsr /end REF_MEASUREMENT /end GROUP
/begin GROUP S102__Override_Probe8 "Toaster_ES1274A/Main1/Input/Assign Logical Meaning to Digital Inputs/ Override Probe8" /begin REF_CHARACTERISTIC userEstopOvrCal_val userEstopOvrEn_val /end REF_CHARACTERISTIC /begin REF_MEASUREMENT userEstopOvrMsr /end REF_MEASUREMENT /end GROUP
/begin GROUP S103_AccessorySignalProcessing "Toaster_ES1274A/Main1/Input/By-Wire System Signal Processing/AccessorySignalProcessing" /begin SUB_GROUP S117__Override_Probe S117__Override_Probe1 /end SUB_GROUP /end GROUP
/begin GROUP S103_BrakeSignalProcessing "Toaster_ES1274A/Main1/Input/By-Wire System Signal Processing/BrakeSignalProcessing"
 /begin SUB_GROUP S118__Override_Probe1 S118__Override_Probe5 S118__Override_Probe6 S118__Override_Probe7 S118__Override_Probe8 S118__Override_Probe9 /end SUB_GROUP
 /begin REF_CHARACTERISTIC brakePedalDriverActivityThreshold_percent brakePedalDriverActivityThreshold_ticks brakePedalDriverOverrideThreshold_percent brakePedalDriverOverrideThreshold_ticks /end REF_CHARACTERISTIC
/end GROUP
/begin GROUP S103_ShiftSignalProcessing "Toaster_ES1274A/Main1/Input/By-Wire System Signal Processing/ShiftSignalProcessing" /begin SUB_GROUP S119__Override_Probe S119__Override_Probe1 /end SUB_GROUP /end GROUP
/begin GROUP S103_SteerSignalProcessing "Toaster_ES1274A/Main1/Input/By-Wire System Signal Processing/SteerSignalProcessing"
 /begin SUB_GROUP S120__Override_Probe S120__Override_Probe1 S120__Override_Probe2 S120__Override_Probe3 /end SUB_GROUP
 /begin REF_CHARACTERISTIC steeringWheelDriverOverrideThreshold_ticks steeringWheelFaultOverrideThreshold_ticks /end REF_CHARACTERISTIC
/end GROUP
/begin GROUP S103_SystemSignalProcessing "Toaster_ES1274A/Main1/Input/By-Wire System Signal Processing/SystemSignalProcessing"
 /begin SUB_GROUP S121__Override_Probe S121__Override_Probe2 S121__Override_Probe3 S121__Override_Probe4 /end SUB_GROUP
/end GROUP
/begin GROUP S103_ThrottleSignalProcessing "Toaster_ES1274A/Main1/Input/By-Wire System Signal Processing/ThrottleSignalProcessing"
 /begin SUB_GROUP S122__Override_Probe10 S122__Override_Probe11 S122__Override_Probe12 S122__Override_Probe13 S122__Override_Probe14 S122__Override_Probe9 /end SUB_GROUP
 /begin REF_CHARACTERISTIC throttlePedalDriverActivityThreshold_percent throttlePedalDriverActivityThreshold_ticks throttlePedalDriverOverrideThreshold_percent throttlePedalDriverOverrideThreshold_ticks /end REF_CHARACTERISTIC
/end GROUP
/begin GROUP S103_wheel_speed_km__h_2_r__min "Toaster_ES1274A/Main1/Input/By-Wire System Signal Processing/wheel speed_km//h_2_r//min" /begin SUB_GROUP S123_wehspd_km__h_2_r__min /end SUB_GROUP /end GROUP
/begin GROUP S104_CANReceiveAndProcess_AccessoryCommand "Toaster_ES1274A/Main1/Input/Read ADC CAN/CANReceiveAndProcess_AccessoryCommand"
 /begin SUB_GROUP S176_Check_Accessory_Command_Counter S176__Override_Probe1 S176__Override_Probe15 S176__Override_Probe16 S176__Override_Probe17 S176__Override_Probe18 S176__Override_Probe2 S176__Override_Probe6 S176__Override_Probe7 /end SUB_GROUP
 /begin REF_CHARACTERISTIC ByPass_ValidateAccessoryCommandAge ByPass_ValidateAccessoryCommandCRC ByPass_ValidateAccessoryCommandCounter Set_AllowedFaultOccuranceOfMsgCounter_AccessoryCommand accessoryCommandAgeThreshold /end REF_CHARACTERISTIC
/end GROUP
/begin GROUP S104_CANReceiveAndProcess_BrakeCommand "Toaster_ES1274A/Main1/Input/Read ADC CAN/CANReceiveAndProcess_BrakeCommand"
 /begin SUB_GROUP S177_Check_Brake_Command_Counter S177__Override_Probe1 S177__Override_Probe15 S177__Override_Probe16 S177__Override_Probe17 S177__Override_Probe18 S177__Override_Probe6 S177__Override_Probe7 /end SUB_GROUP
 /begin REF_CHARACTERISTIC ByPass_ValidateBrakeCommandCRC ByPass_ValidateBrakeCommandCounter ByPass_ValidatekBrakeCommandAge Set_AllowedFaultOccuranceOfMsgCounter_BrakeCommand brakeCommandAgeThreshold /end REF_CHARACTERISTIC
/end GROUP
/begin GROUP S104_CANReceiveAndProcess_ShiftCommand "Toaster_ES1274A/Main1/Input/Read ADC CAN/CANReceiveAndProcess_ShiftCommand"
 /begin SUB_GROUP S178_Check_System_Command_Counter S178__Override_Probe1 S178__Override_Probe16 S178__Override_Probe18 S178__Override_Probe7 /end SUB_GROUP
 /begin REF_CHARACTERISTIC ByPass_ValidateShiftCommandAge ByPass_ValidateShiftCommandCRC ByPass_ValidateShiftCommandCounter Set_AllowedFaultOccuranceOfMsgCounter_ShiftCommand shiftCommandAgeThreshold /end REF_CHARACTERISTIC
/end GROUP
/begin GROUP S104_CANReceiveAndProcess_SteerCommand "Toaster_ES1274A/Main1/Input/Read ADC CAN/CANReceiveAndProcess_SteerCommand"
 /begin SUB_GROUP S179_Check_System_Command_Counter S179__Override_Probe1 S179__Override_Probe15 S179__Override_Probe16 S179__Override_Probe17 S179__Override_Probe18 S179__Override_Probe2 /end SUB_GROUP
 /begin REF_CHARACTERISTIC ByPass_ValidateSteerCommandAge ByPass_ValidateSteerCommandCRC ByPass_ValidateSteerCommandCounter Set_AllowedFaultOccuranceOfMsgCounter_SteerCommand steerCommandAgeThreshold /end REF_CHARACTERISTIC
 /begin REF_MEASUREMENT steer_angle_cmd_byte_0 steer_angle_cmd_byte_1 /end REF_MEASUREMENT
/end GROUP
/begin GROUP S104_CANReceiveAndProcess_SystemCommand "Toaster_ES1274A/Main1/Input/Read ADC CAN/CANReceiveAndProcess_SystemCommand"
 /begin SUB_GROUP S180_Check_System_Command_Counter S180__Override_Probe S180__Override_Probe1 S180__Override_Probe10 S180__Override_Probe11 S180__Override_Probe12 S180__Override_Probe13 S180__Override_Probe14 S180__Override_Probe3 S180__Override_Probe4 S180__Override_Probe5 S180__Override_Probe8 S180__Override_Probe9 /end SUB_GROUP
 /begin REF_CHARACTERISTIC ByPass_ValidateSystemCommandAge ByPass_ValidateSystemCommandCRC ByPass_ValidateSystemCommandCounter Set_AllowedFaultOccuranceOfMsgCounter_SystemCommand systemCommandAgeThreshold /end REF_CHARACTERISTIC
/end GROUP
/begin GROUP S104_CANReceiveAndProcess_ThrottleCommand "Toaster_ES1274A/Main1/Input/Read ADC CAN/CANReceiveAndProcess_ThrottleCommand"
 /begin SUB_GROUP S181_Check_System_Command_Counter S181__Override_Probe1 S181__Override_Probe15 S181__Override_Probe16 S181__Override_Probe17 S181__Override_Probe18 /end SUB_GROUP
 /begin REF_CHARACTERISTIC ByPass_ValidateThrottleCommandAge ByPass_ValidateThrottleCommandCRC ByPass_ValidateThrottleCommandCounter Set_AllowedFaultOccuranceOfMsgCounter_ThrottleCommand throttleCommandAgeThreshold /end REF_CHARACTERISTIC
/end GROUP
/begin GROUP S106__Override_Probe "Toaster_ES1274A/Main1/Input/Read Vehicle CAN/ Override Probe" /begin REF_CHARACTERISTIC Vehicle7B9AgeValidOvrCal_val Vehicle7B9AgeValidOvrEn_val /end REF_CHARACTERISTIC /begin REF_MEASUREMENT Vehicle7B9AgeValidOvrMsr /end REF_MEASUREMENT /end GROUP
/begin GROUP S106__Override_Probe1 "Toaster_ES1274A/Main1/Input/Read Vehicle CAN/ Override Probe1" /begin REF_CHARACTERISTIC Vehicle7BCAgeValidOvrCal_val Vehicle7BCAgeValidOvrEn_val /end REF_CHARACTERISTIC /begin REF_MEASUREMENT Vehicle7BCAgeValidOvrMsr /end REF_MEASUREMENT /end GROUP
/begin GROUP S106__Override_Probe10 "Toaster_ES1274A/Main1/Input/Read Vehicle CAN/ Override Probe10" /begin REF_CHARACTERISTIC Vehicle7B4AgeValidOvrCal_val Vehicle7B4AgeValidOvrEn_val /end REF_CHARACTERISTIC /begin REF_MEASUREMENT Vehicle7B4AgeValidOvrMsr /end REF_MEASUREMENT /end GROUP
/begin GROUP S106__Override_Probe11 "Toaster_ES1274A/Main1/Input/Read Vehicle CAN/ Override Probe11" /begin REF_CHARACTERISTIC Vehicle7B5AgeValidOvrCal_val Vehicle7B5AgeValidOvrEn_val /end REF_CHARACTERISTIC /begin REF_MEASUREMENT Vehicle7B5AgeValidOvrMsr /end REF_MEASUREMENT /end GROUP
/begin GROUP S106__Override_Probe12 "Toaster_ES1274A/Main1/Input/Read Vehicle CAN/ Override Probe12" /begin REF_CHARACTERISTIC Vehicle7BFAgeValidOvrCal_val Vehicle7BFAgeValidOvrEn_val /end REF_CHARACTERISTIC /begin REF_MEASUREMENT Vehicle7BFAgeValidOvrMsr /end REF_MEASUREMENT /end GROUP
/begin GROUP S106__Override_Probe13 "Toaster_ES1274A/Main1/Input/Read Vehicle CAN/ Override Probe13" /begin REF_CHARACTERISTIC Vehicle7BBAgeValidOvrCal_val Vehicle7BBAgeValidOvrEn_val /end REF_CHARACTERISTIC /begin REF_MEASUREMENT Vehicle7BBAgeValidOvrMsr /end REF_MEASUREMENT /end GROUP
/begin GROUP S106__Override_Probe14 "Toaster_ES1274A/Main1/Input/Read Vehicle CAN/ Override Probe14" /begin REF_CHARACTERISTIC Veh_7B2ageValidOvrCal_val Veh_7B2ageValidOvrEn_val /end REF_CHARACTERISTIC /begin REF_MEASUREMENT Veh_7B2ageValidOvrMsr /end REF_MEASUREMENT /end GROUP
/begin GROUP S106__Override_Probe15 "Toaster_ES1274A/Main1/Input/Read Vehicle CAN/ Override Probe15" /begin REF_CHARACTERISTIC Vehicle7BA_AgeValidOvrCal_val Vehicle7BA_AgeValidOvrEn_val /end REF_CHARACTERISTIC /begin REF_MEASUREMENT Vehicle7BA_AgeValidOvrMsr /end REF_MEASUREMENT /end GROUP
/begin GROUP S106__Override_Probe16 "Toaster_ES1274A/Main1/Input/Read Vehicle CAN/ Override Probe16" /begin REF_CHARACTERISTIC Vehicle7D3AgeValidOvrCal_val Vehicle7D3AgeValidOvrEn_val /end REF_CHARACTERISTIC /begin REF_MEASUREMENT Vehicle7D3AgeValidOvrMsr /end REF_MEASUREMENT /end GROUP
/begin GROUP S106__Override_Probe2 "Toaster_ES1274A/Main1/Input/Read Vehicle CAN/ Override Probe2" /begin REF_CHARACTERISTIC Vehicle7BEAgeValidOvrCal_val Vehicle7BEAgeValidOvrEn_val /end REF_CHARACTERISTIC /begin REF_MEASUREMENT Vehicle7BEAgeValidOvrMsr /end REF_MEASUREMENT /end GROUP
/begin GROUP S106__Override_Probe3 "Toaster_ES1274A/Main1/Input/Read Vehicle CAN/ Override Probe3" /begin REF_CHARACTERISTIC Veh_7BCLF_Wheel_spdOvrCal_val Veh_7BCLF_Wheel_spdOvrEn_val /end REF_CHARACTERISTIC /begin REF_MEASUREMENT Veh_7BCLF_Wheel_spdOvrMsr /end REF_MEASUREMENT /end GROUP
/begin GROUP S106__Override_Probe4 "Toaster_ES1274A/Main1/Input/Read Vehicle CAN/ Override Probe4" /begin REF_CHARACTERISTIC Veh_7BCRF_Wheel_spdOvrCal_val Veh_7BCRF_Wheel_spdOvrEn_val /end REF_CHARACTERISTIC /begin REF_MEASUREMENT Veh_7BCRF_Wheel_spdOvrMsr /end REF_MEASUREMENT /end GROUP
/begin GROUP S106__Override_Probe5 "Toaster_ES1274A/Main1/Input/Read Vehicle CAN/ Override Probe5" /begin REF_CHARACTERISTIC Veh_7BCLR_Wheel_spdOvrCal_val Veh_7BCLR_Wheel_spdOvrEn_val /end REF_CHARACTERISTIC /begin REF_MEASUREMENT Veh_7BCLR_Wheel_spdOvrMsr /end REF_MEASUREMENT /end GROUP
/begin GROUP S106__Override_Probe6 "Toaster_ES1274A/Main1/Input/Read Vehicle CAN/ Override Probe6" /begin REF_CHARACTERISTIC Veh_7BCRR_Wheel_spdOvrCal_val Veh_7BCRR_Wheel_spdOvrEn_val /end REF_CHARACTERISTIC /begin REF_MEASUREMENT Veh_7BCRR_Wheel_spdOvrMsr /end REF_MEASUREMENT /end GROUP
/begin GROUP S106__Override_Probe7 "Toaster_ES1274A/Main1/Input/Read Vehicle CAN/ Override Probe7" /begin REF_CHARACTERISTIC Vehicle7B0AgeValidOvrCal_val Vehicle7B0AgeValidOvrEn_val /end REF_CHARACTERISTIC /begin REF_MEASUREMENT Vehicle7B0AgeValidOvrMsr /end REF_MEASUREMENT /end GROUP
/begin GROUP S106__Override_Probe8 "Toaster_ES1274A/Main1/Input/Read Vehicle CAN/ Override Probe8" /begin REF_CHARACTERISTIC Vehicle7B1AgeValidOvrCal_val Vehicle7B1AgeValidOvrEn_val /end REF_CHARACTERISTIC /begin REF_MEASUREMENT Vehicle7B1AgeValidOvrMsr /end REF_MEASUREMENT /end GROUP
/begin GROUP S106__Override_Probe9 "Toaster_ES1274A/Main1/Input/Read Vehicle CAN/ Override Probe9" /begin REF_CHARACTERISTIC Vehicle7B3AgeValidOvrCal_val Vehicle7B3AgeValidOvrEn_val /end REF_CHARACTERISTIC /begin REF_MEASUREMENT Vehicle7B3AgeValidOvrMsr /end REF_MEASUREMENT /end GROUP
/begin GROUP S320__Override_Probe2 "Toaster_ES1274A/Main1/Output/Digital/ Override Probe2" /begin REF_CHARACTERISTIC buzzerOvrCal_val buzzerOvrEn_val /end REF_CHARACTERISTIC /begin REF_MEASUREMENT buzzerOvrMsr /end REF_MEASUREMENT /end GROUP
/begin GROUP S320__Override_Probe21 "Toaster_ES1274A/Main1/Output/Digital/ Override Probe21" /begin REF_CHARACTERISTIC greenLEDDutyOvrCal_val greenLEDDutyOvrEn_val /end REF_CHARACTERISTIC /begin REF_MEASUREMENT greenLEDDutyOvrMsr /end REF_MEASUREMENT /end GROUP
/begin GROUP S320__Override_Probe22 "Toaster_ES1274A/Main1/Output/Digital/ Override Probe22" /begin REF_CHARACTERISTIC greenLEDFreqOvrCal_val greenLEDFreqOvrEn_val /end REF_CHARACTERISTIC /begin REF_MEASUREMENT greenLEDFreqOvrMsr /end REF_MEASUREMENT /end GROUP
/begin GROUP S320__Override_Probe24 "Toaster_ES1274A/Main1/Output/Digital/ Override Probe24" /begin REF_CHARACTERISTIC yellowLEDEnableOvrCal_val yellowLEDEnableOvrEn_val /end REF_CHARACTERISTIC /begin REF_MEASUREMENT yellowLEDEnableOvrMsr /end REF_MEASUREMENT /end GROUP
/begin GROUP S320__Override_Probe25 "Toaster_ES1274A/Main1/Output/Digital/ Override Probe25" /begin REF_CHARACTERISTIC yellowLEDDutyOvrCal_val yellowLEDDutyOvrEn_val /end REF_CHARACTERISTIC /begin REF_MEASUREMENT yellowLEDDutyOvrMsr /end REF_MEASUREMENT /end GROUP
/begin GROUP S320__Override_Probe26 "Toaster_ES1274A/Main1/Output/Digital/ Override Probe26" /begin REF_CHARACTERISTIC yellowLEDFreqOvrCal_val yellowLEDFreqOvrEn_val /end REF_CHARACTERISTIC /begin REF_MEASUREMENT yellowLEDFreqOvrMsr /end REF_MEASUREMENT /end GROUP
/begin GROUP S320__Override_Probe27 "Toaster_ES1274A/Main1/Output/Digital/ Override Probe27" /begin REF_CHARACTERISTIC greenLEDEnableOvrCal_val greenLEDEnableOvrEn_val /end REF_CHARACTERISTIC /begin REF_MEASUREMENT greenLEDEnableOvrMsr /end REF_MEASUREMENT /end GROUP
/begin GROUP S320__Override_Probe28 "Toaster_ES1274A/Main1/Output/Digital/ Override Probe28" /begin REF_CHARACTERISTIC redLEDEnableOvrCal_val redLEDEnableOvrEn_val /end REF_CHARACTERISTIC /begin REF_MEASUREMENT redLEDEnableOvrMsr /end REF_MEASUREMENT /end GROUP
/begin GROUP S320__Override_Probe29 "Toaster_ES1274A/Main1/Output/Digital/ Override Probe29" /begin REF_CHARACTERISTIC redLEDDutyOvrCal_val redLEDDutyOvrEn_val /end REF_CHARACTERISTIC /begin REF_MEASUREMENT redLEDDutyOvrMsr /end REF_MEASUREMENT /end GROUP
/begin GROUP S320__Override_Probe30 "Toaster_ES1274A/Main1/Output/Digital/ Override Probe30" /begin REF_CHARACTERISTIC redLEDFreqOvrCal_val redLEDFreqOvrEn_val /end REF_CHARACTERISTIC /begin REF_MEASUREMENT redLEDFreqOvrMsr /end REF_MEASUREMENT /end GROUP
/begin GROUP S321_Digital "Toaster_ES1274A/Main1/Output/Physical/Digital"
 /begin SUB_GROUP S368__Override_Probe24 S368__Override_Probe25 S368__Override_Probe26 S368__Override_Probe8 /end SUB_GROUP
/end GROUP
/begin GROUP S322__Override_Probe1 "Toaster_ES1274A/Main1/Output/VEHICLE_CAN/ Override Probe1" /begin REF_CHARACTERISTIC DBW_EPB_cmd_7A4OvrCal_val DBW_EPB_cmd_7A4OvrEn_val /end REF_CHARACTERISTIC /begin REF_MEASUREMENT DBW_EPB_cmd_7A4OvrMsr /end REF_MEASUREMENT /end GROUP
/begin GROUP S322__Override_Probe2 "Toaster_ES1274A/Main1/Output/VEHICLE_CAN/ Override Probe2" /begin REF_CHARACTERISTIC engaged_engagedOvrCal_val engaged_engagedOvrEn_val /end REF_CHARACTERISTIC /begin REF_MEASUREMENT engaged_engagedOvrMsr /end REF_MEASUREMENT /end GROUP
/begin GROUP S322__Override_Probe27 "Toaster_ES1274A/Main1/Output/VEHICLE_CAN/ Override Probe27"
 /begin REF_CHARACTERISTIC LightControl_LowBeamOvrCal_val LightControl_LowBeamOvrEn_val /end REF_CHARACTERISTIC
 /begin REF_MEASUREMENT LightControl_LowBeamOvrMsr /end REF_MEASUREMENT
/end GROUP
/begin GROUP S322__Override_Probe28 "Toaster_ES1274A/Main1/Output/VEHICLE_CAN/ Override Probe28"
 /begin REF_CHARACTERISTIC LightControl_HighBeamOvrCal_val LightControl_HighBeamOvrEn_val /end REF_CHARACTERISTIC
 /begin REF_MEASUREMENT LightControl_HighBeamOvrMsr /end REF_MEASUREMENT
/end GROUP
/begin GROUP S322__Override_Probe29 "Toaster_ES1274A/Main1/Output/VEHICLE_CAN/ Override Probe29" /begin REF_CHARACTERISTIC DriveCmd_AccCmdOvrCal_val DriveCmd_AccCmdOvrEn_val /end REF_CHARACTERISTIC /begin REF_MEASUREMENT DriveCmd_AccCmdOvrMsr /end REF_MEASUREMENT /end GROUP
/begin GROUP S322__Override_Probe3 "Toaster_ES1274A/Main1/Output/VEHICLE_CAN/ Override Probe3"
 /begin REF_CHARACTERISTIC MiscControl_horn_flgOvrCal_val MiscControl_horn_flgOvrEn_val /end REF_CHARACTERISTIC
 /begin REF_MEASUREMENT MiscControl_horn_flgOvrMsr /end REF_MEASUREMENT
/end GROUP
/begin GROUP S322__Override_Probe30 "Toaster_ES1274A/Main1/Output/VEHICLE_CAN/ Override Probe30"
 /begin REF_CHARACTERISTIC MiscControl_RightturnOvrCal_val MiscControl_RightturnOvrEn_val /end REF_CHARACTERISTIC
 /begin REF_MEASUREMENT MiscControl_RightturnOvrMsr /end REF_MEASUREMENT
/end GROUP
/begin GROUP S322__Override_Probe31 "Toaster_ES1274A/Main1/Output/VEHICLE_CAN/ Override Probe31"
 /begin REF_CHARACTERISTIC MiscControl_LeftturnOvrCal_val MiscControl_LeftturnOvrEn_val /end REF_CHARACTERISTIC
 /begin REF_MEASUREMENT MiscControl_LeftturnOvrMsr /end REF_MEASUREMENT
/end GROUP
/begin GROUP S322__Override_Probe32 "Toaster_ES1274A/Main1/Output/VEHICLE_CAN/ Override Probe32" /begin REF_CHARACTERISTIC DriveCmd_GearCmdOvrCal_val DriveCmd_GearCmdOvrEn_val /end REF_CHARACTERISTIC /begin REF_MEASUREMENT DriveCmd_GearCmdOvrMsr /end REF_MEASUREMENT /end GROUP
/begin GROUP S322__Override_Probe33 "Toaster_ES1274A/Main1/Output/VEHICLE_CAN/ Override Probe33"
 /begin REF_CHARACTERISTIC DriveCmd_BrakeDecelCmdOvrCal_val DriveCmd_BrakeDecelCmdOvrEn_val /end REF_CHARACTERISTIC
 /begin REF_MEASUREMENT DriveCmd_BrakeDecelCmdOvrMsr /end REF_MEASUREMENT
/end GROUP
/begin GROUP S322__Override_Probe34 "Toaster_ES1274A/Main1/Output/VEHICLE_CAN/ Override Probe34" /begin REF_CHARACTERISTIC MiscControl_HazardOvrCal_val MiscControl_HazardOvrEn_val /end REF_CHARACTERISTIC /begin REF_MEASUREMENT MiscControl_HazardOvrMsr /end REF_MEASUREMENT /end GROUP
/begin GROUP S322__Override_Probe35 "Toaster_ES1274A/Main1/Output/VEHICLE_CAN/ Override Probe35"
 /begin REF_CHARACTERISTIC SteeringCmd_AngelRateCmdOvrCal_val SteeringCmd_AngelRateCmdOvrEn_val /end REF_CHARACTERISTIC
 /begin REF_MEASUREMENT SteeringCmd_AngelRateCmdOvrMsr /end REF_MEASUREMENT
/end GROUP
/begin GROUP S322__Override_Probe36 "Toaster_ES1274A/Main1/Output/VEHICLE_CAN/ Override Probe36"
 /begin REF_CHARACTERISTIC SteeringCmd_AngelCmdOvrCal_val SteeringCmd_AngelCmdOvrEn_val /end REF_CHARACTERISTIC
 /begin REF_MEASUREMENT SteeringCmd_AngelCmdOvrMsr /end REF_MEASUREMENT
/end GROUP
/begin GROUP S424_Falling_Edge_Debounce "Toaster_ES1274A/PwrOnCtrl/PwrOnCtrl/FlexRayForcetoHalt/Falling Edge Debounce" /begin REF_MEASUREMENT Pwr_flgKeyOnDbnc /end REF_MEASUREMENT /end GROUP
/begin GROUP S73__Override_Probe "Toaster_ES1274A/Main1/Control/ByWireSubsystemControl/ShiftControl/ Override Probe" /begin REF_CHARACTERISTIC testShiftEngagedOvrCal_val testShiftEngagedOvrEn_val /end REF_CHARACTERISTIC /begin REF_MEASUREMENT testShiftEngagedOvrMsr /end REF_MEASUREMENT /end GROUP
/begin GROUP S73__Override_Probe1 "Toaster_ES1274A/Main1/Control/ByWireSubsystemControl/ShiftControl/ Override Probe1" /begin REF_CHARACTERISTIC commandedGearOvrCal_val commandedGearOvrEn_val /end REF_CHARACTERISTIC /begin REF_MEASUREMENT commandedGearOvrMsr /end REF_MEASUREMENT /end GROUP
/begin GROUP S74__Override_Probe "Toaster_ES1274A/Main1/Control/ByWireSubsystemControl/SteerControl/ Override Probe" /begin REF_CHARACTERISTIC steerEngagedOvrCal_val steerEngagedOvrEn_val /end REF_CHARACTERISTIC /begin REF_MEASUREMENT steerEngagedOvrMsr /end REF_MEASUREMENT /end GROUP
/begin GROUP S74__Override_Probe1 "Toaster_ES1274A/Main1/Control/ByWireSubsystemControl/SteerControl/ Override Probe1"
 /begin REF_CHARACTERISTIC steeringWheelAngleSetpoint_DegOvrCal_val steeringWheelAngleSetpoint_DegOvrEn_val /end REF_CHARACTERISTIC
 /begin REF_MEASUREMENT steeringWheelAngleSetpoint_DegOvrMsr /end REF_MEASUREMENT
/end GROUP
/begin GROUP S74__Override_Probe2 "Toaster_ES1274A/Main1/Control/ByWireSubsystemControl/SteerControl/ Override Probe2"
 /begin REF_CHARACTERISTIC steeringWheelAngleRateSetpointOvrCal_val steeringWheelAngleRateSetpointOvrEn_val /end REF_CHARACTERISTIC
 /begin REF_MEASUREMENT steeringWheelAngleRateSetpointOvrMsr /end REF_MEASUREMENT
/end GROUP
/begin GROUP S117__Override_Probe "Toaster_ES1274A/Main1/Input/By-Wire System Signal Processing/AccessorySignalProcessing/ Override Probe" /begin REF_CHARACTERISTIC accessoryFaultOvrCal_val accessoryFaultOvrEn_val /end REF_CHARACTERISTIC /begin REF_MEASUREMENT accessoryFaultOvrMsr /end REF_MEASUREMENT /end GROUP
/begin GROUP S117__Override_Probe1 "Toaster_ES1274A/Main1/Input/By-Wire System Signal Processing/AccessorySignalProcessing/ Override Probe1" /begin REF_CHARACTERISTIC accessoryCanFaultOvrCal_val accessoryCanFaultOvrEn_val /end REF_CHARACTERISTIC /begin REF_MEASUREMENT accessoryCanFaultOvrMsr /end REF_MEASUREMENT /end GROUP
/begin GROUP S118__Override_Probe1 "Toaster_ES1274A/Main1/Input/By-Wire System Signal Processing/BrakeSignalProcessing/ Override Probe1"
 /begin REF_CHARACTERISTIC brakeDriverOverride_CANOvrCal_val brakeDriverOverride_CANOvrEn_val /end REF_CHARACTERISTIC
 /begin REF_MEASUREMENT brakeDriverOverride_CANOvrMsr /end REF_MEASUREMENT
/end GROUP
/begin GROUP S118__Override_Probe5 "Toaster_ES1274A/Main1/Input/By-Wire System Signal Processing/BrakeSignalProcessing/ Override Probe5" /begin REF_CHARACTERISTIC brakePedalPositionOvrCal_val brakePedalPositionOvrEn_val /end REF_CHARACTERISTIC /begin REF_MEASUREMENT brakePedalPositionOvrMsr /end REF_MEASUREMENT /end GROUP
/begin GROUP S118__Override_Probe6 "Toaster_ES1274A/Main1/Input/By-Wire System Signal Processing/BrakeSignalProcessing/ Override Probe6" /begin REF_CHARACTERISTIC brakeFaultOvrCal_val brakeFaultOvrEn_val /end REF_CHARACTERISTIC /begin REF_MEASUREMENT brakeFaultOvrMsr /end REF_MEASUREMENT /end GROUP
/begin GROUP S118__Override_Probe7 "Toaster_ES1274A/Main1/Input/By-Wire System Signal Processing/BrakeSignalProcessing/ Override Probe7" /begin REF_CHARACTERISTIC brakeCanFaultOvrCal_val brakeCanFaultOvrEn_val /end REF_CHARACTERISTIC /begin REF_MEASUREMENT brakeCanFaultOvrMsr /end REF_MEASUREMENT /end GROUP
/begin GROUP S118__Override_Probe8 "Toaster_ES1274A/Main1/Input/By-Wire System Signal Processing/BrakeSignalProcessing/ Override Probe8" /begin REF_CHARACTERISTIC brakeDriverActivityOvrCal_val brakeDriverActivityOvrEn_val /end REF_CHARACTERISTIC /begin REF_MEASUREMENT brakeDriverActivityOvrMsr /end REF_MEASUREMENT /end GROUP
/begin GROUP S118__Override_Probe9 "Toaster_ES1274A/Main1/Input/By-Wire System Signal Processing/BrakeSignalProcessing/ Override Probe9"
 /begin REF_CHARACTERISTIC brakeDriverOverride_PedalOvrCal_val brakeDriverOverride_PedalOvrEn_val /end REF_CHARACTERISTIC
 /begin REF_MEASUREMENT brakeDriverOverride_PedalOvrMsr /end REF_MEASUREMENT
/end GROUP
/begin GROUP S119__Override_Probe "Toaster_ES1274A/Main1/Input/By-Wire System Signal Processing/ShiftSignalProcessing/ Override Probe" /begin REF_CHARACTERISTIC shiftFaultOvrCal_val shiftFaultOvrEn_val /end REF_CHARACTERISTIC /begin REF_MEASUREMENT shiftFaultOvrMsr /end REF_MEASUREMENT /end GROUP
/begin GROUP S119__Override_Probe1 "Toaster_ES1274A/Main1/Input/By-Wire System Signal Processing/ShiftSignalProcessing/ Override Probe1" /begin REF_CHARACTERISTIC shiftCanFaultOvrCal_val shiftCanFaultOvrEn_val /end REF_CHARACTERISTIC /begin REF_MEASUREMENT shiftCanFaultOvrMsr /end REF_MEASUREMENT /end GROUP
/begin GROUP S120__Override_Probe "Toaster_ES1274A/Main1/Input/By-Wire System Signal Processing/SteerSignalProcessing/ Override Probe"
 /begin REF_CHARACTERISTIC steering_feedback_eps_statusOvrCal_val steering_feedback_eps_statusOvrEn_val /end REF_CHARACTERISTIC
 /begin REF_MEASUREMENT steering_feedback_eps_statusOvrMsr /end REF_MEASUREMENT
/end GROUP
/begin GROUP S120__Override_Probe1 "Toaster_ES1274A/Main1/Input/By-Wire System Signal Processing/SteerSignalProcessing/ Override Probe1" /begin REF_CHARACTERISTIC steerFaultOvrCal_val steerFaultOvrEn_val /end REF_CHARACTERISTIC /begin REF_MEASUREMENT steerFaultOvrMsr /end REF_MEASUREMENT /end GROUP
/begin GROUP S120__Override_Probe2 "Toaster_ES1274A/Main1/Input/By-Wire System Signal Processing/SteerSignalProcessing/ Override Probe2" /begin REF_CHARACTERISTIC steerDriverOverrideOvrCal_val steerDriverOverrideOvrEn_val /end REF_CHARACTERISTIC /begin REF_MEASUREMENT steerDriverOverrideOvrMsr /end REF_MEASUREMENT /end GROUP
/begin GROUP S120__Override_Probe3 "Toaster_ES1274A/Main1/Input/By-Wire System Signal Processing/SteerSignalProcessing/ Override Probe3" /begin REF_CHARACTERISTIC steerCanFaultOvrCal_val steerCanFaultOvrEn_val /end REF_CHARACTERISTIC /begin REF_MEASUREMENT steerCanFaultOvrMsr /end REF_MEASUREMENT /end GROUP
/begin GROUP S121__Override_Probe "Toaster_ES1274A/Main1/Input/By-Wire System Signal Processing/SystemSignalProcessing/ Override Probe" /begin REF_CHARACTERISTIC subsystemSelectOvrCal_val subsystemSelectOvrEn_val /end REF_CHARACTERISTIC /begin REF_MEASUREMENT subsystemSelectOvrMsr /end REF_MEASUREMENT /end GROUP
/begin GROUP S121__Override_Probe2 "Toaster_ES1274A/Main1/Input/By-Wire System Signal Processing/SystemSignalProcessing/ Override Probe2" /begin REF_CHARACTERISTIC systemFaultOvrCal_val systemFaultOvrEn_val /end REF_CHARACTERISTIC /begin REF_MEASUREMENT systemFaultOvrMsr /end REF_MEASUREMENT /end GROUP
/begin GROUP S121__Override_Probe3 "Toaster_ES1274A/Main1/Input/By-Wire System Signal Processing/SystemSignalProcessing/ Override Probe3" /begin REF_CHARACTERISTIC systemCanFaultOvrCal_val systemCanFaultOvrEn_val /end REF_CHARACTERISTIC /begin REF_MEASUREMENT systemCanFaultOvrMsr /end REF_MEASUREMENT /end GROUP
/begin GROUP S121__Override_Probe4 "Toaster_ES1274A/Main1/Input/By-Wire System Signal Processing/SystemSignalProcessing/ Override Probe4" /begin REF_CHARACTERISTIC button_debouncedOvrCal_val button_debouncedOvrEn_val /end REF_CHARACTERISTIC /begin REF_MEASUREMENT button_debouncedOvrMsr /end REF_MEASUREMENT /end GROUP
/begin GROUP S122__Override_Probe10 "Toaster_ES1274A/Main1/Input/By-Wire System Signal Processing/ThrottleSignalProcessing/ Override Probe10"
 /begin REF_CHARACTERISTIC throttlePedalPositionOvrCal_val throttlePedalPositionOvrEn_val /end REF_CHARACTERISTIC
 /begin REF_MEASUREMENT throttlePedalPositionOvrMsr /end REF_MEASUREMENT
/end GROUP
/begin GROUP S122__Override_Probe11 "Toaster_ES1274A/Main1/Input/By-Wire System Signal Processing/ThrottleSignalProcessing/ Override Probe11" /begin REF_CHARACTERISTIC throttleFaultOvrCal_val throttleFaultOvrEn_val /end REF_CHARACTERISTIC /begin REF_MEASUREMENT throttleFaultOvrMsr /end REF_MEASUREMENT /end GROUP
/begin GROUP S122__Override_Probe12 "Toaster_ES1274A/Main1/Input/By-Wire System Signal Processing/ThrottleSignalProcessing/ Override Probe12" /begin REF_CHARACTERISTIC throttleCanFaultOvrCal_val throttleCanFaultOvrEn_val /end REF_CHARACTERISTIC /begin REF_MEASUREMENT throttleCanFaultOvrMsr /end REF_MEASUREMENT /end GROUP
/begin GROUP S122__Override_Probe13 "Toaster_ES1274A/Main1/Input/By-Wire System Signal Processing/ThrottleSignalProcessing/ Override Probe13"
 /begin REF_CHARACTERISTIC throttleDriverActivityOvrCal_val throttleDriverActivityOvrEn_val /end REF_CHARACTERISTIC
 /begin REF_MEASUREMENT throttleDriverActivityOvrMsr /end REF_MEASUREMENT
/end GROUP
/begin GROUP S122__Override_Probe14 "Toaster_ES1274A/Main1/Input/By-Wire System Signal Processing/ThrottleSignalProcessing/ Override Probe14"
 /begin REF_CHARACTERISTIC throttleDriverOverride_PedalOvrCal_val throttleDriverOverride_PedalOvrEn_val /end REF_CHARACTERISTIC
 /begin REF_MEASUREMENT throttleDriverOverride_PedalOvrMsr /end REF_MEASUREMENT
/end GROUP
/begin GROUP S122__Override_Probe9 "Toaster_ES1274A/Main1/Input/By-Wire System Signal Processing/ThrottleSignalProcessing/ Override Probe9"
 /begin REF_CHARACTERISTIC throttleDriverOverride_CANOvrCal_val throttleDriverOverride_CANOvrEn_val /end REF_CHARACTERISTIC
 /begin REF_MEASUREMENT throttleDriverOverride_CANOvrMsr /end REF_MEASUREMENT
/end GROUP
/begin GROUP S123_wehspd_km__h_2_r__min "Toaster_ES1274A/Main1/Input/By-Wire System Signal Processing/wheel speed_km//h_2_r//min/wehspd_km//h_2_r//min" /begin REF_CHARACTERISTIC Toaster1_wheel_tire_radius /end REF_CHARACTERISTIC /end GROUP
/begin GROUP S176__Override_Probe1 "Toaster_ES1274A/Main1/Input/Read ADC CAN/CANReceiveAndProcess_AccessoryCommand/ Override Probe1" /begin REF_CHARACTERISTIC CMD_DoorFROvrCal_val CMD_DoorFROvrEn_val /end REF_CHARACTERISTIC /begin REF_MEASUREMENT CMD_DoorFROvrMsr /end REF_MEASUREMENT /end GROUP
/begin GROUP S176__Override_Probe15 "Toaster_ES1274A/Main1/Input/Read ADC CAN/CANReceiveAndProcess_AccessoryCommand/ Override Probe15" /begin REF_CHARACTERISTIC turnSignalOvrCal_val turnSignalOvrEn_val /end REF_CHARACTERISTIC /begin REF_MEASUREMENT turnSignalOvrMsr /end REF_MEASUREMENT /end GROUP
/begin GROUP S176__Override_Probe16 "Toaster_ES1274A/Main1/Input/Read ADC CAN/CANReceiveAndProcess_AccessoryCommand/ Override Probe16" /begin REF_CHARACTERISTIC accessoryCrcValidOvrCal_val accessoryCrcValidOvrEn_val /end REF_CHARACTERISTIC /begin REF_MEASUREMENT accessoryCrcValidOvrMsr /end REF_MEASUREMENT /end GROUP
/begin GROUP S176__Override_Probe17 "Toaster_ES1274A/Main1/Input/Read ADC CAN/CANReceiveAndProcess_AccessoryCommand/ Override Probe17" /begin REF_CHARACTERISTIC accessoryCntValidOvrCal_val accessoryCntValidOvrEn_val /end REF_CHARACTERISTIC /begin REF_MEASUREMENT accessoryCntValidOvrMsr /end REF_MEASUREMENT /end GROUP
/begin GROUP S176__Override_Probe18 "Toaster_ES1274A/Main1/Input/Read ADC CAN/CANReceiveAndProcess_AccessoryCommand/ Override Probe18" /begin REF_CHARACTERISTIC accessoryAgeValidOvrCal_val accessoryAgeValidOvrEn_val /end REF_CHARACTERISTIC /begin REF_MEASUREMENT accessoryAgeValidOvrMsr /end REF_MEASUREMENT /end GROUP
/begin GROUP S176__Override_Probe2 "Toaster_ES1274A/Main1/Input/Read ADC CAN/CANReceiveAndProcess_AccessoryCommand/ Override Probe2" /begin REF_CHARACTERISTIC CMD_hornOvrCal_val CMD_hornOvrEn_val /end REF_CHARACTERISTIC /begin REF_MEASUREMENT CMD_hornOvrMsr /end REF_MEASUREMENT /end GROUP
/begin GROUP S176__Override_Probe6 "Toaster_ES1274A/Main1/Input/Read ADC CAN/CANReceiveAndProcess_AccessoryCommand/ Override Probe6" /begin REF_CHARACTERISTIC drivingLightsOvrCal_val drivingLightsOvrEn_val /end REF_CHARACTERISTIC /begin REF_MEASUREMENT drivingLightsOvrMsr /end REF_MEASUREMENT /end GROUP
/begin GROUP S176__Override_Probe7 "Toaster_ES1274A/Main1/Input/Read ADC CAN/CANReceiveAndProcess_AccessoryCommand/ Override Probe7" /begin REF_CHARACTERISTIC wiperOvrCal_val wiperOvrEn_val /end REF_CHARACTERISTIC /begin REF_MEASUREMENT wiperOvrMsr /end REF_MEASUREMENT /end GROUP
/begin GROUP S176_Check_Accessory_Command_Counter "Toaster_ES1274A/Main1/Input/Read ADC CAN/CANReceiveAndProcess_AccessoryCommand/Check Accessory Command Counter"
 /begin REF_MEASUREMENT Diag_CheckAccessoryCommandCounter_crt Diag_CheckAccessoryCommandCounter_faultCount Diag_CheckAccessoryCommandCounter_prev /end REF_MEASUREMENT
/end GROUP
/begin GROUP S177__Override_Probe1 "Toaster_ES1274A/Main1/Input/Read ADC CAN/CANReceiveAndProcess_BrakeCommand/ Override Probe1" /begin REF_CHARACTERISTIC cmd_EPB_45OvrCal_val cmd_EPB_45OvrEn_val /end REF_CHARACTERISTIC /begin REF_MEASUREMENT cmd_EPB_45OvrMsr /end REF_MEASUREMENT /end GROUP
/begin GROUP S177__Override_Probe15 "Toaster_ES1274A/Main1/Input/Read ADC CAN/CANReceiveAndProcess_BrakeCommand/ Override Probe15" /begin REF_CHARACTERISTIC cmd_brakeLightsOvrCal_val cmd_brakeLightsOvrEn_val /end REF_CHARACTERISTIC /begin REF_MEASUREMENT cmd_brakeLightsOvrMsr /end REF_MEASUREMENT /end GROUP
/begin GROUP S177__Override_Probe16 "Toaster_ES1274A/Main1/Input/Read ADC CAN/CANReceiveAndProcess_BrakeCommand/ Override Probe16" /begin REF_CHARACTERISTIC brakeCrcValidOvrCal_val brakeCrcValidOvrEn_val /end REF_CHARACTERISTIC /begin REF_MEASUREMENT brakeCrcValidOvrMsr /end REF_MEASUREMENT /end GROUP
/begin GROUP S177__Override_Probe17 "Toaster_ES1274A/Main1/Input/Read ADC CAN/CANReceiveAndProcess_BrakeCommand/ Override Probe17" /begin REF_CHARACTERISTIC brakeCntValidOvrCal_val brakeCntValidOvrEn_val /end REF_CHARACTERISTIC /begin REF_MEASUREMENT brakeCntValidOvrMsr /end REF_MEASUREMENT /end GROUP
/begin GROUP S177__Override_Probe18 "Toaster_ES1274A/Main1/Input/Read ADC CAN/CANReceiveAndProcess_BrakeCommand/ Override Probe18" /begin REF_CHARACTERISTIC brakeAgeValidOvrCal_val brakeAgeValidOvrEn_val /end REF_CHARACTERISTIC /begin REF_MEASUREMENT brakeAgeValidOvrMsr /end REF_MEASUREMENT /end GROUP
/begin GROUP S177__Override_Probe6 "Toaster_ES1274A/Main1/Input/Read ADC CAN/CANReceiveAndProcess_BrakeCommand/ Override Probe6"
 /begin REF_CHARACTERISTIC cmd_brakePedalPositionOvrCal_val cmd_brakePedalPositionOvrEn_val /end REF_CHARACTERISTIC
 /begin REF_MEASUREMENT cmd_brakePedalPositionOvrMsr /end REF_MEASUREMENT
/end GROUP
/begin GROUP S177__Override_Probe7 "Toaster_ES1274A/Main1/Input/Read ADC CAN/CANReceiveAndProcess_BrakeCommand/ Override Probe7"
 /begin REF_CHARACTERISTIC cmd_brakePedalPositionRateOvrCal_val cmd_brakePedalPositionRateOvrEn_val /end REF_CHARACTERISTIC
 /begin REF_MEASUREMENT cmd_brakePedalPositionRateOvrMsr /end REF_MEASUREMENT
/end GROUP
/begin GROUP S177_Check_Brake_Command_Counter "Toaster_ES1274A/Main1/Input/Read ADC CAN/CANReceiveAndProcess_BrakeCommand/Check Brake Command Counter"
 /begin REF_MEASUREMENT Diag_CheckBrakeCommandCounter_crt Diag_CheckBrakeCommandCounter_faultCount Diag_CheckBrakeCommandCounter_prev /end REF_MEASUREMENT
/end GROUP
/begin GROUP S178__Override_Probe1 "Toaster_ES1274A/Main1/Input/Read ADC CAN/CANReceiveAndProcess_ShiftCommand/ Override Probe1" /begin REF_CHARACTERISTIC shiftCntValidOvrCal_val shiftCntValidOvrEn_val /end REF_CHARACTERISTIC /begin REF_MEASUREMENT shiftCntValidOvrMsr /end REF_MEASUREMENT /end GROUP
/begin GROUP S178__Override_Probe16 "Toaster_ES1274A/Main1/Input/Read ADC CAN/CANReceiveAndProcess_ShiftCommand/ Override Probe16" /begin REF_CHARACTERISTIC shiftCrcValidOvrCal_val shiftCrcValidOvrEn_val /end REF_CHARACTERISTIC /begin REF_MEASUREMENT shiftCrcValidOvrMsr /end REF_MEASUREMENT /end GROUP
/begin GROUP S178__Override_Probe18 "Toaster_ES1274A/Main1/Input/Read ADC CAN/CANReceiveAndProcess_ShiftCommand/ Override Probe18" /begin REF_CHARACTERISTIC shiftAgeValidOvrCal_val shiftAgeValidOvrEn_val /end REF_CHARACTERISTIC /begin REF_MEASUREMENT shiftAgeValidOvrMsr /end REF_MEASUREMENT /end GROUP
/begin GROUP S178__Override_Probe7 "Toaster_ES1274A/Main1/Input/Read ADC CAN/CANReceiveAndProcess_ShiftCommand/ Override Probe7" /begin REF_CHARACTERISTIC gearOvrCal_val gearOvrEn_val /end REF_CHARACTERISTIC /begin REF_MEASUREMENT gearOvrMsr /end REF_MEASUREMENT /end GROUP
/begin GROUP S178_Check_System_Command_Counter "Toaster_ES1274A/Main1/Input/Read ADC CAN/CANReceiveAndProcess_ShiftCommand/Check System Command Counter"
 /begin REF_MEASUREMENT Diag_CheckShiftCommandCounter_crt Diag_CheckShiftCommandCounter_faultCount Diag_CheckShiftCommandCounter_prev /end REF_MEASUREMENT
/end GROUP
/begin GROUP S179__Override_Probe1 "Toaster_ES1274A/Main1/Input/Read ADC CAN/CANReceiveAndProcess_SteerCommand/ Override Probe1"
 /begin REF_CHARACTERISTIC steeringWheelAngle_rawOvrCal_val steeringWheelAngle_rawOvrEn_val /end REF_CHARACTERISTIC
 /begin REF_MEASUREMENT steeringWheelAngle_rawOvrMsr /end REF_MEASUREMENT
/end GROUP
/begin GROUP S179__Override_Probe15 "Toaster_ES1274A/Main1/Input/Read ADC CAN/CANReceiveAndProcess_SteerCommand/ Override Probe15"
 /begin REF_CHARACTERISTIC steeringWheelAngleCommand_DegOvrCal_val steeringWheelAngleCommand_DegOvrEn_val /end REF_CHARACTERISTIC
 /begin REF_MEASUREMENT steeringWheelAngleCommand_DegOvrMsr /end REF_MEASUREMENT
/end GROUP
/begin GROUP S179__Override_Probe16 "Toaster_ES1274A/Main1/Input/Read ADC CAN/CANReceiveAndProcess_SteerCommand/ Override Probe16" /begin REF_CHARACTERISTIC steerCrcValidOvrCal_val steerCrcValidOvrEn_val /end REF_CHARACTERISTIC /begin REF_MEASUREMENT steerCrcValidOvrMsr /end REF_MEASUREMENT /end GROUP
/begin GROUP S179__Override_Probe17 "Toaster_ES1274A/Main1/Input/Read ADC CAN/CANReceiveAndProcess_SteerCommand/ Override Probe17" /begin REF_CHARACTERISTIC steerCntValidOvrCal_val steerCntValidOvrEn_val /end REF_CHARACTERISTIC /begin REF_MEASUREMENT steerCntValidOvrMsr /end REF_MEASUREMENT /end GROUP
/begin GROUP S179__Override_Probe18 "Toaster_ES1274A/Main1/Input/Read ADC CAN/CANReceiveAndProcess_SteerCommand/ Override Probe18" /begin REF_CHARACTERISTIC steerAgeValidOvrCal_val steerAgeValidOvrEn_val /end REF_CHARACTERISTIC /begin REF_MEASUREMENT steerAgeValidOvrMsr /end REF_MEASUREMENT /end GROUP
/begin GROUP S179__Override_Probe2 "Toaster_ES1274A/Main1/Input/Read ADC CAN/CANReceiveAndProcess_SteerCommand/ Override Probe2"
 /begin REF_CHARACTERISTIC steeringWheelAngleRateCommandOvrCal_val steeringWheelAngleRateCommandOvrEn_val /end REF_CHARACTERISTIC
 /begin REF_MEASUREMENT steeringWheelAngleRateCommandOvrMsr /end REF_MEASUREMENT
/end GROUP
/begin GROUP S179_Check_System_Command_Counter "Toaster_ES1274A/Main1/Input/Read ADC CAN/CANReceiveAndProcess_SteerCommand/Check System Command Counter"
 /begin REF_MEASUREMENT Diag_CheckSteerCommandCounter_crt Diag_CheckSteerCommandCounter_faultCount Diag_CheckSteerCommandCounter_prev /end REF_MEASUREMENT
/end GROUP
/begin GROUP S180__Override_Probe "Toaster_ES1274A/Main1/Input/Read ADC CAN/CANReceiveAndProcess_SystemCommand/ Override Probe" /begin REF_CHARACTERISTIC systemAgeOvrCal_val systemAgeOvrEn_val /end REF_CHARACTERISTIC /begin REF_MEASUREMENT systemAgeOvrMsr /end REF_MEASUREMENT /end GROUP
/begin GROUP S180__Override_Probe1 "Toaster_ES1274A/Main1/Input/Read ADC CAN/CANReceiveAndProcess_SystemCommand/ Override Probe1" /begin REF_CHARACTERISTIC systemAgeValidOvrCal_val systemAgeValidOvrEn_val /end REF_CHARACTERISTIC /begin REF_MEASUREMENT systemAgeValidOvrMsr /end REF_MEASUREMENT /end GROUP
/begin GROUP S180__Override_Probe10 "Toaster_ES1274A/Main1/Input/Read ADC CAN/CANReceiveAndProcess_SystemCommand/ Override Probe10" /begin REF_CHARACTERISTIC selectSteerOvrCal_val selectSteerOvrEn_val /end REF_CHARACTERISTIC /begin REF_MEASUREMENT selectSteerOvrMsr /end REF_MEASUREMENT /end GROUP
/begin GROUP S180__Override_Probe11 "Toaster_ES1274A/Main1/Input/Read ADC CAN/CANReceiveAndProcess_SystemCommand/ Override Probe11" /begin REF_CHARACTERISTIC selectThrottleOvrCal_val selectThrottleOvrEn_val /end REF_CHARACTERISTIC /begin REF_MEASUREMENT selectThrottleOvrMsr /end REF_MEASUREMENT /end GROUP
/begin GROUP S180__Override_Probe12 "Toaster_ES1274A/Main1/Input/Read ADC CAN/CANReceiveAndProcess_SystemCommand/ Override Probe12"
 /begin REF_CHARACTERISTIC systemRequestADSEngagedOvrCal_val systemRequestADSEngagedOvrEn_val /end REF_CHARACTERISTIC
 /begin REF_MEASUREMENT systemRequestADSEngagedOvrMsr /end REF_MEASUREMENT
/end GROUP
/begin GROUP S180__Override_Probe13 "Toaster_ES1274A/Main1/Input/Read ADC CAN/CANReceiveAndProcess_SystemCommand/ Override Probe13" /begin REF_CHARACTERISTIC selectAccessoryOvrCal_val selectAccessoryOvrEn_val /end REF_CHARACTERISTIC /begin REF_MEASUREMENT selectAccessoryOvrMsr /end REF_MEASUREMENT /end GROUP
/begin GROUP S180__Override_Probe14 "Toaster_ES1274A/Main1/Input/Read ADC CAN/CANReceiveAndProcess_SystemCommand/ Override Probe14" /begin REF_CHARACTERISTIC selectBrakeOvrCal_val selectBrakeOvrEn_val /end REF_CHARACTERISTIC /begin REF_MEASUREMENT selectBrakeOvrMsr /end REF_MEASUREMENT /end GROUP
/begin GROUP S180__Override_Probe3 "Toaster_ES1274A/Main1/Input/Read ADC CAN/CANReceiveAndProcess_SystemCommand/ Override Probe3" /begin REF_CHARACTERISTIC systemCntValidOvrCal_val systemCntValidOvrEn_val /end REF_CHARACTERISTIC /begin REF_MEASUREMENT systemCntValidOvrMsr /end REF_MEASUREMENT /end GROUP
/begin GROUP S180__Override_Probe4 "Toaster_ES1274A/Main1/Input/Read ADC CAN/CANReceiveAndProcess_SystemCommand/ Override Probe4" /begin REF_CHARACTERISTIC systemCrcValidOvrCal_val systemCrcValidOvrEn_val /end REF_CHARACTERISTIC /begin REF_MEASUREMENT systemCrcValidOvrMsr /end REF_MEASUREMENT /end GROUP
/begin GROUP S180__Override_Probe5 "Toaster_ES1274A/Main1/Input/Read ADC CAN/CANReceiveAndProcess_SystemCommand/ Override Probe5" /begin REF_CHARACTERISTIC adcCapableOvrCal_val adcCapableOvrEn_val /end REF_CHARACTERISTIC /begin REF_MEASUREMENT adcCapableOvrMsr /end REF_MEASUREMENT /end GROUP
/begin GROUP S180__Override_Probe8 "Toaster_ES1274A/Main1/Input/Read ADC CAN/CANReceiveAndProcess_SystemCommand/ Override Probe8" /begin REF_CHARACTERISTIC systemClearOverrideOvrCal_val systemClearOverrideOvrEn_val /end REF_CHARACTERISTIC /begin REF_MEASUREMENT systemClearOverrideOvrMsr /end REF_MEASUREMENT /end GROUP
/begin GROUP S180__Override_Probe9 "Toaster_ES1274A/Main1/Input/Read ADC CAN/CANReceiveAndProcess_SystemCommand/ Override Probe9" /begin REF_CHARACTERISTIC selectShiftOvrCal_val selectShiftOvrEn_val /end REF_CHARACTERISTIC /begin REF_MEASUREMENT selectShiftOvrMsr /end REF_MEASUREMENT /end GROUP
/begin GROUP S180_Check_System_Command_Counter "Toaster_ES1274A/Main1/Input/Read ADC CAN/CANReceiveAndProcess_SystemCommand/Check System Command Counter"
 /begin REF_MEASUREMENT Diag_CheckSystemCommandCounter_crt Diag_CheckSystemCommandCounter_faultCount Diag_CheckSystemCommandCounter_prev /end REF_MEASUREMENT
/end GROUP
/begin GROUP S181__Override_Probe1 "Toaster_ES1274A/Main1/Input/Read ADC CAN/CANReceiveAndProcess_ThrottleCommand/ Override Probe1"
 /begin REF_CHARACTERISTIC acceleratorPositionRateOvrCal_val acceleratorPositionRateOvrEn_val /end REF_CHARACTERISTIC
 /begin REF_MEASUREMENT acceleratorPositionRateOvrMsr /end REF_MEASUREMENT
/end GROUP
/begin GROUP S181__Override_Probe15 "Toaster_ES1274A/Main1/Input/Read ADC CAN/CANReceiveAndProcess_ThrottleCommand/ Override Probe15" /begin REF_CHARACTERISTIC acceleratorPositionOvrCal_val acceleratorPositionOvrEn_val /end REF_CHARACTERISTIC /begin REF_MEASUREMENT acceleratorPositionOvrMsr /end REF_MEASUREMENT /end GROUP
/begin GROUP S181__Override_Probe16 "Toaster_ES1274A/Main1/Input/Read ADC CAN/CANReceiveAndProcess_ThrottleCommand/ Override Probe16" /begin REF_CHARACTERISTIC throttleCrcValidOvrCal_val throttleCrcValidOvrEn_val /end REF_CHARACTERISTIC /begin REF_MEASUREMENT throttleCrcValidOvrMsr /end REF_MEASUREMENT /end GROUP
/begin GROUP S181__Override_Probe17 "Toaster_ES1274A/Main1/Input/Read ADC CAN/CANReceiveAndProcess_ThrottleCommand/ Override Probe17" /begin REF_CHARACTERISTIC throttleCntValidOvrCal_val throttleCntValidOvrEn_val /end REF_CHARACTERISTIC /begin REF_MEASUREMENT throttleCntValidOvrMsr /end REF_MEASUREMENT /end GROUP
/begin GROUP S181__Override_Probe18 "Toaster_ES1274A/Main1/Input/Read ADC CAN/CANReceiveAndProcess_ThrottleCommand/ Override Probe18" /begin REF_CHARACTERISTIC throttleAgeValidOvrCal_val throttleAgeValidOvrEn_val /end REF_CHARACTERISTIC /begin REF_MEASUREMENT throttleAgeValidOvrMsr /end REF_MEASUREMENT /end GROUP
/begin GROUP S181_Check_System_Command_Counter "Toaster_ES1274A/Main1/Input/Read ADC CAN/CANReceiveAndProcess_ThrottleCommand/Check System Command Counter"
 /begin REF_MEASUREMENT Diag_CheckThrottleCommandCounter_crt Diag_CheckThrottleCommandCounter_faultCount Diag_CheckThrottleCommandCounter_prev /end REF_MEASUREMENT
/end GROUP
/begin GROUP S368__Override_Probe24 "Toaster_ES1274A/Main1/Output/Physical/Digital/ Override Probe24" /begin REF_CHARACTERISTIC LSO06_PIN13OvrCal_val LSO06_PIN13OvrEn_val /end REF_CHARACTERISTIC /begin REF_MEASUREMENT LSO06_PIN13OvrMsr /end REF_MEASUREMENT /end GROUP
/begin GROUP S368__Override_Probe25 "Toaster_ES1274A/Main1/Output/Physical/Digital/ Override Probe25" /begin REF_CHARACTERISTIC LSO04_PIN45OvrCal_val LSO04_PIN45OvrEn_val /end REF_CHARACTERISTIC /begin REF_MEASUREMENT LSO04_PIN45OvrMsr /end REF_MEASUREMENT /end GROUP
/begin GROUP S368__Override_Probe26 "Toaster_ES1274A/Main1/Output/Physical/Digital/ Override Probe26" /begin REF_CHARACTERISTIC LSO05_PIN46OvrCal_val LSO05_PIN46OvrEn_val /end REF_CHARACTERISTIC /begin REF_MEASUREMENT LSO05_PIN46OvrMsr /end REF_MEASUREMENT /end GROUP
/begin GROUP S368__Override_Probe8 "Toaster_ES1274A/Main1/Output/Physical/Digital/ Override Probe8" /begin REF_CHARACTERISTIC LSO03_PIN14OvrCal_val LSO03_PIN14OvrEn_val /end REF_CHARACTERISTIC /begin REF_MEASUREMENT LSO03_PIN14OvrMsr /end REF_MEASUREMENT /end GROUP
/end MODULE
/end PROJECT
/* (add any file trailer comments here) */
/* EOF Toaster_ES1274A.a2l */
